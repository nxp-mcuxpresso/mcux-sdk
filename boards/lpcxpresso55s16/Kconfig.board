## boards/lpcxpresso55s16/Kconfig.board
```kconfig
# Copyright 2023 NXP
# All rights reserved.
#
# SPDX-License-Identifier: BSD-3-Clause


config MCUX_USE_BOARD_LPCXPRESSO55S16
    bool "LPCXPRESSO55S16"
    select MCUX_USE_SOC_LPC55S16
    select MCUX_SOC_PART_LPC55S16
```

## boards/lpcxpresso55s28/Kconfig
```kconfig
# Copyright 2023 NXP
# All rights reserved.
#
# SPDX-License-Identifier: BSD-3-Clause
if MCUX_USE_BOARD_LPCXPRESSO55S28

config MCUX_BOARD
    default "lpcxpresso55s28"

config MCUX_KIT
    default "lpcxpresso55s28"


#### Board level drivers ####

endif
```

## boards/lpcxpresso55s69/Kconfig
```kconfig
# Copyright 2023 NXP
# All rights reserved.
#
# SPDX-License-Identifier: BSD-3-Clause
if (MCUX_USE_BOARD_LPCXPRESSO55S69_CM33_CORE0 || MCUX_USE_BOARD_LPCXPRESSO55S69_CM33_CORE1)

config MCUX_BOARD
    default "lpcxpresso55s69"

config MCUX_KIT
    default "lpcxpresso55s69"


#### Board level drivers ####

endif
```

## boards/lpcxpresso55s69/Kconfig.board
```kconfig
# Copyright 2023 NXP
# All rights reserved.
#
# SPDX-License-Identifier: BSD-3-Clause


config MCUX_USE_BOARD_LPCXPRESSO55S69_CM33_CORE0
    bool "LPCXPRESSO55S69 [CM33_CORE0]"
    select MCUX_USE_SOC_LPC55S69_CM33_CORE0
    select MCUX_SOC_PART_LPC55S69

config MCUX_USE_BOARD_LPCXPRESSO55S69_CM33_CORE1
    bool "LPCXPRESSO55S69 [CM33_CORE1]"
    select MCUX_USE_SOC_LPC55S69_CM33_CORE1
    select MCUX_SOC_PART_LPC55S69
```

## boards/lpcxpresso802/Kconfig
```kconfig
# Copyright 2023 NXP
# All rights reserved.
#
# SPDX-License-Identifier: BSD-3-Clause
if MCUX_USE_BOARD_LPCXPRESSO802

config MCUX_BOARD
    default "lpcxpresso802"

config MCUX_KIT
    default "lpcxpresso802"


#### Board level drivers ####

endif
```

## boards/lpcxpresso802/Kconfig.board
```kconfig
# Copyright 2023 NXP
# All rights reserved.
#
# SPDX-License-Identifier: BSD-3-Clause


config MCUX_USE_BOARD_LPCXPRESSO802
    bool "LPCXPRESSO802"
    select MCUX_USE_SOC_LPC802
    select MCUX_SOC_PART_LPC802
```

## boards/lpcxpresso804/Kconfig
```kconfig
# Copyright 2023 NXP
# All rights reserved.
#
# SPDX-License-Identifier: BSD-3-Clause
if MCUX_USE_BOARD_LPCXPRESSO804

config MCUX_BOARD
    default "lpcxpresso804"

config MCUX_KIT
    default "lpcxpresso804"


#### Board level drivers ####

endif
```

## boards/lpcxpresso804/Kconfig.board
```kconfig
# Copyright 2023 NXP
# All rights reserved.
#
# SPDX-License-Identifier: BSD-3-Clause


config MCUX_USE_BOARD_LPCXPRESSO804
    bool "LPCXPRESSO804"
    select MCUX_USE_SOC_LPC804
    select MCUX_SOC_PART_LPC804
```

## boards/lpcxpresso824max/Kconfig
```kconfig
# Copyright 2023 NXP
# All rights reserved.
#
# SPDX-License-Identifier: BSD-3-Clause
if MCUX_USE_BOARD_LPCXPRESSO824MAX

config MCUX_BOARD
    default "lpcxpresso824max"

config MCUX_KIT
    default "lpcxpresso824max"


#### Board level drivers ####

endif
```

## boards/lpcxpresso824max/Kconfig.board
```kconfig
# Copyright 2023 NXP
# All rights reserved.
#
# SPDX-License-Identifier: BSD-3-Clause


config MCUX_USE_BOARD_LPCXPRESSO824MAX
    bool "LPCXPRESSO824MAX"
    select MCUX_USE_SOC_LPC824
    select MCUX_SOC_PART_LPC824
```

## boards/lpcxpresso845max/Kconfig
```kconfig
# Copyright 2023 NXP
# All rights reserved.
#
# SPDX-License-Identifier: BSD-3-Clause
if MCUX_USE_BOARD_LPCXPRESSO845MAX

config MCUX_BOARD
    default "lpcxpresso845max"

config MCUX_KIT
    default "lpcxpresso845max"


#### Board level drivers ####

endif
```

## boards/lpcxpresso845max/Kconfig.board
```kconfig
# Copyright 2023 NXP
# All rights reserved.
#
# SPDX-License-Identifier: BSD-3-Clause


config MCUX_USE_BOARD_LPCXPRESSO845MAX
    bool "LPCXPRESSO845MAX"
    select MCUX_USE_SOC_LPC845
    select MCUX_SOC_PART_LPC845
```

## boards/mimxrt685audevk/Kconfig
```kconfig
# Copyright 2023 NXP
# All rights reserved.
#
# SPDX-License-Identifier: BSD-3-Clause
if (MCUX_USE_BOARD_MIMXRT685AUDEVK_CM33)

config MCUX_BOARD
    default "mimxrt685audevk"

config MCUX_KIT
    default "mimxrt685audevk"


#### Board level drivers ####
rsource "flash_config/Kconfig"

endif
```

## boards/mimxrt685audevk/Kconfig.board
```kconfig
# Copyright 2023 NXP
# All rights reserved.
#
# SPDX-License-Identifier: BSD-3-Clause


config MCUX_USE_BOARD_MIMXRT685AUDEVK_CM33
    bool "MIMXRT685AUDEVK [CM33]"
    select MCUX_USE_SOC_MIMXRT685S_CM33
    select MCUX_SOC_PART_MIMXRT685S
```

## boards/mimxrt685audevk/flash_config/Kconfig
```kconfig
# Copyright 2023 NXP
# All rights reserved.
#
# SPDX-License-Identifier: BSD-3-Clause

# driver_flash_config_mimxrt685audevk
config MCUX_USE_driver_flash_config_mimxrt685audevk
    bool "Flash config"
    select MCUX_USE_driver_common
    help
      flash config block
```

## boards/twrkm34z50mv3/Kconfig
```kconfig
# Copyright 2023 NXP
# All rights reserved.
#
# SPDX-License-Identifier: BSD-3-Clause
if MCUX_USE_BOARD_TWRKM34Z50MV3

config MCUX_BOARD
    default "twrkm34z50mv3"

config MCUX_KIT
    default "twrkm34z50mv3"


#### Board level drivers ####

endif
```

## boards/twrkm34z50mv3/Kconfig.board
```kconfig
# Copyright 2023 NXP
# All rights reserved.
#
# SPDX-License-Identifier: BSD-3-Clause


config MCUX_USE_BOARD_TWRKM34Z50MV3
    bool "TWRKM34Z50MV3"
    select MCUX_USE_SOC_MKM34ZA5
    select MCUX_SOC_PART_MKM34Z128Axxx5
```

## boards/twrkm34z75m/Kconfig
```kconfig
# Copyright 2023 NXP
# All rights reserved.
#
# SPDX-License-Identifier: BSD-3-Clause
if MCUX_USE_BOARD_TWRKM34Z75M

config MCUX_BOARD
    default "twrkm34z75m"

config MCUX_KIT
    default "twrkm34z75m"


#### Board level drivers ####

endif
```

## boards/twrkm34z75m/Kconfig.board
```kconfig
# Copyright 2023 NXP
# All rights reserved.
#
# SPDX-License-Identifier: BSD-3-Clause


config MCUX_USE_BOARD_TWRKM34Z75M
    bool "TWRKM34Z75M"
    select MCUX_USE_SOC_MKM34Z7
    select MCUX_SOC_PART_MKM34Z256xxx7
```

## boards/twrkm35z75m/Kconfig
```kconfig
# Copyright 2023 NXP
# All rights reserved.
#
# SPDX-License-Identifier: BSD-3-Clause
if MCUX_USE_BOARD_TWRKM35Z75M

config MCUX_BOARD
    default "twrkm35z75m"

config MCUX_KIT
    default "twrkm35z75m"


#### Board level drivers ####

endif
```

## cmsis_drivers/Kconfig
```kconfig
# Copyright 2023 NXP
# All rights reserved.
#
# SPDX-License-Identifier: BSD-3-Clause

menu "CMSIS Driver Configuration"

rsource "./*/Kconfig"

endmenu
```

## cmsis_drivers/dspi/Kconfig
```kconfig
# Copyright 2023 NXP
# All rights reserved.
#
# SPDX-License-Identifier: BSD-3-Clause

# driver_cmsis_dspi
config MCUX_HAS_driver_cmsis_dspi
    bool

config MCUX_USE_driver_cmsis_dspi
    depends on MCUX_HAS_driver_cmsis_dspi
    bool "DSPI CMSIS Driver"
    select MCUX_USE_driver_dspi_edma
    select MCUX_USE_CMSIS_Driver_Include_SPI
    select MCUX_USE_RTE_Device
    help
      DSPI CMSIS Driver
```

## cmsis_drivers/ecspi/Kconfig
```kconfig
# Copyright 2023 NXP
# All rights reserved.
#
# SPDX-License-Identifier: BSD-3-Clause

# driver_cmsis_ecspi
config MCUX_HAS_driver_cmsis_ecspi
    bool

config MCUX_USE_driver_cmsis_ecspi
    depends on MCUX_HAS_driver_cmsis_ecspi
    bool "ECSPI CMSIS Driver"
    select MCUX_USE_driver_ecspi
    select MCUX_USE_CMSIS_Driver_Include_SPI
    select MCUX_USE_RTE_Device
    help
      ECSPI CMSIS Driver
```

## cmsis_drivers/enet/Kconfig
```kconfig
# Copyright 2023 NXP
# All rights reserved.
#
# SPDX-License-Identifier: BSD-3-Clause

# driver_cmsis_enet
config MCUX_HAS_driver_cmsis_enet
    bool

config MCUX_USE_driver_cmsis_enet
    depends on MCUX_HAS_driver_cmsis_enet
    bool "ENET CMSIS Driver"
    select MCUX_USE_driver_enet
    select MCUX_USE_CMSIS_Driver_Include_Ethernet_MAC
    select MCUX_USE_CMSIS_Driver_Include_Ethernet_PHY
    select MCUX_USE_CMSIS_Driver_Include_Ethernet
    select MCUX_USE_RTE_Device
    select MCUX_USE_driver_phy-common
    help
      ENET CMSIS Driver
```

## cmsis_drivers/flexcomm/Kconfig
```kconfig
# Copyright 2023 NXP
# All rights reserved.
#
# SPDX-License-Identifier: BSD-3-Clause

# driver_cmsis_flexcomm_i2c
config MCUX_HAS_driver_cmsis_flexcomm_i2c
    bool

config MCUX_USE_driver_cmsis_flexcomm_i2c
    depends on MCUX_HAS_driver_cmsis_flexcomm_i2c
    bool "I2C CMSIS Driver"
    select MCUX_USE_driver_flexcomm_i2c_dma
    select MCUX_USE_CMSIS_Driver_Include_I2C
    select MCUX_USE_RTE_Device
    help
      I2C CMSIS Driver

# driver_cmsis_flexcomm_spi
config MCUX_HAS_driver_cmsis_flexcomm_spi
    bool

config MCUX_USE_driver_cmsis_flexcomm_spi
    depends on MCUX_HAS_driver_cmsis_flexcomm_spi
    bool "SPI CMSIS Driver"
    select MCUX_USE_driver_flexcomm_spi_dma
    select MCUX_USE_CMSIS_Driver_Include_SPI
    select MCUX_USE_RTE_Device
    help
      SPI CMSIS Driver

# driver_cmsis_flexcomm_usart
config MCUX_HAS_driver_cmsis_flexcomm_usart
    bool

config MCUX_USE_driver_cmsis_flexcomm_usart
    depends on MCUX_HAS_driver_cmsis_flexcomm_usart
    bool "USART CMSIS Driver"
    select MCUX_USE_driver_flexcomm_usart_dma
    select MCUX_USE_CMSIS_Driver_Include_USART
    select MCUX_USE_RTE_Device
    help
      USART CMSIS Driver
```
