## boards/frdmk32l2b/Kconfig
```kconfig
# Copyright 2023 NXP
# All rights reserved.
#
# SPDX-License-Identifier: BSD-3-Clause
if MCUX_USE_BOARD_FRDMK32L2B

config MCUX_BOARD
    default "frdmk32l2b"

config MCUX_KIT
    default "frdmk32l2b"


#### Board level drivers ####

endif
```

## boards/frdmk32l2b/Kconfig.board
```kconfig
# Copyright 2023 NXP
# All rights reserved.
#
# SPDX-License-Identifier: BSD-3-Clause


config MCUX_USE_BOARD_FRDMK32L2B
    bool "FRDMK32L2B"
    select MCUX_USE_SOC_K32L2B31A
    select MCUX_SOC_PART_K32L2B31xxxxA
```

## boards/frdmk32l3a6/Kconfig
```kconfig
# Copyright 2023 NXP
# All rights reserved.
#
# SPDX-License-Identifier: BSD-3-Clause
if (MCUX_USE_BOARD_FRDMK32L3A6_CM0PLUS || MCUX_USE_BOARD_FRDMK32L3A6_CM4)

config MCUX_BOARD
    default "frdmk32l3a6"

config MCUX_KIT
    default "frdmk32l3a6"


#### Board level drivers ####

endif
```

## boards/frdmk32l3a6/Kconfig.board
```kconfig
# Copyright 2023 NXP
# All rights reserved.
#
# SPDX-License-Identifier: BSD-3-Clause


config MCUX_USE_BOARD_FRDMK32L3A6_CM0PLUS
    bool "FRDMK32L3A6 [CM0PLUS]"
    select MCUX_USE_SOC_K32L3A60_CM0PLUS
    select MCUX_SOC_PART_K32L3A60xxx

config MCUX_USE_BOARD_FRDMK32L3A6_CM4
    bool "FRDMK32L3A6 [CM4]"
    select MCUX_USE_SOC_K32L3A60_CM4
    select MCUX_SOC_PART_K32L3A60xxx
```

## boards/frdmke02z40m/Kconfig
```kconfig
# Copyright 2023 NXP
# All rights reserved.
#
# SPDX-License-Identifier: BSD-3-Clause
if MCUX_USE_BOARD_FRDMKE02Z40M

config MCUX_BOARD
    default "frdmke02z40m"

config MCUX_KIT
    default "frdmke02z40m"


#### Board level drivers ####

endif
```

## boards/frdmke02z40m/Kconfig.board
```kconfig
# Copyright 2023 NXP
# All rights reserved.
#
# SPDX-License-Identifier: BSD-3-Clause


config MCUX_USE_BOARD_FRDMKE02Z40M
    bool "FRDMKE02Z40M"
    select MCUX_USE_SOC_MKE02Z4
    select MCUX_SOC_PART_MKE02Z64xxx4
```

## boards/frdmke15z/Kconfig
```kconfig
# Copyright 2023 NXP
# All rights reserved.
#
# SPDX-License-Identifier: BSD-3-Clause
if MCUX_USE_BOARD_FRDMKE15Z

config MCUX_BOARD
    default "frdmke15z"

config MCUX_KIT
    default "frdmke15z"


#### Board level drivers ####

endif
```

## boards/frdmke15z/Kconfig.board
```kconfig
# Copyright 2023 NXP
# All rights reserved.
#
# SPDX-License-Identifier: BSD-3-Clause


config MCUX_USE_BOARD_FRDMKE15Z
    bool "FRDMKE15Z"
    select MCUX_USE_SOC_MKE15Z7
    select MCUX_SOC_PART_MKE15Z256xxx7
```

## boards/frdmke16z/Kconfig
```kconfig
# Copyright 2023 NXP
# All rights reserved.
#
# SPDX-License-Identifier: BSD-3-Clause
if MCUX_USE_BOARD_FRDMKE16Z

config MCUX_BOARD
    default "frdmke16z"

config MCUX_KIT
    default "frdmke16z"


#### Board level drivers ####

endif
```

## boards/frdmke16z/Kconfig.board
```kconfig
# Copyright 2023 NXP
# All rights reserved.
#
# SPDX-License-Identifier: BSD-3-Clause


config MCUX_USE_BOARD_FRDMKE16Z
    bool "FRDMKE16Z"
    select MCUX_USE_SOC_MKE16Z4
    select MCUX_SOC_PART_MKE16Z64xxx4
```

## boards/frdmke17z/Kconfig
```kconfig
# Copyright 2023 NXP
# All rights reserved.
#
# SPDX-License-Identifier: BSD-3-Clause
if MCUX_USE_BOARD_FRDMKE17Z

config MCUX_BOARD
    default "frdmke17z"

config MCUX_KIT
    default "frdmke17z"


#### Board level drivers ####

endif
```

## boards/frdmke17z/Kconfig.board
```kconfig
# Copyright 2023 NXP
# All rights reserved.
#
# SPDX-License-Identifier: BSD-3-Clause


config MCUX_USE_BOARD_FRDMKE17Z
    bool "FRDMKE17Z"
    select MCUX_USE_SOC_MKE17Z7
    select MCUX_SOC_PART_MKE17Z256xxx7
```

## boards/lpc845breakout/Kconfig
```kconfig
# Copyright 2023 NXP
# All rights reserved.
#
# SPDX-License-Identifier: BSD-3-Clause
if MCUX_USE_BOARD_LPC845BREAKOUT

config MCUX_BOARD
    default "lpc845breakout"

config MCUX_KIT
    default "lpc845breakout"


#### Board level drivers ####

endif
```

## boards/lpc845breakout/Kconfig.board
```kconfig
# Copyright 2023 NXP
# All rights reserved.
#
# SPDX-License-Identifier: BSD-3-Clause


config MCUX_USE_BOARD_LPC845BREAKOUT
    bool "LPC845BREAKOUT"
    select MCUX_USE_SOC_LPC845
    select MCUX_SOC_PART_LPC845
```

## boards/lpcxpresso51u68/Kconfig
```kconfig
# Copyright 2023 NXP
# All rights reserved.
#
# SPDX-License-Identifier: BSD-3-Clause
if MCUX_USE_BOARD_LPCXPRESSO51U68

config MCUX_BOARD
    default "lpcxpresso51u68"

config MCUX_KIT
    default "lpcxpresso51u68"


#### Board level drivers ####

endif
```

## boards/lpcxpresso51u68/Kconfig.board
```kconfig
# Copyright 2023 NXP
# All rights reserved.
#
# SPDX-License-Identifier: BSD-3-Clause


config MCUX_USE_BOARD_LPCXPRESSO51U68
    bool "LPCXPRESSO51U68"
    select MCUX_USE_SOC_LPC51U68
    select MCUX_SOC_PART_LPC51U68
```

## boards/lpcxpresso54628/Kconfig
```kconfig
# Copyright 2023 NXP
# All rights reserved.
#
# SPDX-License-Identifier: BSD-3-Clause
if MCUX_USE_BOARD_LPCXPRESSO54628

config MCUX_BOARD
    default "lpcxpresso54628"

config MCUX_KIT
    default "lpcxpresso54628"


#### Board level drivers ####

endif
```

## boards/lpcxpresso54628/Kconfig.board
```kconfig
# Copyright 2023 NXP
# All rights reserved.
#
# SPDX-License-Identifier: BSD-3-Clause


config MCUX_USE_BOARD_LPCXPRESSO54628
    bool "LPCXPRESSO54628"
    select MCUX_USE_SOC_LPC54628
    select MCUX_SOC_PART_LPC54628J512
```

## boards/lpcxpresso54s018/Kconfig
```kconfig
# Copyright 2023 NXP
# All rights reserved.
#
# SPDX-License-Identifier: BSD-3-Clause
if MCUX_USE_BOARD_LPCXPRESSO54S018

config MCUX_BOARD
    default "lpcxpresso54s018"

config MCUX_KIT
    default "lpcxpresso54s018"


#### Board level drivers ####

endif
```

## boards/lpcxpresso54s018/Kconfig.board
```kconfig
# Copyright 2023 NXP
# All rights reserved.
#
# SPDX-License-Identifier: BSD-3-Clause


config MCUX_USE_BOARD_LPCXPRESSO54S018
    bool "LPCXPRESSO54S018"
    select MCUX_USE_SOC_LPC54S018
    select MCUX_SOC_PART_LPC54S018
```

## boards/lpcxpresso54s018m/Kconfig
```kconfig
# Copyright 2023 NXP
# All rights reserved.
#
# SPDX-License-Identifier: BSD-3-Clause
if MCUX_USE_BOARD_LPCXPRESSO54S018M

config MCUX_BOARD
    default "lpcxpresso54s018m"

config MCUX_KIT
    default "lpcxpresso54s018m"


#### Board level drivers ####

endif
```

## boards/lpcxpresso54s018m/Kconfig.board
```kconfig
# Copyright 2023 NXP
# All rights reserved.
#
# SPDX-License-Identifier: BSD-3-Clause


config MCUX_USE_BOARD_LPCXPRESSO54S018M
    bool "LPCXPRESSO54S018M"
    select MCUX_USE_SOC_LPC54S018M
    select MCUX_SOC_PART_LPC54S018J4M
```

## boards/lpcxpresso55s06/Kconfig
```kconfig
# Copyright 2023 NXP
# All rights reserved.
#
# SPDX-License-Identifier: BSD-3-Clause
if MCUX_USE_BOARD_LPCXPRESSO55S06

config MCUX_BOARD
    default "lpcxpresso55s06"

config MCUX_KIT
    default "lpcxpresso55s06"


#### Board level drivers ####

endif
```

## boards/lpcxpresso55s06/Kconfig.board
```kconfig
# Copyright 2023 NXP
# All rights reserved.
#
# SPDX-License-Identifier: BSD-3-Clause


config MCUX_USE_BOARD_LPCXPRESSO55S06
    bool "LPCXPRESSO55S06"
    select MCUX_USE_SOC_LPC55S06
    select MCUX_SOC_PART_LPC55S06
```

## boards/lpcxpresso55s16/Kconfig
```kconfig
# Copyright 2023 NXP
# All rights reserved.
#
# SPDX-License-Identifier: BSD-3-Clause
if MCUX_USE_BOARD_LPCXPRESSO55S16

config MCUX_BOARD
    default "lpcxpresso55s16"

config MCUX_KIT
    default "lpcxpresso55s16"


#### Board level drivers ####

endif
```
