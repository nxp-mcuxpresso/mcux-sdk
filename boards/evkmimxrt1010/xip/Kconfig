## boards/evkmimxrt1010/xip/Kconfig
```kconfig
# Copyright 2023 NXP
# All rights reserved.
#
# SPDX-License-Identifier: BSD-3-Clause

# driver_xip_board_evkmimxrt1010
config MCUX_USE_driver_xip_board_evkmimxrt1010
    bool "XIP Board Driver"
    select MCUX_USE_driver_common
    help
      XIP Board Driver
```

## boards/evkmimxrt1015/Kconfig
```kconfig
# Copyright 2023 NXP
# All rights reserved.
#
# SPDX-License-Identifier: BSD-3-Clause
if MCUX_USE_BOARD_EVKMIMXRT1015

config MCUX_BOARD
    default "evkmimxrt1015"

config MCUX_KIT
    default "evkmimxrt1015"


#### Board level drivers ####
rsource "xip/Kconfig"

endif
```

## boards/evkmimxrt1020/Kconfig.board
```kconfig
# Copyright 2023 NXP
# All rights reserved.
#
# SPDX-License-Identifier: BSD-3-Clause


config MCUX_USE_BOARD_EVKMIMXRT1020
    bool "EVKMIMXRT1020"
    select MCUX_USE_SOC_MIMXRT1021
    select MCUX_SOC_PART_MIMXRT1021xxxxx
```

## boards/evkmimxrt1024/Kconfig
```kconfig
# Copyright 2023 NXP
# All rights reserved.
#
# SPDX-License-Identifier: BSD-3-Clause
if MCUX_USE_BOARD_EVKMIMXRT1024

config MCUX_BOARD
    default "evkmimxrt1024"

config MCUX_KIT
    default "evkmimxrt1024"


#### Board level drivers ####
rsource "xip/Kconfig"
rsource "cmsis_pack_flash_algo/Kconfig"

endif
```

## boards/evkmimxrt1024/Kconfig.board
```kconfig
# Copyright 2023 NXP
# All rights reserved.
#
# SPDX-License-Identifier: BSD-3-Clause


config MCUX_USE_BOARD_EVKMIMXRT1024
    bool "EVKMIMXRT1024"
    select MCUX_USE_SOC_MIMXRT1024
    select MCUX_SOC_PART_MIMXRT1024xxxxx
```

## boards/evkmimxrt1024/cmsis_pack_flash_algo/Kconfig
```kconfig
# Copyright 2023 NXP
# All rights reserved.
#
# SPDX-License-Identifier: BSD-3-Clause

# component_cmsis_pack_flash_algo_MIMXRT1024
config MCUX_USE_component_cmsis_pack_flash_algo_MIMXRT1024
    bool "cmsis_pack_flash_algo"

    help
      cmsis_pack_flash_algo
```

## boards/evkmimxrt1040/Kconfig.board
```kconfig
# Copyright 2023 NXP
# All rights reserved.
#
# SPDX-License-Identifier: BSD-3-Clause


config MCUX_USE_BOARD_EVKMIMXRT1040
    bool "EVKMIMXRT1040"
    select MCUX_USE_SOC_MIMXRT1042
    select MCUX_SOC_PART_MIMXRT1042xxxxB
```

## boards/evkmimxrt1040/xip/Kconfig
```kconfig
# Copyright 2023 NXP
# All rights reserved.
#
# SPDX-License-Identifier: BSD-3-Clause

# driver_xip_board_evkmimxrt1040
config MCUX_USE_driver_xip_board_evkmimxrt1040
    bool "XIP Board Driver"
    select MCUX_USE_driver_common
    help
      XIP Board Driver
```

## boards/evkmimxrt1060/Kconfig
```kconfig
# Copyright 2023 NXP
# All rights reserved.
#
# SPDX-License-Identifier: BSD-3-Clause
if MCUX_USE_BOARD_EVKMIMXRT1060

config MCUX_BOARD
    default "evkmimxrt1060"

config MCUX_KIT
    default "evkmimxrt1060"


#### Board level drivers ####
rsource "xip/Kconfig"

endif
```

## boards/evkmimxrt1060/Kconfig.board
```kconfig
# Copyright 2023 NXP
# All rights reserved.
#
# SPDX-License-Identifier: BSD-3-Clause


config MCUX_USE_BOARD_EVKMIMXRT1060
    bool "EVKMIMXRT1060"
    select MCUX_USE_SOC_MIMXRT1062
    select MCUX_SOC_PART_MIMXRT1062xxxxA
```

## boards/evkmimxrt1064/Kconfig
```kconfig
# Copyright 2023 NXP
# All rights reserved.
#
# SPDX-License-Identifier: BSD-3-Clause
if MCUX_USE_BOARD_EVKMIMXRT1064

config MCUX_BOARD
    default "evkmimxrt1064"

config MCUX_KIT
    default "evkmimxrt1064"


#### Board level drivers ####
rsource "xip/Kconfig"

endif
```

## boards/evkmimxrt1064/Kconfig.board
```kconfig
# Copyright 2023 NXP
# All rights reserved.
#
# SPDX-License-Identifier: BSD-3-Clause


config MCUX_USE_BOARD_EVKMIMXRT1064
    bool "EVKMIMXRT1064"
    select MCUX_USE_SOC_MIMXRT1064
    select MCUX_SOC_PART_MIMXRT1064xxxxA
```

## boards/evkmimxrt1064/xip/Kconfig
```kconfig
# Copyright 2023 NXP
# All rights reserved.
#
# SPDX-License-Identifier: BSD-3-Clause

# driver_xip_board_evkmimxrt1064
config MCUX_USE_driver_xip_board_evkmimxrt1064
    bool "XIP Board Driver"
    select MCUX_USE_driver_common
    help
      XIP Board Driver
```

## boards/evkmimxrt1160/Kconfig
```kconfig
# Copyright 2023 NXP
# All rights reserved.
#
# SPDX-License-Identifier: BSD-3-Clause
if (MCUX_USE_BOARD_EVKMIMXRT1160_CM4 || MCUX_USE_BOARD_EVKMIMXRT1160_CM7)

config MCUX_BOARD
    default "evkmimxrt1160"

config MCUX_KIT
    default "evkmimxrt1160"


#### Board level drivers ####
rsource "xip/Kconfig"
rsource "xmcd/Kconfig"

endif
```

## boards/evkmimxrt1160/Kconfig.board
```kconfig
# Copyright 2023 NXP
# All rights reserved.
#
# SPDX-License-Identifier: BSD-3-Clause


config MCUX_USE_BOARD_EVKMIMXRT1160_CM4
    bool "EVKMIMXRT1160 [CM4]"
    select MCUX_USE_SOC_MIMXRT1166_CM4
    select MCUX_SOC_PART_MIMXRT1166xxxxx

config MCUX_USE_BOARD_EVKMIMXRT1160_CM7
    bool "EVKMIMXRT1160 [CM7]"
    select MCUX_USE_SOC_MIMXRT1166_CM7
    select MCUX_SOC_PART_MIMXRT1166xxxxx
```

## boards/evkmimxrt1160/xmcd/Kconfig
```kconfig
# Copyright 2023 NXP
# All rights reserved.
#
# SPDX-License-Identifier: BSD-3-Clause

# driver_xmcd_evkmimxrt1160
config MCUX_USE_driver_xmcd_evkmimxrt1160
    bool "XMCD Driver"
    select MCUX_USE_driver_common
    help
      XMCD Driver
```

## boards/evkmimxrt1170/Kconfig
```kconfig
# Copyright 2023 NXP
# All rights reserved.
#
# SPDX-License-Identifier: BSD-3-Clause
if (MCUX_USE_BOARD_EVKMIMXRT1170_CM4 || MCUX_USE_BOARD_EVKMIMXRT1170_CM7)

config MCUX_BOARD
    default "evkmimxrt1170"

config MCUX_KIT
    default "evkmimxrt1170"


#### Board level drivers ####
rsource "xip/Kconfig"
rsource "xmcd/Kconfig"

endif
```

## boards/evkmimxrt595/Kconfig
```kconfig
# Copyright 2023 NXP
# All rights reserved.
#
# SPDX-License-Identifier: BSD-3-Clause
if (MCUX_USE_BOARD_EVKMIMXRT595_CM33)

config MCUX_BOARD
    default "evkmimxrt595"

config MCUX_KIT
    default "evkmimxrt595"


#### Board level drivers ####
rsource "flash_config/Kconfig"

endif
```

## boards/evkmimxrt595/flash_config/Kconfig
```kconfig
# Copyright 2023 NXP
# All rights reserved.
#
# SPDX-License-Identifier: BSD-3-Clause

# driver_flash_config_evkmimxrt595
config MCUX_USE_driver_flash_config_evkmimxrt595
    bool "Flash config"
    select MCUX_USE_driver_iap
    help
      flash config block
```

## boards/evkmimxrt685/Kconfig
```kconfig
# Copyright 2023 NXP
# All rights reserved.
#
# SPDX-License-Identifier: BSD-3-Clause
if (MCUX_USE_BOARD_EVKMIMXRT685_CM33)

config MCUX_BOARD
    default "evkmimxrt685"

config MCUX_KIT
    default "evkmimxrt685"


#### Board level drivers ####
rsource "flash_config/Kconfig"

endif
```

## boards/evkmimxrt685/flash_config/Kconfig
```kconfig
# Copyright 2023 NXP
# All rights reserved.
#
# SPDX-License-Identifier: BSD-3-Clause

# driver_flash_config_evkmimxrt685
config MCUX_USE_driver_flash_config_evkmimxrt685
    bool "Flash config"
    select MCUX_USE_driver_common
    help
      flash config block
```

## boards/frdmk22f/Kconfig
```kconfig
# Copyright 2023 NXP
# All rights reserved.
#
# SPDX-License-Identifier: BSD-3-Clause
if MCUX_USE_BOARD_FRDMK22F

config MCUX_BOARD
    default "frdmk22f"

config MCUX_KIT
    default "frdmk22f"


#### Board level drivers ####

endif
```

## boards/frdmk22f/Kconfig.board
```kconfig
# Copyright 2023 NXP
# All rights reserved.
#
# SPDX-License-Identifier: BSD-3-Clause


config MCUX_USE_BOARD_FRDMK22F
    bool "FRDMK22F"
    select MCUX_USE_SOC_MK22F51212
    select MCUX_SOC_PART_MK22FN512xxx12
```

## boards/frdmk32l2a4s/Kconfig
```kconfig
# Copyright 2023 NXP
# All rights reserved.
#
# SPDX-License-Identifier: BSD-3-Clause
if MCUX_USE_BOARD_FRDMK32L2A4S

config MCUX_BOARD
    default "frdmk32l2a4s"

config MCUX_KIT
    default "frdmk32l2a4s"


#### Board level drivers ####

endif
```

## boards/frdmk32l2a4s/Kconfig.board
```kconfig
# Copyright 2023 NXP
# All rights reserved.
#
# SPDX-License-Identifier: BSD-3-Clause


config MCUX_USE_BOARD_FRDMK32L2A4S
    bool "FRDMK32L2A4S"
    select MCUX_USE_SOC_K32L2A41A
    select MCUX_SOC_PART_K32L2A41xxxxA
```
