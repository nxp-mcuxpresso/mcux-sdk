## components/lists/Kconfig
```kconfig
# Copyright 2023 NXP
# All rights reserved.
#
# SPDX-License-Identifier: BSD-3-Clause

# component_lists
config MCUX_HAS_component_lists
    bool

config MCUX_USE_component_lists
    depends on MCUX_HAS_component_lists
    bool "Component lists"
    select MCUX_USE_driver_common
    help
      Component lists
```

## components/serial_manager/Kconfig
```kconfig
# Copyright 2023 NXP
# All rights reserved.
#
# SPDX-License-Identifier: BSD-3-Clause

config MCUX_HAS_component_serial_manager
    bool

config MCUX_HAS_component_serial_manager_uart
    bool

config MCUX_HAS_component_serial_manager_spi
    bool

config MCUX_HAS_component_serial_manager_swo
    bool

menuconfig MCUX_USE_component_serial_manager
    depends on MCUX_HAS_component_serial_manager
    bool "Serial Manager"
    select MCUX_USE_driver_common
    select MCUX_USE_component_lists

    help
      Component serial_manager


if MCUX_USE_component_serial_manager

# component_serial_manager_uart
menuconfig MCUX_USE_component_serial_manager_uart
    depends on MCUX_HAS_component_serial_manager_uart
    bool "Serial Manager uart"

    help
      Component serial_manager_uart

    if MCUX_USE_component_serial_manager_uart

    config MCUX_component_serial_manager_uart_USE_flexcomm_usart
        depends on MCUX_HAS_driver_flexcomm_usart
        bool "Use flexcomm_usart"
        select MCUX_USE_driver_flexcomm_usart

    config MCUX_component_serial_manager_uart_USE_lpsci
        depends on MCUX_HAS_driver_lpsci
        bool "Use lpsci"
        select MCUX_USE_driver_lpsci

    config MCUX_component_serial_manager_uart_USE_lpuart
        depends on MCUX_HAS_driver_lpuart
        bool "Use lpuart"
        select MCUX_USE_driver_lpuart

    config MCUX_component_serial_manager_uart_USE_uart
        depends on MCUX_HAS_driver_uart
        bool "Use uart"
        select MCUX_USE_driver_uart

    config MCUX_component_serial_manager_uart_USE_iuart
        depends on MCUX_HAS_driver_iuart
        bool "Use iuart"
        select MCUX_USE_driver_iuart

    config MCUX_component_serial_manager_uart_USE_vusart
        depends on MCUX_HAS_driver_vusart
        bool "Use vusart"
        select MCUX_USE_driver_vusart

    config MCUX_component_serial_manager_uart_USE_lpc_miniusart
        depends on MCUX_HAS_driver_lpc_miniusart
        bool "Use lpc_miniusart"
        select MCUX_USE_driver_lpc_miniusart

    config MCUX_component_serial_manager_uart_USE_qsci
        depends on MCUX_HAS_driver_qsci
        bool "Use qsci"
        select MCUX_USE_driver_qsci

    endif # MCUX_USE_component_serial_manager_uart


menuconfig MCUX_USE_component_serial_manager_spi
    depends on MCUX_HAS_component_serial_manager_spi
    bool "Serial Manager SPI"

    if MCUX_USE_component_serial_manager_spi
    config MCUX_component_serial_manager_spi_USE_dspi
    depends on (MCUX_HAS_driver_dspi && MCUX_HAS_component_dspi_adapter)
    bool "Use DSPI"
    select MCUX_USE_driver_dspi
    select MCUX_USE_component_dspi_adapter

    config MCUX_component_serial_manager_spi_USE_flexcomm_spi
    depends on (MCUX_HAS_driver_flexcomm_spi && MCUX_HAS_component_flexcomm_spi_adapter)
    bool "Use Flexcomm SPI"
    select MCUX_USE_driver_flexcomm_spi
    select MCUX_USE_component_flexcomm_spi_adapter

    config MCUX_component_serial_manager_spi_USE_lpspi
    depends on (MCUX_HAS_driver_lpspi && MCUX_HAS_component_lpspi_adapter)
    bool "Use LPSPI"
    select MCUX_USE_driver_lpspi
    select MCUX_USE_component_lpspi_adapter

    config MCUX_component_serial_manager_spi_USE_spi
    depends on (MCUX_HAS_driver_spi && MCUX_HAS_component_spi_adapter)
    bool "Use SPI"
    select MCUX_USE_driver_spi
    select MCUX_USE_component_spi_adapter

    endif # MCUX_USE_component_serial_manager_spi

# component_serial_manager_swo
config MCUX_USE_component_serial_manager_swo
    depends on MCUX_HAS_component_serial_manager_swo
    bool "Serial Manager Swo"
    select MCUX_USE_driver_common
    help
      Component serial_manager_swo

endif
```

## components/spi/Kconfig
```kconfig
# Copyright 2023 NXP
# All rights reserved.
#
# SPDX-License-Identifier: BSD-3-Clause

# component_dspi_adapter
config MCUX_HAS_component_dspi_adapter
    bool

config MCUX_USE_component_dspi_adapter
    depends on MCUX_HAS_component_dspi_adapter
    bool "Component dspi_adapter"
    select MCUX_USE_driver_common
    select MCUX_USE_driver_dspi
    help
      Component dspi_adapter

# component_flexcomm_spi_adapter
config MCUX_HAS_component_flexcomm_spi_adapter
    bool

config MCUX_USE_component_flexcomm_spi_adapter
    depends on MCUX_HAS_component_flexcomm_spi_adapter
    bool "Component flexcomm_spi_adapter"
    select MCUX_USE_driver_common
    select MCUX_USE_driver_flexcomm_spi
    help
      Component flexcomm_spi_adapter

# component_lpspi_adapter
config MCUX_HAS_component_lpspi_adapter
    bool

config MCUX_USE_component_lpspi_adapter
    depends on MCUX_HAS_component_lpspi_adapter
    bool "Component lpspi_adapter"
    select MCUX_USE_driver_common
    select MCUX_USE_driver_lpspi
    help
      Component lpspi_adapter

# component_spi_adapter
config MCUX_HAS_component_spi_adapter
    bool

config MCUX_USE_component_spi_adapter
    depends on MCUX_HAS_component_spi_adapter
    bool "Component spi_adapter"
    select MCUX_USE_driver_common
    select MCUX_USE_driver_spi
    help
      Component spi_adapter
```

## components/timer/Kconfig
```kconfig
# Copyright 2023 NXP
# All rights reserved.
#
# SPDX-License-Identifier: BSD-3-Clause

# component_ctimer_adapter
config MCUX_HAS_component_ctimer_adapter
    bool

config MCUX_USE_component_ctimer_adapter
    depends on MCUX_HAS_component_ctimer_adapter
    bool "Component ctimer_adapter"
    select MCUX_USE_driver_common
    select MCUX_USE_driver_ctimer
    help
      Component ctimer_adapter

# component_ftm_adapter
config MCUX_HAS_component_ftm_adapter
    bool

config MCUX_USE_component_ftm_adapter
    depends on MCUX_HAS_component_ftm_adapter
    bool "Component ftm_adapter"
    select MCUX_USE_driver_common
    select MCUX_USE_driver_ftm
    help
      Component ftm_adapter

# component_gpt_adapter
config MCUX_HAS_component_gpt_adapter
    bool

config MCUX_USE_component_gpt_adapter
    depends on MCUX_HAS_component_gpt_adapter
    bool "Component gpt_adapter"
    select MCUX_USE_driver_common
    select MCUX_USE_driver_gpt
    help
      Component gpt_adapter

# component_lpit_adapter
config MCUX_HAS_component_lpit_adapter
    bool

config MCUX_USE_component_lpit_adapter
    depends on MCUX_HAS_component_lpit_adapter
    bool "Component lpit_adapter"
    select MCUX_USE_driver_common
    select MCUX_USE_driver_lpit
    help
      Component lpit_adapter

# component_lptmr_adapter
config MCUX_HAS_component_lptmr_adapter
    bool

config MCUX_USE_component_lptmr_adapter
    depends on MCUX_HAS_component_lptmr_adapter
    bool "Component lptmr_adapter"
    select MCUX_USE_driver_common
    select MCUX_USE_driver_lptmr
    help
      Component lptmr_adapter

# component_mrt_adapter
config MCUX_HAS_component_mrt_adapter
    bool

config MCUX_USE_component_mrt_adapter
    depends on MCUX_HAS_component_mrt_adapter
    bool "Component mrt_adapter"
    select MCUX_USE_driver_common
    select MCUX_USE_driver_mrt
    help
      Component mrt_adapter

# component_pit_adapter
config MCUX_HAS_component_pit_adapter
    bool

config MCUX_USE_component_pit_adapter
    depends on MCUX_HAS_component_pit_adapter
    bool "Component pit_adapter"
    select MCUX_USE_driver_common
    select MCUX_USE_driver_pit
    help
      Component pit_adapter

# component_tpm_adapter
config MCUX_HAS_component_tpm_adapter
    bool

config MCUX_USE_component_tpm_adapter
    depends on MCUX_HAS_component_tpm_adapter
    bool "Component tpm_adapter"
    select MCUX_USE_driver_common
    select MCUX_USE_driver_tpm
    help
      Component tpm_adapter

# component_ostimer_adapter
config MCUX_HAS_component_ostimer_adapter
    bool

config MCUX_USE_component_ostimer_adapter
    depends on MCUX_HAS_component_ostimer_adapter
    bool "Component ostimer_adapter"
    select MCUX_USE_driver_common
    select MCUX_USE_driver_ostimer
    help
      Component ostimer_adapter
```

## components/uart/Kconfig
```kconfig
# Copyright 2023 NXP
# All rights reserved.
#
# SPDX-License-Identifier: BSD-3-Clause

# component_iuart_adapter
config MCUX_HAS_component_iuart_adapter
    bool

config MCUX_USE_component_iuart_adapter
    depends on MCUX_HAS_component_iuart_adapter
    bool "iuart_adapter"
    select MCUX_USE_driver_common
    select MCUX_USE_driver_iuart
    help
      Component iuart_adapter

# component_lpuart_adapter
config MCUX_HAS_component_lpuart_adapter
    bool

config MCUX_USE_component_lpuart_adapter
    depends on MCUX_HAS_component_lpuart_adapter
    bool "lpuart_adapter"
    select MCUX_USE_driver_common
    select MCUX_USE_driver_lpuart
    help
      Component lpuart_adapter

# component_lpuart_dma_adapter
config MCUX_HAS_component_lpuart_dma_adapter
    bool

menuconfig MCUX_USE_component_lpuart_dma_adapter
    depends on MCUX_HAS_component_lpuart_dma_adapter
    bool "lpuart_dma_adapter"
    select MCUX_USE_component_lpuart_adapter
    select MCUX_USE_component_timer_manager

    help
      Component lpuart_dma_adapter

    if MCUX_USE_component_lpuart_dma_adapter

    config MCUX_component_lpuart_dma_adapter_USE_lpuart_edma
        depends on MCUX_HAS_driver_lpuart_edma
        bool "Use lpuart_edma"
        select MCUX_USE_driver_lpuart_edma

    config MCUX_component_lpuart_dma_adapter_USE_lpuart_dma
        depends on MCUX_HAS_driver_lpuart_dma
        bool "Use lpuart_dma"
        select MCUX_USE_driver_lpuart_dma

    endif # MCUX_USE_component_lpuart_dma_adapter

# component_miniusart_adapter
config MCUX_HAS_component_miniusart_adapter
    bool

config MCUX_USE_component_miniusart_adapter
    depends on MCUX_HAS_component_miniusart_adapter
    bool "miniusart_adapter"
    select MCUX_USE_driver_common
    select MCUX_USE_driver_lpc_miniusart
    help
      Component miniusart_adapter

# component_uart_adapter
config MCUX_HAS_component_uart_adapter
    bool

config MCUX_USE_component_uart_adapter
    depends on MCUX_HAS_component_uart_adapter
    bool "uart_adapter"
    select MCUX_USE_driver_common
    select MCUX_USE_driver_uart
    help
      Component uart_adapter

# component_usart_adapter
config MCUX_HAS_component_usart_adapter
    bool

config MCUX_USE_component_usart_adapter
    depends on MCUX_HAS_component_usart_adapter
    bool "usart_adapter"
    select MCUX_USE_driver_common
    select MCUX_USE_driver_flexcomm_usart
    select MCUX_USE_driver_flexcomm
    help
      Component usart_adapter

# component_usart_dma_adapter
config MCUX_HAS_component_usart_dma_adapter
    bool

config MCUX_USE_component_usart_dma_adapter
    depends on MCUX_HAS_component_usart_dma_adapter
    bool "usart_dma_adapter"
    select MCUX_USE_component_usart_adapter
    select MCUX_USE_component_timer_manager
    select MCUX_USE_driver_flexcomm_usart_dma
    help
      Component usart_dma_adapter
```

## devices/K32L2A41A/drivers/Kconfig
```kconfig
# Copyright 2023 NXP
# All rights reserved.
#
# SPDX-License-Identifier: BSD-3-Clause

# driver_clock
config MCUX_USE_driver_clock
    bool "Clock Driver"
    select MCUX_USE_driver_common
    help
      Clock Driver
```
