## cmsis_drivers/i2c/Kconfig
```kconfig
# Copyright 2023 NXP
# All rights reserved.
#
# SPDX-License-Identifier: BSD-3-Clause

# driver_cmsis_i2c
config MCUX_HAS_driver_cmsis_i2c
    bool

config MCUX_USE_driver_cmsis_i2c
    depends on MCUX_HAS_driver_cmsis_i2c
    bool "I2C CMSIS Driver"
    select MCUX_USE_driver_i2c
    select MCUX_USE_CMSIS_Driver_Include_I2C
    select MCUX_USE_RTE_Device
    help
      I2C CMSIS Driver
```

## cmsis_drivers/iuart/Kconfig
```kconfig
# Copyright 2023 NXP
# All rights reserved.
#
# SPDX-License-Identifier: BSD-3-Clause

# driver_cmsis_iuart
config MCUX_HAS_driver_cmsis_iuart
    bool

config MCUX_USE_driver_cmsis_iuart
    depends on MCUX_HAS_driver_cmsis_iuart
    bool "IUART CMSIS Driver"
    select MCUX_USE_driver_iuart
    select MCUX_USE_CMSIS_Driver_Include_USART
    select MCUX_USE_RTE_Device
    help
      UART CMSIS Driver
```

## cmsis_drivers/lpi2c/Kconfig
```kconfig
# Copyright 2023 NXP
# All rights reserved.
#
# SPDX-License-Identifier: BSD-3-Clause

# driver_cmsis_lpi2c
config MCUX_HAS_driver_cmsis_lpi2c
    bool

config MCUX_USE_driver_cmsis_lpi2c
    depends on MCUX_HAS_driver_cmsis_lpi2c
    bool "LPI2C CMSIS Driver"
    select MCUX_USE_driver_lpi2c
    select MCUX_USE_CMSIS_Driver_Include_I2C
    select MCUX_USE_RTE_Device
    help
      LPI2C CMSIS Driver
```

## cmsis_drivers/lpspi/Kconfig
```kconfig
# Copyright 2023 NXP
# All rights reserved.
#
# SPDX-License-Identifier: BSD-3-Clause

# driver_cmsis_lpspi
config MCUX_HAS_driver_cmsis_lpspi
    bool

config MCUX_USE_driver_cmsis_lpspi
    depends on MCUX_HAS_driver_cmsis_lpspi
    bool "LPSPI CMSIS Driver"
    select MCUX_USE_driver_lpspi
    select MCUX_USE_CMSIS_Driver_Include_SPI
    select MCUX_USE_RTE_Device
    help
      LPSPI CMSIS Driver
```

## cmsis_drivers/lpuart/Kconfig
```kconfig
# Copyright 2023 NXP
# All rights reserved.
#
# SPDX-License-Identifier: BSD-3-Clause

# driver_cmsis_lpuart
config MCUX_HAS_driver_cmsis_lpuart
    bool

config MCUX_USE_driver_cmsis_lpuart
    depends on MCUX_HAS_driver_cmsis_lpuart
    bool "LPUART CMSIS Driver"
    select MCUX_USE_driver_lpuart
    select MCUX_USE_CMSIS_Driver_Include_USART
    select MCUX_USE_RTE_Device
    help
      LPUART CMSIS Driver
```

## cmsis_drivers/spi/Kconfig
```kconfig
# Copyright 2023 NXP
# All rights reserved.
#
# SPDX-License-Identifier: BSD-3-Clause

# driver_cmsis_spi
config MCUX_HAS_driver_cmsis_spi
    bool

config MCUX_USE_driver_cmsis_spi
    depends on MCUX_HAS_driver_cmsis_spi
    bool "SPI CMSIS Driver"
    select MCUX_USE_driver_spi
    select MCUX_USE_CMSIS_Driver_Include_SPI
    select MCUX_USE_RTE_Device
    help
      SPI CMSIS Driver
```

## cmsis_drivers/uart/Kconfig
```kconfig
# Copyright 2023 NXP
# All rights reserved.
#
# SPDX-License-Identifier: BSD-3-Clause

# driver_cmsis_uart
config MCUX_HAS_driver_cmsis_uart
    bool

config MCUX_USE_driver_cmsis_uart
    depends on MCUX_HAS_driver_cmsis_uart
    bool "UART CMSIS Driver"
    select MCUX_USE_driver_uart
    select MCUX_USE_CMSIS_Driver_Include_USART
    select MCUX_USE_RTE_Device
    help
      UART CMSIS Driver
```

## components/Kconfig
```kconfig
# Copyright 2023 NXP
# All rights reserved.
#
# SPDX-License-Identifier: BSD-3-Clause

menu "Components Configuration"

rsource "./*/Kconfig"

endmenu
```

## components/gpio/Kconfig
```kconfig
# Copyright 2023 NXP
# All rights reserved.
#
# SPDX-License-Identifier: BSD-3-Clause

# component_gpio_adapter
config MCUX_HAS_component_gpio_adapter
    bool

config MCUX_USE_component_gpio_adapter
    depends on MCUX_HAS_component_gpio_adapter
    bool "Component gpio_adapter"
    select MCUX_USE_driver_gpio
    select MCUX_USE_driver_port
    help
      Component gpio_adapter

# component_lpc_gpio_adapter
config MCUX_HAS_component_lpc_gpio_adapter
    bool

config MCUX_USE_component_lpc_gpio_adapter
    depends on MCUX_HAS_component_lpc_gpio_adapter
    bool "Component lpc_gpio_adapter"
    select MCUX_USE_driver_lpc_gpio
    select MCUX_USE_driver_inputmux
    select MCUX_USE_driver_pint
    help
      Component lpc_gpio_adapter

# component_igpio_adapter
config MCUX_HAS_component_igpio_adapter
    bool

config MCUX_USE_component_igpio_adapter
    depends on MCUX_HAS_component_igpio_adapter
    bool "Component igpio_adapter"
    select MCUX_USE_driver_igpio
    help
      Component igpio_adapter

# component_gint_adapter
config MCUX_HAS_component_gint_adapter
    bool

config MCUX_USE_component_gint_adapter
    depends on MCUX_HAS_component_gint_adapter
    bool "Component gint_adapter"
    select MCUX_USE_driver_gint
    help
      Component gint_adapter

# component_rt_gpio_adapter
config MCUX_HAS_component_rt_gpio_adapter
    bool

config MCUX_USE_component_rt_gpio_adapter
    depends on MCUX_HAS_component_rt_gpio_adapter
    bool "Component rt_gpio_adapter"
    select MCUX_USE_driver_lpc_gpio
    help
      Component rt_gpio_adapter
```

## components/i2c/Kconfig
```kconfig
# Copyright 2023 NXP
# All rights reserved.
#
# SPDX-License-Identifier: BSD-3-Clause

# component_flexcomm_i2c_adapter
config MCUX_HAS_component_flexcomm_i2c_adapter
    bool

config MCUX_USE_component_flexcomm_i2c_adapter
    depends on MCUX_HAS_component_flexcomm_i2c_adapter
    bool "Component flexcomm_i2c_adapter"
    select MCUX_USE_driver_common
    select MCUX_USE_driver_flexcomm_i2c
    help
      Component flexcomm_i2c_adapter

# component_i2c_adapter
config MCUX_HAS_component_i2c_adapter
    bool

config MCUX_USE_component_i2c_adapter
    depends on MCUX_HAS_component_i2c_adapter
    bool "Component i2c_adapter"
    select MCUX_USE_driver_common
    select MCUX_USE_driver_i2c
    help
      Component i2c_adapter

# component_ii2c_adapter
config MCUX_HAS_component_ii2c_adapter
    bool

config MCUX_USE_component_ii2c_adapter
    depends on MCUX_HAS_component_ii2c_adapter
    bool "Component ii2c_adapter"
    select MCUX_USE_driver_common
    select MCUX_USE_driver_ii2c
    help
      Component ii2c_adapter

# component_lpc_i2c_adapter
config MCUX_HAS_component_lpc_i2c_adapter
    bool

config MCUX_USE_component_lpc_i2c_adapter
    depends on MCUX_HAS_component_lpc_i2c_adapter
    bool "Component lpc_i2c_adapter"
    select MCUX_USE_driver_common
    select MCUX_USE_driver_lpc_i2c
    help
      Component lpc_i2c_adapter

# component_lpi2c_adapter
config MCUX_HAS_component_lpi2c_adapter
    bool

config MCUX_USE_component_lpi2c_adapter
    depends on MCUX_HAS_component_lpi2c_adapter
    bool "Component lpi2c_adapter"
    select MCUX_USE_driver_common
    select MCUX_USE_driver_lpi2c
    help
      Component lpi2c_adapter

# component_i3c_adapter
config MCUX_HAS_component_i3c_adapter
    bool

config MCUX_USE_component_i3c_adapter
    depends on MCUX_HAS_component_i3c_adapter
    bool "Component i3c_adapter"
    select MCUX_USE_driver_common
    select MCUX_USE_driver_i3c
    help
      Component i3c_adapter
```
