## drivers/dac/Kconfig
```kconfig
# Copyright 2023 NXP
# All rights reserved.
#
# SPDX-License-Identifier: BSD-3-Clause

# driver_dac
config MCUX_HAS_driver_dac
    bool

config MCUX_USE_driver_dac
    depends on MCUX_HAS_driver_dac
    bool "DAC Driver"
    select MCUX_USE_driver_common
    help
      DAC Driver
```

## drivers/dac12/Kconfig
```kconfig
# Copyright 2023 NXP
# All rights reserved.
#
# SPDX-License-Identifier: BSD-3-Clause

# driver_dac12
config MCUX_HAS_driver_dac12
    bool

config MCUX_USE_driver_dac12
    depends on MCUX_HAS_driver_dac12
    bool "DAC12 Driver"
    select MCUX_USE_driver_common
    help
      DAC12 Driver
```

## drivers/dac_1/Kconfig
```kconfig
# Copyright 2023 NXP
# All rights reserved.
#
# SPDX-License-Identifier: BSD-3-Clause

# driver_dac_1
config MCUX_HAS_driver_dac_1
    bool

config MCUX_USE_driver_dac_1
    depends on MCUX_HAS_driver_dac_1
    bool "DAC Driver"
    select MCUX_USE_driver_common
    help
      DAC Driver
```

## drivers/dcdc_1/Kconfig
```kconfig
# Copyright 2023 NXP
# All rights reserved.
#
# SPDX-License-Identifier: BSD-3-Clause

# driver_dcdc_1
config MCUX_HAS_driver_dcdc_1
    bool

config MCUX_USE_driver_dcdc_1
    depends on MCUX_HAS_driver_dcdc_1
    bool "DCDC Driver"
    select MCUX_USE_driver_common
    help
      DCDC Driver
```

## drivers/dcic/Kconfig
```kconfig
# Copyright 2023 NXP
# All rights reserved.
#
# SPDX-License-Identifier: BSD-3-Clause

# driver_dcic
config MCUX_HAS_driver_dcic
    bool

config MCUX_USE_driver_dcic
    depends on MCUX_HAS_driver_dcic
    bool "DCIC Driver"
    select MCUX_USE_driver_common
    help
      DCIC Driver
```

## drivers/dcp/Kconfig
```kconfig
# Copyright 2023 NXP
# All rights reserved.
#
# SPDX-License-Identifier: BSD-3-Clause

# driver_dcp
config MCUX_HAS_driver_dcp
    bool

config MCUX_USE_driver_dcp
    depends on MCUX_HAS_driver_dcp
    bool "DCP Driver"
    select MCUX_USE_driver_common
    help
      DCP Driver
```

## drivers/dma/Kconfig
```kconfig
# Copyright 2023 NXP
# All rights reserved.
#
# SPDX-License-Identifier: BSD-3-Clause

# driver_dma
config MCUX_HAS_driver_dma
    bool

config MCUX_USE_driver_dma
    depends on MCUX_HAS_driver_dma
    bool "DMA Driver"
    select MCUX_USE_driver_dmamux
    select MCUX_USE_driver_common
    help
      DMA Driver
```

## drivers/dmamux/Kconfig
```kconfig
# Copyright 2023 NXP
# All rights reserved.
#
# SPDX-License-Identifier: BSD-3-Clause

# driver_dmamux
config MCUX_HAS_driver_dmamux
    bool

config MCUX_USE_driver_dmamux
    depends on MCUX_HAS_driver_dmamux
    bool "DMAMUX Driver"
    select MCUX_USE_driver_common
    help
      DMAMUX Driver
```

## drivers/dmic/Kconfig
```kconfig
# Copyright 2023 NXP
# All rights reserved.
#
# SPDX-License-Identifier: BSD-3-Clause

# driver_dmic
config MCUX_HAS_driver_dmic
    bool

config MCUX_USE_driver_dmic
    depends on MCUX_HAS_driver_dmic
    bool "DMIC Driver"
    select MCUX_USE_driver_common
    help
      DMIC Driver

# driver_dmic_hwvad
config MCUX_HAS_driver_dmic_hwvad
    bool

config MCUX_USE_driver_dmic_hwvad
    depends on MCUX_HAS_driver_dmic_hwvad
    bool "DMIC HWVAD Driver"
    select MCUX_USE_driver_dmic
    select MCUX_USE_driver_common
    help
      DMIC HWVAD Driver

# driver_dmic_dma
config MCUX_HAS_driver_dmic_dma
    bool

config MCUX_USE_driver_dmic_dma
    depends on MCUX_HAS_driver_dmic_dma
    bool "DMIC DMA Driver"
    select MCUX_USE_driver_dmic
    help
      DMIC DMA Driver
```

## drivers/dspi/Kconfig
```kconfig
# Copyright 2023 NXP
# All rights reserved.
#
# SPDX-License-Identifier: BSD-3-Clause

# driver_dspi_edma
config MCUX_HAS_driver_dspi_edma
    bool

config MCUX_USE_driver_dspi_edma
    depends on MCUX_HAS_driver_dspi_edma
    bool "DSPI_EDMA Driver"
    select MCUX_USE_driver_dspi
    help
      DSPI Driver

# driver_dspi
config MCUX_HAS_driver_dspi
    bool

config MCUX_USE_driver_dspi
    depends on MCUX_HAS_driver_dspi
    bool "DSPI Driver"
    select MCUX_USE_driver_common
    help
      DSPI Driver
```

## drivers/easrc/Kconfig
```kconfig
# Copyright 2023 NXP
# All rights reserved.
#
# SPDX-License-Identifier: BSD-3-Clause

# driver_easrc_sdma
config MCUX_HAS_driver_easrc_sdma
    bool

config MCUX_USE_driver_easrc_sdma
    depends on MCUX_HAS_driver_easrc_sdma
    bool "asrc_m2m_sdma Driver"
    select MCUX_USE_driver_easrc
    select MCUX_USE_driver_sdma
    select MCUX_USE_driver_common
    help
      asrc_sdma Driver

# driver_easrc
config MCUX_HAS_driver_easrc
    bool

config MCUX_USE_driver_easrc
    depends on MCUX_HAS_driver_easrc
    bool "asrc Driver"
    select MCUX_USE_driver_common
    help
      asrc Driver
```

## drivers/ecspi/Kconfig
```kconfig
# Copyright 2023 NXP
# All rights reserved.
#
# SPDX-License-Identifier: BSD-3-Clause

# driver_ecspi_sdma
config MCUX_HAS_driver_ecspi_sdma
    bool

config MCUX_USE_driver_ecspi_sdma
    depends on MCUX_HAS_driver_ecspi_sdma
    bool "ECSPI SDMA Driver"
    select MCUX_USE_driver_ecspi
    help
      ECSPI SDMA Driver

# driver_ecspi
config MCUX_HAS_driver_ecspi
    bool

config MCUX_USE_driver_ecspi
    depends on MCUX_HAS_driver_ecspi
    bool "ECSPI Driver"
    select MCUX_USE_driver_common
    help
      ECSPI Driver
```

## drivers/edma/Kconfig
```kconfig
# Copyright 2023 NXP
# All rights reserved.
#
# SPDX-License-Identifier: BSD-3-Clause

# driver_edma
config MCUX_HAS_driver_edma
    bool

config MCUX_USE_driver_edma
    depends on MCUX_HAS_driver_edma
    bool "EDMA Driver"
    select MCUX_USE_driver_common
    select MCUX_USE_driver_dmamux
    help
      EDMA Driver
```

## drivers/eeprom/Kconfig
```kconfig
# Copyright 2023 NXP
# All rights reserved.
#
# SPDX-License-Identifier: BSD-3-Clause

# driver_eeprom
config MCUX_HAS_driver_eeprom
    bool

config MCUX_USE_driver_eeprom
    depends on MCUX_HAS_driver_eeprom
    bool "eeprom Driver"
    select MCUX_USE_driver_common
    help
      eeprom Driver
```

## drivers/elcdif/Kconfig
```kconfig
# Copyright 2023 NXP
# All rights reserved.
#
# SPDX-License-Identifier: BSD-3-Clause

# driver_elcdif
config MCUX_HAS_driver_elcdif
    bool

config MCUX_USE_driver_elcdif
    depends on MCUX_HAS_driver_elcdif
    bool "ELCDIF Driver"
    select MCUX_USE_driver_common
    help
      ELCDIF Driver
```

## drivers/enc/Kconfig
```kconfig
# Copyright 2023 NXP
# All rights reserved.
#
# SPDX-License-Identifier: BSD-3-Clause

# driver_enc
config MCUX_HAS_driver_enc
    bool

config MCUX_USE_driver_enc
    depends on MCUX_HAS_driver_enc
    bool "ENC Driver"
    select MCUX_USE_driver_common
    help
      ENC Driver
```

## drivers/enet/Kconfig
```kconfig
# Copyright 2023 NXP
# All rights reserved.
#
# SPDX-License-Identifier: BSD-3-Clause

# driver_enet
config MCUX_HAS_driver_enet
    bool

config MCUX_USE_driver_enet
    depends on MCUX_HAS_driver_enet
    bool "ENET Driver"
    select MCUX_USE_driver_common
    help
      ENET Driver
```

## drivers/enet_qos/Kconfig
```kconfig
# Copyright 2023 NXP
# All rights reserved.
#
# SPDX-License-Identifier: BSD-3-Clause

# driver_enet_qos
config MCUX_HAS_driver_enet_qos
    bool

config MCUX_USE_driver_enet_qos
    depends on MCUX_HAS_driver_enet_qos
    bool "ENET QoS Driver"
    select MCUX_USE_driver_common
    help
      ENET QoS Driver
```

## drivers/ewm/Kconfig
```kconfig
# Copyright 2023 NXP
# All rights reserved.
#
# SPDX-License-Identifier: BSD-3-Clause

# driver_ewm
config MCUX_HAS_driver_ewm
    bool

config MCUX_USE_driver_ewm
    depends on MCUX_HAS_driver_ewm
    bool "EWM Driver"
    select MCUX_USE_driver_common
    help
      EWM Driver
```

## drivers/flash/Kconfig
```kconfig
# Copyright 2023 NXP
# All rights reserved.
#
# SPDX-License-Identifier: BSD-3-Clause

# driver_flash
config MCUX_HAS_driver_flash
    bool

config MCUX_USE_driver_flash
    depends on MCUX_HAS_driver_flash
    bool "Flash Driver"
    select MCUX_USE_driver_common
    help
      Flash Driver
```

## drivers/flash_ftmr/Kconfig
```kconfig
# Copyright 2023 NXP
# All rights reserved.
#
# SPDX-License-Identifier: BSD-3-Clause

# driver_flash_ftmr
config MCUX_HAS_driver_flash_ftmr
    bool

config MCUX_USE_driver_flash_ftmr
    depends on MCUX_HAS_driver_flash_ftmr
    bool "Flash Driver"
    select MCUX_USE_driver_common
    help
      Flash Driver
```

## drivers/flashiap/Kconfig
```kconfig
# Copyright 2023 NXP
# All rights reserved.
#
# SPDX-License-Identifier: BSD-3-Clause

# driver_flashiap
config MCUX_HAS_driver_flashiap
    bool

config MCUX_USE_driver_flashiap
    depends on MCUX_HAS_driver_flashiap
    bool "FLASHIAP Driver"
    select MCUX_USE_driver_common
    help
      FLASHIAP Driver
```

## drivers/flexbus/Kconfig
```kconfig
# Copyright 2023 NXP
# All rights reserved.
#
# SPDX-License-Identifier: BSD-3-Clause

# driver_flexbus
config MCUX_HAS_driver_flexbus
    bool

config MCUX_USE_driver_flexbus
    depends on MCUX_HAS_driver_flexbus
    bool "FLEXBUS Driver"
    select MCUX_USE_driver_common
    help
      FLEXBUS Driver
```

## drivers/flexcan/Kconfig
```kconfig
# Copyright 2023 NXP
# All rights reserved.
#
# SPDX-License-Identifier: BSD-3-Clause

# driver_flexcan
config MCUX_HAS_driver_flexcan
    bool

config MCUX_USE_driver_flexcan
    depends on MCUX_HAS_driver_flexcan
    bool "FLEXCAN Driver"
    select MCUX_USE_driver_common
    help
      FLEXCAN Driver

# driver_flexcan_edma
config MCUX_HAS_driver_flexcan_edma
    bool

config MCUX_USE_driver_flexcan_edma
    depends on MCUX_HAS_driver_flexcan_edma
    bool "FLEXCAN EDMA Driver"
    select MCUX_USE_driver_flexcan
    help
      FLEXCAN Driver
```

## drivers/flexcomm/Kconfig
```kconfig
# Copyright 2023 NXP
# All rights reserved.
#
# SPDX-License-Identifier: BSD-3-Clause

# driver_flexcomm
config MCUX_HAS_driver_flexcomm
    bool

config MCUX_USE_driver_flexcomm
    depends on MCUX_HAS_driver_flexcomm
    bool "FLEXCOMM Driver"
    select MCUX_USE_driver_common
    help
      FLEXCOMM Driver

rsource "./i2c/Kconfig"
rsource "./i2s/Kconfig"
rsource "./spi/Kconfig"
rsource "./usart/Kconfig"
```
