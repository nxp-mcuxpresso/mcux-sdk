## drivers/iap/Kconfig
```kconfig
# Copyright 2023 NXP
# All rights reserved.
#
# SPDX-License-Identifier: BSD-3-Clause

# driver_iap
config MCUX_HAS_driver_iap
    bool

config MCUX_USE_driver_iap
    depends on MCUX_HAS_driver_iap
    bool "IAP Driver"
    select MCUX_USE_driver_common
    help
      IAP Driver
```

## drivers/iap1/Kconfig
```kconfig
# Copyright 2023 NXP
# All rights reserved.
#
# SPDX-License-Identifier: BSD-3-Clause

# driver_iap1
config MCUX_HAS_driver_iap1
    bool

config MCUX_USE_driver_iap1
    depends on MCUX_HAS_driver_iap1
    bool "IAP Driver"
    select MCUX_USE_driver_common
    help
      FLASHIAP Driver
```

## drivers/iee/Kconfig
```kconfig
# Copyright 2023 NXP
# All rights reserved.
#
# SPDX-License-Identifier: BSD-3-Clause

# driver_iee
config MCUX_HAS_driver_iee
    bool

config MCUX_USE_driver_iee
    depends on MCUX_HAS_driver_iee
    bool "IEE Driver"
    select MCUX_USE_driver_common
    help
      IEE Driver
```

## drivers/iee_apc/Kconfig
```kconfig
# Copyright 2023 NXP
# All rights reserved.
#
# SPDX-License-Identifier: BSD-3-Clause

# driver_iee_apc
config MCUX_HAS_driver_iee_apc
    bool

config MCUX_USE_driver_iee_apc
    depends on MCUX_HAS_driver_iee_apc
    bool "IEE APC Driver"
    select MCUX_USE_driver_common
    help
      IEE APC Driver
```

## drivers/igpio/Kconfig
```kconfig
# Copyright 2023 NXP
# All rights reserved.
#
# SPDX-License-Identifier: BSD-3-Clause

# driver_igpio
config MCUX_HAS_driver_igpio
    bool

config MCUX_USE_driver_igpio
    depends on MCUX_HAS_driver_igpio
    bool "igpio"
    select MCUX_USE_driver_common
    help
      GPIO Driver
```

## drivers/ii2c/Kconfig
```kconfig
# Copyright 2023 NXP
# All rights reserved.
#
# SPDX-License-Identifier: BSD-3-Clause

# driver_ii2c
config MCUX_HAS_driver_ii2c
    bool

config MCUX_USE_driver_ii2c
    depends on MCUX_HAS_driver_ii2c
    bool "I2C Driver"

    help
      I2C Driver
```

## drivers/inputmux/Kconfig
```kconfig
# Copyright 2023 NXP
# All rights reserved.
#
# SPDX-License-Identifier: BSD-3-Clause

# driver_inputmux
config MCUX_HAS_driver_inputmux
    bool

config MCUX_USE_driver_inputmux
    depends on MCUX_HAS_driver_inputmux
    bool "INPUTMUX Driver"
    select MCUX_USE_driver_common
    select MCUX_USE_driver_inputmux_connections
    help
      INPUTMUX Driver
```

## drivers/intmux/Kconfig
```kconfig
# Copyright 2023 NXP
# All rights reserved.
#
# SPDX-License-Identifier: BSD-3-Clause

# driver_intmux
config MCUX_HAS_driver_intmux
    bool

config MCUX_USE_driver_intmux
    depends on MCUX_HAS_driver_intmux
    bool "INTMUX Driver"
    select MCUX_USE_driver_common
    help
      INTMUX Driver
```

## drivers/ipwm/Kconfig
```kconfig
# Copyright 2023 NXP
# All rights reserved.
#
# SPDX-License-Identifier: BSD-3-Clause

# driver_ipwm
config MCUX_HAS_driver_ipwm
    bool

config MCUX_USE_driver_ipwm
    depends on MCUX_HAS_driver_ipwm
    bool "PWM Driver"

    help
      PWM Driver
```

## drivers/irq/Kconfig
```kconfig
# Copyright 2023 NXP
# All rights reserved.
#
# SPDX-License-Identifier: BSD-3-Clause

# driver_irq
config MCUX_HAS_driver_irq
    bool

config MCUX_USE_driver_irq
    depends on MCUX_HAS_driver_irq
    bool "IRQ Driver"
    select MCUX_USE_driver_common
    help
      IRQ Driver
```

## drivers/irtc/Kconfig
```kconfig
# Copyright 2023 NXP
# All rights reserved.
#
# SPDX-License-Identifier: BSD-3-Clause

# driver_irtc
config MCUX_HAS_driver_irtc
    bool

config MCUX_USE_driver_irtc
    depends on MCUX_HAS_driver_irtc
    bool "IRTC Driver"
    select MCUX_USE_driver_common
    help
      IRTC Driver
```

## drivers/iuart/Kconfig
```kconfig
# Copyright 2023 NXP
# All rights reserved.
#
# SPDX-License-Identifier: BSD-3-Clause

# driver_iuart
config MCUX_HAS_driver_iuart
    bool

config MCUX_USE_driver_iuart
    depends on MCUX_HAS_driver_iuart
    bool "IUART Driver"

    help
      IUART Driver

# driver_iuart_sdma
config MCUX_HAS_driver_iuart_sdma
    bool

config MCUX_USE_driver_iuart_sdma
    depends on MCUX_HAS_driver_iuart_sdma
    bool "IUART SDMA Driver"
    select MCUX_USE_driver_iuart
    help
      IUART SDMA Driver
```

## drivers/kbi/Kconfig
```kconfig
# Copyright 2023 NXP
# All rights reserved.
#
# SPDX-License-Identifier: BSD-3-Clause

# driver_kbi
config MCUX_HAS_driver_kbi
    bool

config MCUX_USE_driver_kbi
    depends on MCUX_HAS_driver_kbi
    bool "KBI Driver"
    select MCUX_USE_driver_common
    help
      KBI Driver
```

## drivers/key_manager/Kconfig
```kconfig
# Copyright 2023 NXP
# All rights reserved.
#
# SPDX-License-Identifier: BSD-3-Clause

# driver_key_manager
config MCUX_HAS_driver_key_manager
    bool

config MCUX_USE_driver_key_manager
    depends on MCUX_HAS_driver_key_manager
    bool "Key Manager Driver"
    select MCUX_USE_driver_common
    help
      Key Manager Driver
```

## drivers/kpp/Kconfig
```kconfig
# Copyright 2023 NXP
# All rights reserved.
#
# SPDX-License-Identifier: BSD-3-Clause

# driver_kpp
config MCUX_HAS_driver_kpp
    bool

config MCUX_USE_driver_kpp
    depends on MCUX_HAS_driver_kpp
    bool "KPP Driver"
    select MCUX_USE_driver_common
    help
      KPP Driver
```

## drivers/lcdif/Kconfig
```kconfig
# Copyright 2023 NXP
# All rights reserved.
#
# SPDX-License-Identifier: BSD-3-Clause

# driver_lcdif
config MCUX_HAS_driver_lcdif
    bool

config MCUX_USE_driver_lcdif
    depends on MCUX_HAS_driver_lcdif
    bool "LCDIF Driver"
    select MCUX_USE_driver_common
    help
      LCDIF Driver
```

## drivers/lcdifv2/Kconfig
```kconfig
# Copyright 2023 NXP
# All rights reserved.
#
# SPDX-License-Identifier: BSD-3-Clause

# driver_lcdifv2
config MCUX_HAS_driver_lcdifv2
    bool

config MCUX_USE_driver_lcdifv2
    depends on MCUX_HAS_driver_lcdifv2
    bool "LCDIFV2 Driver"
    select MCUX_USE_driver_common
    help
      LCDIFV2 Driver
```

## drivers/lpadc/Kconfig
```kconfig
# Copyright 2023 NXP
# All rights reserved.
#
# SPDX-License-Identifier: BSD-3-Clause

# driver_lpadc
config MCUX_HAS_driver_lpadc
    bool

config MCUX_USE_driver_lpadc
    depends on MCUX_HAS_driver_lpadc
    bool "LPADC Driver"
    select MCUX_USE_driver_common
    help
      LPADC Driver
```

## drivers/lpc_acomp/Kconfig
```kconfig
# Copyright 2023 NXP
# All rights reserved.
#
# SPDX-License-Identifier: BSD-3-Clause

# driver_lpc_acomp
config MCUX_HAS_driver_lpc_acomp
    bool

config MCUX_USE_driver_lpc_acomp
    depends on MCUX_HAS_driver_lpc_acomp
    bool "LPC_ACOMP Driver"
    select MCUX_USE_driver_common
    help
      LPC_ACOMP Driver
```

## drivers/lpc_adc/Kconfig
```kconfig
# Copyright 2023 NXP
# All rights reserved.
#
# SPDX-License-Identifier: BSD-3-Clause

# driver_lpc_adc
config MCUX_HAS_driver_lpc_adc
    bool

config MCUX_USE_driver_lpc_adc
    depends on MCUX_HAS_driver_lpc_adc
    bool "ADC Driver"
    select MCUX_USE_driver_common
    help
      ADC Driver
```

## drivers/lpc_dac/Kconfig
```kconfig
# Copyright 2023 NXP
# All rights reserved.
#
# SPDX-License-Identifier: BSD-3-Clause

# driver_lpc_dac
config MCUX_HAS_driver_lpc_dac
    bool

config MCUX_USE_driver_lpc_dac
    depends on MCUX_HAS_driver_lpc_dac
    bool "DAC Driver"
    select MCUX_USE_driver_common
    help
      DAC Driver
```

## drivers/lpc_dma/Kconfig
```kconfig
# Copyright 2023 NXP
# All rights reserved.
#
# SPDX-License-Identifier: BSD-3-Clause

# driver_lpc_dma
config MCUX_HAS_driver_lpc_dma
    bool

config MCUX_USE_driver_lpc_dma
    depends on MCUX_HAS_driver_lpc_dma
    bool "DMA Driver"
    select MCUX_USE_driver_common
    help
      DMA Driver
```

## drivers/lpc_enet/Kconfig
```kconfig
# Copyright 2023 NXP
# All rights reserved.
#
# SPDX-License-Identifier: BSD-3-Clause

# driver_lpc_enet
config MCUX_HAS_driver_lpc_enet
    bool

config MCUX_USE_driver_lpc_enet
    depends on MCUX_HAS_driver_lpc_enet
    bool "enet Driver"
    select MCUX_USE_driver_common
    help
      enet Driver
```

## drivers/lpc_gpio/Kconfig
```kconfig
# Copyright 2023 NXP
# All rights reserved.
#
# SPDX-License-Identifier: BSD-3-Clause

# driver_lpc_gpio
config MCUX_HAS_driver_lpc_gpio
    bool

config MCUX_USE_driver_lpc_gpio
    depends on MCUX_HAS_driver_lpc_gpio
    bool "GPIO Driver"
    select MCUX_USE_driver_common
    help
      GPIO Driver
```
