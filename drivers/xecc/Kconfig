## zephyr/Kconfig.drivers
```kconfig
# Copyright 2021 NXP
# SPDX-License-Identifier: BSD-3-Clause

menu "Drivers"

config MCUX_SDK_DRIVER_ADC16
	bool "ADC16"
	depends on HAS_MCUX_SDK_DRIVER_ADC16

config MCUX_SDK_DRIVER_CLOCK
	bool "Clock"
	depends on HAS_MCUX_SDK_DRIVER_CLOCK

config MCUX_SDK_DRIVER_CMP
	bool "CMP"
	depends on HAS_MCUX_SDK_DRIVER_CMP

config MCUX_SDK_DRIVER_CMP_1
	bool "CMP_1"
	depends on HAS_MCUX_SDK_DRIVER_CMP_1

config MCUX_SDK_DRIVER_CMT
	bool "CMT"
	depends on HAS_MCUX_SDK_DRIVER_CMT

config MCUX_SDK_DRIVER_COMMON
	bool "Common"
	depends on HAS_MCUX_SDK_DRIVER_COMMON

config MCUX_SDK_DRIVER_CRC
	bool "CRC"
	depends on HAS_MCUX_SDK_DRIVER_CRC

config MCUX_SDK_DRIVER_DAC
	bool "DAC"
	depends on HAS_MCUX_SDK_DRIVER_DAC

config MCUX_SDK_DRIVER_DMAMUX
	bool "DMAMUX"
	depends on HAS_MCUX_SDK_DRIVER_DMAMUX

config MCUX_SDK_DRIVER_DSPI
	bool "DSPI"
	depends on HAS_MCUX_SDK_DRIVER_DSPI

config MCUX_SDK_DRIVER_DSPI_EDMA
	bool "DSPI_EDMA"
	depends on HAS_MCUX_SDK_DRIVER_DSPI_EDMA

config MCUX_SDK_DRIVER_EDMA
	bool "EDMA"
	depends on HAS_MCUX_SDK_DRIVER_EDMA

config MCUX_SDK_DRIVER_EWM
	bool "EWM"
	depends on HAS_MCUX_SDK_DRIVER_EWM

config MCUX_SDK_DRIVER_FLASH
	bool "FLASH"
	depends on HAS_MCUX_SDK_DRIVER_FLASH

config MCUX_SDK_DRIVER_FLEXCAN
	bool "FLEXCAN"
	depends on HAS_MCUX_SDK_DRIVER_FLEXCAN

config MCUX_SDK_DRIVER_FLEXCOMM
	bool "FLEXCOMM"
	depends on HAS_MCUX_SDK_DRIVER_FLEXCOMM

config MCUX_SDK_DRIVER_FLEXCOMM_I2C
	bool "FLEXCOMM_I2C"
	depends on HAS_MCUX_SDK_DRIVER_FLEXCOMM_I2C
	imply MCUX_SDK_DRIVER_FLEXCOMM

config MCUX_SDK_DRIVER_FLEXCOMM_I2C_DMA
	bool "FLEXCOMM_I2C_DMA"
	depends on HAS_MCUX_SDK_DRIVER_FLEXCOMM_I2C_DMA
	imply MCUX_SDK_DRIVER_FLEXCOMM

config MCUX_SDK_DRIVER_FLEXCOMM_I2S
	bool "FLEXCOMM_I2S"
	depends on HAS_MCUX_SDK_DRIVER_FLEXCOMM_I2S
	imply MCUX_SDK_DRIVER_FLEXCOMM

config MCUX_SDK_DRIVER_FLEXCOMM_I2S_DMA
	bool "FLEXCOMM_I2S_DMA"
	depends on HAS_MCUX_SDK_DRIVER_FLEXCOMM_I2S_DMA
	imply MCUX_SDK_DRIVER_FLEXCOMM

config MCUX_SDK_DRIVER_FLEXCOMM_SPI
	bool "FLEXCOMM_SPI"
	depends on HAS_MCUX_SDK_DRIVER_FLEXCOMM_SPI
	imply MCUX_SDK_DRIVER_FLEXCOMM

config MCUX_SDK_DRIVER_FLEXCOMM_SPI_DMA
	bool "FLEXCOMM_SPI_DMA"
	depends on HAS_MCUX_SDK_DRIVER_FLEXCOMM_SPI_DMA
	imply MCUX_SDK_DRIVER_FLEXCOMM

config MCUX_SDK_DRIVER_FLEXCOMM_USART
	bool "FLEXCOMM_USART"
	depends on HAS_MCUX_SDK_DRIVER_FLEXCOMM_USART
	imply MCUX_SDK_DRIVER_FLEXCOMM

config MCUX_SDK_DRIVER_FLEXCOMM_USART_DMA
	bool "FLEXCOMM_USART_DMA"
	depends on HAS_MCUX_SDK_DRIVER_FLEXCOMM_USART_DMA
	imply MCUX_SDK_DRIVER_FLEXCOMM

config MCUX_SDK_DRIVER_FTM
	bool "FTM"
	depends on HAS_MCUX_SDK_DRIVER_FTM

config MCUX_SDK_DRIVER_GPIO
	bool "GPIO"
	depends on HAS_MCUX_SDK_DRIVER_GPIO

config MCUX_SDK_DRIVER_I2C
	bool "I2C"
	depends on HAS_MCUX_SDK_DRIVER_I2C

config MCUX_SDK_DRIVER_I2C_EDMA
	bool "I2C_EDMA"
	depends on HAS_MCUX_SDK_DRIVER_I2C_EDMA

config MCUX_SDK_DRIVER_INPUTMUX
	bool "INPUTMUX"
	depends on HAS_MCUX_SDK_DRIVER_INPUTMUX

config MCUX_SDK_DRIVER_LPADC
	bool "LPADC"
	depends on HAS_MCUX_SDK_DRIVER_LPADC

config MCUX_SDK_DRIVER_LPC_CRC
	bool "LPC_CRC"
	depends on HAS_MCUX_SDK_DRIVER_LPC_CRC

config MCUX_SDK_DRIVER_LPC_DMA
	bool "LPC_DMA"
	depends on HAS_MCUX_SDK_DRIVER_LPC_DMA

config MCUX_SDK_DRIVER_LPC_GPIO
	bool "LPC_GPIO"
	depends on HAS_MCUX_SDK_DRIVER_LPC_GPIO

config MCUX_SDK_DRIVER_LPC_IOCON
	bool "LPC_IOCON"
	depends on HAS_MCUX_SDK_DRIVER_LPC_IOCON

config MCUX_SDK_DRIVER_LPTMR
	bool "LPTMR"
	depends on HAS_MCUX_SDK_DRIVER_LPTMR

config MCUX_SDK_DRIVER_PDB
	bool "PDB"
	depends on HAS_MCUX_SDK_DRIVER_PDB

config MCUX_SDK_DRIVER_PINT
	bool "PINT"
	depends on HAS_MCUX_SDK_DRIVER_PINT

config MCUX_SDK_DRIVER_PIT
	bool "PIT"
	depends on HAS_MCUX_SDK_DRIVER_PIT

config MCUX_SDK_DRIVER_PORT
	bool "PORT"
	depends on HAS_MCUX_SDK_DRIVER_PORT

config MCUX_SDK_DRIVER_PUF
	bool "PUF"
	depends on HAS_MCUX_SDK_DRIVER_PUF

config MCUX_SDK_DRIVER_RCM
	bool "RCM"
	depends on HAS_MCUX_SDK_DRIVER_RCM

config MCUX_SDK_DRIVER_RNGA
	bool "RNGA"
	depends on HAS_MCUX_SDK_DRIVER_RNGA

config MCUX_SDK_DRIVER_RTC
	bool "RTC"
	depends on HAS_MCUX_SDK_DRIVER_RTC

config MCUX_SDK_DRIVER_SIM
	bool "SIM"
	depends on HAS_MCUX_SDK_DRIVER_SIM

config MCUX_SDK_DRIVER_SMC
	bool "SMC"
	depends on HAS_MCUX_SDK_DRIVER_SMC

config MCUX_SDK_DRIVER_SYSMPU
	bool "SYSMPU"
	depends on HAS_MCUX_SDK_DRIVER_SYSMPU

config MCUX_SDK_DRIVER_UART
	bool "UART"
	depends on HAS_MCUX_SDK_DRIVER_UART

config MCUX_SDK_DRIVER_UART_EDMA
	bool "UART_EDMA"
	depends on HAS_MCUX_SDK_DRIVER_UART_EDMA

config MCUX_SDK_DRIVER_VREF
	bool "VREF"
	depends on HAS_MCUX_SDK_DRIVER_VREF

config MCUX_SDK_DRIVER_WDOG
	bool "WDOG"
	depends on HAS_MCUX_SDK_DRIVER_WDOG

config HAS_MCUX_SDK_DRIVER_ADC16
	bool

config HAS_MCUX_SDK_DRIVER_CLOCK
	bool

config HAS_MCUX_SDK_DRIVER_CMP
	bool

config HAS_MCUX_SDK_DRIVER_CMP_1
	bool

config HAS_MCUX_SDK_DRIVER_CMT
	bool

config HAS_MCUX_SDK_DRIVER_COMMON
	bool

config HAS_MCUX_SDK_DRIVER_CRC
	bool

config HAS_MCUX_SDK_DRIVER_DAC
	bool

config HAS_MCUX_SDK_DRIVER_DMAMUX
	bool

config HAS_MCUX_SDK_DRIVER_DSPI
	bool

config HAS_MCUX_SDK_DRIVER_DSPI_EDMA
	bool

config HAS_MCUX_SDK_DRIVER_EDMA
	bool

config HAS_MCUX_SDK_DRIVER_EWM
	bool

config HAS_MCUX_SDK_DRIVER_FLASH
	bool

config HAS_MCUX_SDK_DRIVER_FLEXCAN
	bool

config HAS_MCUX_SDK_DRIVER_FLEXCOMM
	bool

config HAS_MCUX_SDK_DRIVER_FLEXCOMM_I2C
	bool

config HAS_MCUX_SDK_DRIVER_FLEXCOMM_I2C_DMA
	bool

config HAS_MCUX_SDK_DRIVER_FLEXCOMM_I2S
	bool

config HAS_MCUX_SDK_DRIVER_FLEXCOMM_I2S_DMA
	bool

config HAS_MCUX_SDK_DRIVER_FLEXCOMM_SPI
	bool

config HAS_MCUX_SDK_DRIVER_FLEXCOMM_SPI_DMA
	bool

config HAS_MCUX_SDK_DRIVER_FLEXCOMM_USART
	bool

config HAS_MCUX_SDK_DRIVER_FLEXCOMM_USART_DMA
	bool

config HAS_MCUX_SDK_DRIVER_FTM
	bool

config HAS_MCUX_SDK_DRIVER_GPIO
	bool

config HAS_MCUX_SDK_DRIVER_I2C
	bool

config HAS_MCUX_SDK_DRIVER_I2C_EDMA
	bool

config HAS_MCUX_SDK_DRIVER_INPUTMUX
	bool

config HAS_MCUX_SDK_DRIVER_LPADC
	bool

config HAS_MCUX_SDK_DRIVER_LPC_CRC
	bool

config HAS_MCUX_SDK_DRIVER_LPC_DMA
	bool

config HAS_MCUX_SDK_DRIVER_LPC_GPIO
	bool

config HAS_MCUX_SDK_DRIVER_LPC_IOCON
	bool

config HAS_MCUX_SDK_DRIVER_LPTMR
	bool

config HAS_MCUX_SDK_DRIVER_PDB
	bool

config HAS_MCUX_SDK_DRIVER_PINT
	bool

config HAS_MCUX_SDK_DRIVER_PIT
	bool

config HAS_MCUX_SDK_DRIVER_PORT
	bool

config HAS_MCUX_SDK_DRIVER_PUF
	bool

config HAS_MCUX_SDK_DRIVER_RCM
	bool

config HAS_MCUX_SDK_DRIVER_RNGA
	bool

config HAS_MCUX_SDK_DRIVER_RTC
	bool

config HAS_MCUX_SDK_DRIVER_SIM
	bool

config HAS_MCUX_SDK_DRIVER_SMC
	bool

config HAS_MCUX_SDK_DRIVER_SYSMPU
	bool

config HAS_MCUX_SDK_DRIVER_UART
	bool

config HAS_MCUX_SDK_DRIVER_UART_EDMA
	bool

config HAS_MCUX_SDK_DRIVER_VREF
	bool

config HAS_MCUX_SDK_DRIVER_WDOG
	bool

endmenu # Drivers
```
