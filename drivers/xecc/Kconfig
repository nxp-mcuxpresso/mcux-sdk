## drivers/xecc/Kconfig
```kconfig
# Copyright 2023 NXP
# All rights reserved.
#
# SPDX-License-Identifier: BSD-3-Clause

# driver_xecc
config MCUX_HAS_driver_xecc
    bool

config MCUX_USE_driver_xecc
    depends on MCUX_HAS_driver_xecc
    bool "XECC Driver"
    select MCUX_USE_driver_common
    help
      XECC Driver
```

## drivers/xrdc/Kconfig
```kconfig
# Copyright 2023 NXP
# All rights reserved.
#
# SPDX-License-Identifier: BSD-3-Clause

# driver_xrdc
config MCUX_HAS_driver_xrdc
    bool

config MCUX_USE_driver_xrdc
    depends on MCUX_HAS_driver_xrdc
    bool "XRDC Driver"
    select MCUX_USE_driver_common
    help
      XRDC Driver
```

## drivers/xrdc2/Kconfig
```kconfig
# Copyright 2023 NXP
# All rights reserved.
#
# SPDX-License-Identifier: BSD-3-Clause

# driver_xrdc2
config MCUX_HAS_driver_xrdc2
    bool

config MCUX_USE_driver_xrdc2
    depends on MCUX_HAS_driver_xrdc2
    bool "XRDC2 Driver"
    select MCUX_USE_driver_common
    help
      XRDC2 Driver
```

## kconfig
```kconfig
# Copyright 2021 NXP
# SPDX-License-Identifier: BSD-3-Clause

menu "MCUX SDK"

rsource "./devices/kconfig.socs"

rsource "./drivers/kconfig.drivers"

rsource "./CMSIS/kconfig.CMSIS"

rsource "./components/kconfig.components"

rsource "./devices/kconfig.devices"

rsource "./utilities/kconfig.utilities"

rsource "./middleware/kconfig.middleware"

endmenu
```

## middleware/kconfig.middleware
```kconfig
# Copyright 2021 NXP
# SPDX-License-Identifier: BSD-3-Clause

menu "middleware"

    depends on HAS_MIDDLEWARE
menu "issdk"

    depends on HAS_MCUX_SDK_middleware_issdk_algorithms_pedometer_common || HAS_MCUX_SDK_middleware_issdk_algorithms_pedometer_lib_cm4 || HAS_MCUX_SDK_middleware_issdk_sensor_allregdefs

config USE_middleware_issdk_algorithms_pedometer_common
    bool 
    depends on HAS_MCUX_SDK_middleware_issdk_algorithms_pedometer_common
    default n
    select USE_CMSIS_Driver_Include_I2C if HAS_MCUX_SDK_CMSIS_Driver_Include_I2C
    select USE_CMSIS_Driver_Include_SPI if HAS_MCUX_SDK_CMSIS_Driver_Include_SPI

config USE_middleware_issdk_algorithms_pedometer_lib_cm4
    bool 
    depends on HAS_MCUX_SDK_middleware_issdk_algorithms_pedometer_lib_cm4
    default n

config USE_middleware_issdk_sensor_allregdefs
    bool "Middleware issdk sensor allregdefs"
    depends on HAS_MCUX_SDK_middleware_issdk_sensor_allregdefs
    default n
    select USE_CMSIS_Driver_Include_I2C if HAS_MCUX_SDK_CMSIS_Driver_Include_I2C
    select USE_CMSIS_Driver_Include_SPI if HAS_MCUX_SDK_CMSIS_Driver_Include_SPI

endmenu

config HAS_MCUX_SDK_middleware_issdk_algorithms_pedometer_common
    bool


config HAS_MCUX_SDK_middleware_issdk_algorithms_pedometer_lib_cm4
    bool


config HAS_MCUX_SDK_middleware_issdk_sensor_allregdefs
    bool


menu "mmcau"

    depends on HAS_MCUX_SDK_middleware_mmcau_cm0p || HAS_MCUX_SDK_middleware_mmcau_cm4_cm7 || HAS_MCUX_SDK_middleware_mmcau_common_files

config USE_middleware_mmcau_cm0p
    bool "Kinetis MMCAU security function library for Arm Cortex-M0+"
    depends on HAS_MCUX_SDK_middleware_mmcau_cm0p
    default n
    select USE_middleware_mmcau_common_files if HAS_MCUX_SDK_middleware_mmcau_common_files

config USE_middleware_mmcau_cm4_cm7
    bool "Kinetis MMCAU security function library for Arm Cortex-M4 and Cortex-M7"
    depends on HAS_MCUX_SDK_middleware_mmcau_cm4_cm7
    default n
    select USE_driver_clock if HAS_MCUX_SDK_driver_clock
    select USE_middleware_mmcau_common_files if HAS_MCUX_SDK_middleware_mmcau_common_files

config USE_middleware_mmcau_common_files
    bool "Kinetis MMCAU common source files"
    depends on HAS_MCUX_SDK_middleware_mmcau_common_files
    default n
    select USE_driver_common if HAS_MCUX_SDK_driver_common

endmenu

config HAS_MCUX_SDK_middleware_mmcau_cm0p
    bool


config HAS_MCUX_SDK_middleware_mmcau_cm4_cm7
    bool


config HAS_MCUX_SDK_middleware_mmcau_common_files
    bool


menu "usb"

    depends on HAS_MCUX_SDK_middleware_usb_common_header || HAS_MCUX_SDK_middleware_usb_device_common_header

config USE_middleware_usb_common_header
    bool "USB Common Header"
    depends on HAS_MCUX_SDK_middleware_usb_common_header
    default n
    select USE_component_osa if HAS_MCUX_SDK_component_osa

config USE_middleware_usb_device_common_header
    bool "USB Device Common Header"
    depends on HAS_MCUX_SDK_middleware_usb_device_common_header
    default n
    select USE_middleware_usb_common_header if HAS_MCUX_SDK_middleware_usb_common_header

endmenu

config HAS_MCUX_SDK_middleware_usb_common_header
    bool


config HAS_MCUX_SDK_middleware_usb_device_common_header
    bool


endmenu
```

## utilities/Kconfig
```kconfig
# Copyright 2023 NXP
# All rights reserved.
#
# SPDX-License-Identifier: BSD-3-Clause

menu "Utilities Configuration"


# utility_str
config MCUX_HAS_utility_str
    bool

config MCUX_USE_utility_str
    depends on MCUX_HAS_utility_str
    bool "Utility str"
    select MCUX_USE_driver_common
    help
      Utility str

# utility_debug_console_lite
config MCUX_HAS_utility_debug_console_lite
    bool

config MCUX_USE_utility_debug_console_lite
    depends on MCUX_HAS_utility_debug_console_lite
    bool "Utility debug_console_lite"
    select MCUX_USE_driver_common
    help
      Utility debug_console_lite

# utility_debug_console
config MCUX_HAS_utility_debug_console
    bool

config MCUX_USE_utility_debug_console
    depends on MCUX_HAS_utility_debug_console
    bool "Utility debug_console"
    select MCUX_USE_component_serial_manager
    select MCUX_USE_driver_common
    help
      Utility debug_console

rsource "./assert/Kconfig"
rsource "./misc_utilities/Kconfig"
rsource "./shell/Kconfig"

endmenu
```

## utilities/assert/Kconfig
```kconfig
# Copyright 2023 NXP
# All rights reserved.
#
# SPDX-License-Identifier: BSD-3-Clause

# utility_assert
config MCUX_HAS_utility_assert
    bool

config MCUX_USE_utility_assert
    depends on MCUX_HAS_utility_assert
    bool "Utility assert"
    select MCUX_USE_utility_debug_console
    help
      Utility assert

# utility_assert_lite
config MCUX_HAS_utility_assert_lite
    bool

config MCUX_USE_utility_assert_lite
    depends on MCUX_HAS_utility_assert_lite
    bool "Utility assert_lite"
    select MCUX_USE_utility_debug_console_lite
    help
      Utility assert_lite
```

## utilities/kconfig.utilities
```kconfig
# Copyright 2021 NXP
# SPDX-License-Identifier: BSD-3-Clause

menu "utilities"

config USE_utility_notifier
    bool "Utility notifier"
    depends on HAS_MCUX_SDK_utility_notifier
    default n
    select USE_driver_common if HAS_MCUX_SDK_driver_common

config USE_utility_shell
    bool "Utility shell"
    depends on HAS_MCUX_SDK_utility_shell
    default n
    select USE_utility_debug_console if HAS_MCUX_SDK_utility_debug_console
    select USE_component_lists if HAS_MCUX_SDK_component_lists

config USE_utility_assert
    bool "Utility assert"
    depends on HAS_MCUX_SDK_utility_assert
    default n
    select USE_utility_debug_console if HAS_MCUX_SDK_utility_debug_console

config USE_utility_assert_lite
    bool "Utility assert_lite"
    depends on HAS_MCUX_SDK_utility_assert_lite
    default n
    select USE_utility_debug_console_lite if HAS_MCUX_SDK_utility_debug_console_lite

config USE_utility_debug_console
    bool "Utility debug_console"
    depends on HAS_MCUX_SDK_utility_debug_console
    default n
    select USE_component_serial_manager if HAS_MCUX_SDK_component_serial_manager

config USE_utility_debug_console_lite
    bool "Utility debug_console_lite"
    depends on HAS_MCUX_SDK_utility_debug_console_lite
    default n
    select USE_component_lpuart_adapter if HAS_MCUX_SDK_component_lpuart_adapter
    select USE_component_usart_adapter if HAS_MCUX_SDK_component_usart_adapter
    select USE_component_miniusart_adapter if HAS_MCUX_SDK_component_miniusart_adapter
    select USE_component_iuart_adapter if HAS_MCUX_SDK_component_iuart_adapter
    select USE_component_uart_adapter if HAS_MCUX_SDK_component_uart_adapter
    select USE_driver_common if HAS_MCUX_SDK_driver_common

config USE_utilities_misc_utilities
    bool "utilities_misc_utilities"
    depends on HAS_MCUX_SDK_utilities_misc_utilities
    default n

config USE_utility_incbin
    bool "utility incbin"
    depends on HAS_MCUX_SDK_utility_incbin
    default n

config HAS_MCUX_SDK_utility_notifier
    bool


config HAS_MCUX_SDK_utility_shell
    bool


config HAS_MCUX_SDK_utility_assert
    bool


config HAS_MCUX_SDK_utility_assert_lite
    bool


config HAS_MCUX_SDK_utility_debug_console
    bool


config HAS_MCUX_SDK_utility_debug_console_lite
    bool


config HAS_MCUX_SDK_utilities_misc_utilities
    bool


config HAS_MCUX_SDK_utility_incbin
    bool


endmenu
```

## utilities/misc_utilities/Kconfig
```kconfig
# Copyright 2023 NXP
# All rights reserved.
#
# SPDX-License-Identifier: BSD-3-Clause

# utilities_misc_utilities
config MCUX_HAS_utilities_misc_utilities
    bool

config MCUX_USE_utilities_misc_utilities
    depends on MCUX_HAS_utilities_misc_utilities
    bool "Utilities miscellaneous"
    help
      Utilities which is needed for particular toolchain like the SBRK function required to address limitation between HEAP and STACK in GCC toolchain library.

# utility_incbin
config MCUX_HAS_utility_incbin
    bool

config MCUX_USE_utility_incbin
    depends on MCUX_HAS_utility_incbin
    bool "utility incbin"
    help
      Used to include slave core binary into master core binary.
```

## utilities/shell/Kconfig
```kconfig
# Copyright 2023 NXP
# All rights reserved.
#
# SPDX-License-Identifier: BSD-3-Clause

# utility_shell
config MCUX_HAS_utility_shell
    bool

config MCUX_USE_utility_shell
    depends on MCUX_HAS_utility_shell
    bool "Utility shell"
    select MCUX_USE_utility_str
    select MCUX_USE_component_lists
    select MCUX_USE_driver_common
    help
      Utility shell
```

## west.yml
```yaml
manifest:
  remotes:
  - name: nxpmicro
    url-base: https://github.com/NXPmicro
  - name: nxp
    url-base: https://github.com/NXP
  - name: nxp-mcuxpresso
    url-base: https://github.com/nxp-mcuxpresso
  defaults:
    remote: nxpmicro
  self:
    path: core
  projects:
  - name: mcux-sdk-examples
    revision: MCUX_2.6.16_K32W0
    path: examples
    remote: nxp-mcuxpresso
  - name: mcux-sdk-middleware-connectivity-framework
    revision: MCUX_2.6.16_K32W0
    path: middleware/wireless/framework
    remote: nxp
  - name: mcux-sdk-middleware-bluetooth-controller
    path: middleware/wireless/ble_controller
    revision: MCUX_2.6.16_K32W0
    remote: nxp
  - name: mcux-sdk-middleware-bluetooth-host
    path: middleware/wireless/bluetooth
    revision: MCUX_2.6.16_K32W0
    remote: nxp
  - name: mcux-sdk-middleware-ieee_802.15.4
    path: middleware/wireless/ieee-802.15.4
    revision: MCUX_2.6.16_K32W0
    remote: nxp
  - name: mcux-sdk-middleware-zigbee
    path: middleware/wireless/zigbee
    revision: MCUX_2.6.16_K32W0
    remote: nxp-mcuxpresso
  - name: amazon-freertos
    path: rtos/amazon-freertos
    revision: fb74168634e716fb5f0a61714e5c0d1ac6246bac
    remote: nxp
```

## zephyr/Kconfig
```kconfig
# Copyright 2021 NXP
# SPDX-License-Identifier: BSD-3-Clause

config ZEPHYR_HAL_NXP_MODULE
	bool

config USE_MCUX_SDK
	bool "Use MCUX SDK"
	help
	  This option enables the use of NXP MCUXpresso SDK

if USE_MCUX_SDK
rsource "../Kconfig"
endif
```

## zephyr/Kconfig.devices
```kconfig
# Copyright 2021 NXP
# SPDX-License-Identifier: BSD-3-Clause

menu "Devices"

config MCUX_SDK_DEVICE_LPC55S69
	bool "LPC55S69"
	select HAS_MCUX_SDK_DRIVER_CLOCK
	select HAS_MCUX_SDK_DRIVER_CMP_1
	select HAS_MCUX_SDK_DRIVER_COMMON
	select HAS_MCUX_SDK_DRIVER_FLEXCOMM
	select HAS_MCUX_SDK_DRIVER_FLEXCOMM_I2C
	select HAS_MCUX_SDK_DRIVER_FLEXCOMM_I2C_DMA
	select HAS_MCUX_SDK_DRIVER_FLEXCOMM_I2S
	select HAS_MCUX_SDK_DRIVER_FLEXCOMM_I2S_DMA
	select HAS_MCUX_SDK_DRIVER_FLEXCOMM_SPI
	select HAS_MCUX_SDK_DRIVER_FLEXCOMM_SPI_DMA
	select HAS_MCUX_SDK_DRIVER_FLEXCOMM_USART
	select HAS_MCUX_SDK_DRIVER_FLEXCOMM_USART_DMA
	select HAS_MCUX_SDK_DRIVER_INPUTMUX
	select HAS_MCUX_SDK_DRIVER_LPADC
	select HAS_MCUX_SDK_DRIVER_LPC_CRC
	select HAS_MCUX_SDK_DRIVER_LPC_DMA
	select HAS_MCUX_SDK_DRIVER_LPC_GPIO
	select HAS_MCUX_SDK_DRIVER_LPC_IOCON
	select HAS_MCUX_SDK_DRIVER_PINT
	select HAS_MCUX_SDK_DRIVER_PUF

config MCUX_SDK_DEVICE_MK64F12
	bool "MK64F12"
	select HAS_MCUX_SDK_DRIVER_ADC16
	select HAS_MCUX_SDK_DRIVER_CLOCK
	select HAS_MCUX_SDK_DRIVER_CMP
	select HAS_MCUX_SDK_DRIVER_CMT
	select HAS_MCUX_SDK_DRIVER_COMMON
	select HAS_MCUX_SDK_DRIVER_CRC
	select HAS_MCUX_SDK_DRIVER_DAC
	select HAS_MCUX_SDK_DRIVER_DMAMUX
	select HAS_MCUX_SDK_DRIVER_DSPI
	select HAS_MCUX_SDK_DRIVER_DSPI_EDMA
	select HAS_MCUX_SDK_DRIVER_EDMA
	select HAS_MCUX_SDK_DRIVER_EWM
	select HAS_MCUX_SDK_DRIVER_FLASH
	select HAS_MCUX_SDK_DRIVER_FLEXCAN
	select HAS_MCUX_SDK_DRIVER_FTM
	select HAS_MCUX_SDK_DRIVER_GPIO
	select HAS_MCUX_SDK_DRIVER_I2C
	select HAS_MCUX_SDK_DRIVER_I2C_EDMA
	select HAS_MCUX_SDK_DRIVER_LPTMR
	select HAS_MCUX_SDK_DRIVER_PDB
	select HAS_MCUX_SDK_DRIVER_PIT
	select HAS_MCUX_SDK_DRIVER_PORT
	select HAS_MCUX_SDK_DRIVER_RCM
	select HAS_MCUX_SDK_DRIVER_RNGA
	select HAS_MCUX_SDK_DRIVER_RTC
	select HAS_MCUX_SDK_DRIVER_SIM
	select HAS_MCUX_SDK_DRIVER_SMC
	select HAS_MCUX_SDK_DRIVER_SYSMPU
	select HAS_MCUX_SDK_DRIVER_UART
	select HAS_MCUX_SDK_DRIVER_UART_EDMA
	select HAS_MCUX_SDK_DRIVER_VREF
	select HAS_MCUX_SDK_DRIVER_WDOG

endmenu # Devices
```
