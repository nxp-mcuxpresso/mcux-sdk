## drivers/sysctl/Kconfig
```kconfig
# Copyright 2023 NXP
# All rights reserved.
#
# SPDX-License-Identifier: BSD-3-Clause

# driver_sysctl
config MCUX_HAS_driver_sysctl
    bool

config MCUX_USE_driver_sysctl
    depends on MCUX_HAS_driver_sysctl
    bool "SYSCTL Driver"
    select MCUX_USE_driver_common
    help
      SYSCTL Driver
```

## drivers/sysmpu/Kconfig
```kconfig
# Copyright 2023 NXP
# All rights reserved.
#
# SPDX-License-Identifier: BSD-3-Clause

# driver_sysmpu
config MCUX_HAS_driver_sysmpu
    bool

config MCUX_USE_driver_sysmpu
    depends on MCUX_HAS_driver_sysmpu
    bool "SYSMPU Driver"
    select MCUX_USE_driver_common
    help
      SYSMPU Driver
```

## drivers/tempmon/Kconfig
```kconfig
# Copyright 2023 NXP
# All rights reserved.
#
# SPDX-License-Identifier: BSD-3-Clause

# driver_tempmon
config MCUX_HAS_driver_tempmon
    bool

config MCUX_USE_driver_tempmon
    depends on MCUX_HAS_driver_tempmon
    bool "TEMPMON Driver"
    select MCUX_USE_driver_common
    help
      TEMPMON Driver
```

## drivers/tempsensor/Kconfig
```kconfig
# Copyright 2023 NXP
# All rights reserved.
#
# SPDX-License-Identifier: BSD-3-Clause

# driver_tempsensor
config MCUX_HAS_driver_tempsensor
    bool

config MCUX_USE_driver_tempsensor
    depends on MCUX_HAS_driver_tempsensor
    bool "TEMPSENSOR Driver"
    select MCUX_USE_driver_common
    help
      TEMPSENSOR Driver
```

## drivers/tmu_1/Kconfig
```kconfig
# Copyright 2023 NXP
# All rights reserved.
#
# SPDX-License-Identifier: BSD-3-Clause

# driver_tmu_1
config MCUX_HAS_driver_tmu_1
    bool

config MCUX_USE_driver_tmu_1
    depends on MCUX_HAS_driver_tmu_1
    bool "TMU Driver"
    select MCUX_USE_driver_common
    help
      TMU Driver
```

## drivers/tmu_2/Kconfig
```kconfig
# Copyright 2023 NXP
# All rights reserved.
#
# SPDX-License-Identifier: BSD-3-Clause

# driver_tmu_2
config MCUX_HAS_driver_tmu_2
    bool

config MCUX_USE_driver_tmu_2
    depends on MCUX_HAS_driver_tmu_2
    bool "TMU Driver"
    select MCUX_USE_driver_common
    help
      TMU Driver
```

## drivers/trng/Kconfig
```kconfig
# Copyright 2023 NXP
# All rights reserved.
#
# SPDX-License-Identifier: BSD-3-Clause

# driver_trng
config MCUX_HAS_driver_trng
    bool

config MCUX_USE_driver_trng
    depends on MCUX_HAS_driver_trng
    bool "TRNG Driver"
    select MCUX_USE_driver_common
    help
      TRNG Driver
```

## drivers/tsc/Kconfig
```kconfig
# Copyright 2023 NXP
# All rights reserved.
#
# SPDX-License-Identifier: BSD-3-Clause

# driver_tsc
config MCUX_HAS_driver_tsc
    bool

config MCUX_USE_driver_tsc
    depends on MCUX_HAS_driver_tsc
    bool "TSC Driver"
    select MCUX_USE_driver_common
    help
      TSC Driver
```

## drivers/tsi/Kconfig
```kconfig
# Copyright 2023 NXP
# All rights reserved.
#
# SPDX-License-Identifier: BSD-3-Clause
rsource "./tsi_v4/Kconfig"
rsource "./tsi_v5/Kconfig"
```

## drivers/tsi/tsi_v4/Kconfig
```kconfig
# Copyright 2023 NXP
# All rights reserved.
#
# SPDX-License-Identifier: BSD-3-Clause

# driver_tsi_v4
config MCUX_HAS_driver_tsi_v4
    bool

config MCUX_USE_driver_tsi_v4
    depends on MCUX_HAS_driver_tsi_v4
    bool "TSI Driver"
    select MCUX_USE_driver_common
    help
      TSI Driver
```

## drivers/tsi/tsi_v5/Kconfig
```kconfig
# Copyright 2023 NXP
# All rights reserved.
#
# SPDX-License-Identifier: BSD-3-Clause

# driver_tsi_v5
config MCUX_HAS_driver_tsi_v5
    bool

config MCUX_USE_driver_tsi_v5
    depends on MCUX_HAS_driver_tsi_v5
    bool "TSI Driver"
    select MCUX_USE_driver_common
    help
      TSI Driver
```

## drivers/tstmr/Kconfig
```kconfig
# Copyright 2023 NXP
# All rights reserved.
#
# SPDX-License-Identifier: BSD-3-Clause

# driver_tstmr
config MCUX_HAS_driver_tstmr
    bool

config MCUX_USE_driver_tstmr
    depends on MCUX_HAS_driver_tstmr
    bool "TSTMR Driver"
    select MCUX_USE_driver_common
    help
      TSTMR Driver
```

## drivers/uart/Kconfig
```kconfig
# Copyright 2023 NXP
# All rights reserved.
#
# SPDX-License-Identifier: BSD-3-Clause

# driver_uart_edma
config MCUX_HAS_driver_uart_edma
    bool

config MCUX_USE_driver_uart_edma
    depends on MCUX_HAS_driver_uart_edma
    bool "UART EDMA Driver"
    select MCUX_USE_driver_uart
    help
      UART Driver

# driver_uart
config MCUX_HAS_driver_uart
    bool

config MCUX_USE_driver_uart
    depends on MCUX_HAS_driver_uart
    bool "UART Driver"
    select MCUX_USE_driver_common
    help
      UART Driver

# driver_uart_dma
config MCUX_HAS_driver_uart_dma
    bool

config MCUX_USE_driver_uart_dma
    depends on MCUX_HAS_driver_uart_dma
    bool "UART DMA Driver"
    select MCUX_USE_driver_uart
    help
      UART Driver
```

## drivers/usdhc/Kconfig
```kconfig
# Copyright 2023 NXP
# All rights reserved.
#
# SPDX-License-Identifier: BSD-3-Clause

# driver_usdhc
config MCUX_HAS_driver_usdhc
    bool

config MCUX_USE_driver_usdhc
    depends on MCUX_HAS_driver_usdhc
    bool "USDHC Driver"
    select MCUX_USE_driver_common
    help
      USDHC Driver
```

## drivers/utick/Kconfig
```kconfig
# Copyright 2023 NXP
# All rights reserved.
#
# SPDX-License-Identifier: BSD-3-Clause

# driver_utick
config MCUX_HAS_driver_utick
    bool

config MCUX_USE_driver_utick
    depends on MCUX_HAS_driver_utick
    bool "UTICK Driver"
    select MCUX_USE_driver_common
    help
      UTICK Driver
```

## drivers/vref/Kconfig
```kconfig
# Copyright 2023 NXP
# All rights reserved.
#
# SPDX-License-Identifier: BSD-3-Clause

# driver_vref
config MCUX_HAS_driver_vref
    bool

config MCUX_USE_driver_vref
    depends on MCUX_HAS_driver_vref
    bool "VREF Driver"
    select MCUX_USE_driver_common
    help
      VREF Driver
```

## drivers/wdog/Kconfig
```kconfig
# Copyright 2023 NXP
# All rights reserved.
#
# SPDX-License-Identifier: BSD-3-Clause

# driver_wdog
config MCUX_HAS_driver_wdog
    bool

config MCUX_USE_driver_wdog
    depends on MCUX_HAS_driver_wdog
    bool "WDOG Driver"
    select MCUX_USE_driver_common
    help
      WDOG Driver
```

## drivers/wdog01/Kconfig
```kconfig
# Copyright 2023 NXP
# All rights reserved.
#
# SPDX-License-Identifier: BSD-3-Clause

# driver_wdog01
config MCUX_HAS_driver_wdog01
    bool

config MCUX_USE_driver_wdog01
    depends on MCUX_HAS_driver_wdog01
    bool "wdog01 Driver"
    select MCUX_USE_driver_common
    help
      wdog01 Driver
```

## drivers/wdog32/Kconfig
```kconfig
# Copyright 2023 NXP
# All rights reserved.
#
# SPDX-License-Identifier: BSD-3-Clause

# driver_wdog32
config MCUX_HAS_driver_wdog32
    bool

config MCUX_USE_driver_wdog32
    depends on MCUX_HAS_driver_wdog32
    bool "WDOG32 Driver"
    select MCUX_USE_driver_common
    help
      WDOG32 Driver
```

## drivers/wdog8/Kconfig
```kconfig
# Copyright 2023 NXP
# All rights reserved.
#
# SPDX-License-Identifier: BSD-3-Clause

# driver_wdog8
config MCUX_HAS_driver_wdog8
    bool

config MCUX_USE_driver_wdog8
    depends on MCUX_HAS_driver_wdog8
    bool "WDOG Driver"
    select MCUX_USE_driver_common
    help
      WDOG Driver
```

## drivers/wkt/Kconfig
```kconfig
# Copyright 2023 NXP
# All rights reserved.
#
# SPDX-License-Identifier: BSD-3-Clause

# driver_wkt
config MCUX_HAS_driver_wkt
    bool

config MCUX_USE_driver_wkt
    depends on MCUX_HAS_driver_wkt
    bool "WKT Driver"
    select MCUX_USE_driver_common
    help
      WKT Driver
```

## drivers/wwdt/Kconfig
```kconfig
# Copyright 2023 NXP
# All rights reserved.
#
# SPDX-License-Identifier: BSD-3-Clause

# driver_wwdt
config MCUX_HAS_driver_wwdt
    bool

config MCUX_USE_driver_wwdt
    depends on MCUX_HAS_driver_wwdt
    bool "WWDT Driver"
    select MCUX_USE_driver_common
    help
      WWDT Driver
```

## drivers/xbar/Kconfig
```kconfig
# Copyright 2023 NXP
# All rights reserved.
#
# SPDX-License-Identifier: BSD-3-Clause

# driver_xbar
config MCUX_HAS_driver_xbar
    bool

config MCUX_USE_driver_xbar
    depends on MCUX_HAS_driver_xbar
    bool "XBAR Driver"
    select MCUX_USE_driver_common
    help
      XBAR Driver
```

## drivers/xbara/Kconfig
```kconfig
# Copyright 2023 NXP
# All rights reserved.
#
# SPDX-License-Identifier: BSD-3-Clause

# driver_xbara
config MCUX_HAS_driver_xbara
    bool

config MCUX_USE_driver_xbara
    depends on MCUX_HAS_driver_xbara
    bool "XBARA Driver"
    select MCUX_USE_driver_common
    help
      XBARA Driver
```

## drivers/xbarb/Kconfig
```kconfig
# Copyright 2023 NXP
# All rights reserved.
#
# SPDX-License-Identifier: BSD-3-Clause

# driver_xbarb
config MCUX_HAS_driver_xbarb
    bool

config MCUX_USE_driver_xbarb
    depends on MCUX_HAS_driver_xbarb
    bool "XBARB Driver"
    select MCUX_USE_driver_common
    help
      XBARB Driver
```
