## drivers/lpc_iopctl/Kconfig
```kconfig
# Copyright 2023 NXP
# All rights reserved.
#
# SPDX-License-Identifier: BSD-3-Clause

# driver_lpc_iopctl
config MCUX_HAS_driver_lpc_iopctl
    bool

config MCUX_USE_driver_lpc_iopctl
    depends on MCUX_HAS_driver_lpc_iopctl
    bool "iopctl Driver"
    select MCUX_USE_driver_common
    help
      iopctl Driver
```

## drivers/lpc_lcdc/Kconfig
```kconfig
# Copyright 2023 NXP
# All rights reserved.
#
# SPDX-License-Identifier: BSD-3-Clause

# driver_lpc_lcdc
config MCUX_HAS_driver_lpc_lcdc
    bool

config MCUX_USE_driver_lpc_lcdc
    depends on MCUX_HAS_driver_lpc_lcdc
    bool "LCDC Driver"
    select MCUX_USE_driver_common
    help
      LCDC Driver
```

## drivers/lpc_minispi/Kconfig
```kconfig
# Copyright 2023 NXP
# All rights reserved.
#
# SPDX-License-Identifier: BSD-3-Clause

# driver_lpc_minispi
config MCUX_HAS_driver_lpc_minispi
    bool

config MCUX_USE_driver_lpc_minispi
    depends on MCUX_HAS_driver_lpc_minispi
    bool "SPI Driver"
    select MCUX_USE_driver_common
    help
      SPI Driver
```

## drivers/lpc_miniusart/Kconfig
```kconfig
# Copyright 2023 NXP
# All rights reserved.
#
# SPDX-License-Identifier: BSD-3-Clause

# driver_lpc_miniusart
config MCUX_HAS_driver_lpc_miniusart
    bool

config MCUX_USE_driver_lpc_miniusart
    depends on MCUX_HAS_driver_lpc_miniusart
    bool "Usart Driver"
    select MCUX_USE_driver_common
    help
      USART Driver
```

## drivers/lpc_rit/Kconfig
```kconfig
# Copyright 2023 NXP
# All rights reserved.
#
# SPDX-License-Identifier: BSD-3-Clause

# driver_rit
config MCUX_HAS_driver_rit
    bool

config MCUX_USE_driver_rit
    depends on MCUX_HAS_driver_rit
    bool "RIT Driver"
    select MCUX_USE_driver_common
    help
      RIT Driver
```

## drivers/lpc_rtc/Kconfig
```kconfig
# Copyright 2023 NXP
# All rights reserved.
#
# SPDX-License-Identifier: BSD-3-Clause

# driver_lpc_rtc
config MCUX_HAS_driver_lpc_rtc
    bool

config MCUX_USE_driver_lpc_rtc
    depends on MCUX_HAS_driver_lpc_rtc
    bool "RTC Driver"
    select MCUX_USE_driver_common
    help
      RTC Driver
```

## drivers/lpcmp/Kconfig
```kconfig
# Copyright 2023 NXP
# All rights reserved.
#
# SPDX-License-Identifier: BSD-3-Clause

# driver_lpcmp
config MCUX_HAS_driver_lpcmp
    bool

config MCUX_USE_driver_lpcmp
    depends on MCUX_HAS_driver_lpcmp
    bool "LPCMP Driver"
    select MCUX_USE_driver_common
    help
      LPCMP Driver
```

## drivers/lpi2c/Kconfig
```kconfig
# Copyright 2023 NXP
# All rights reserved.
#
# SPDX-License-Identifier: BSD-3-Clause

# driver_lpi2c_edma
config MCUX_HAS_driver_lpi2c_edma
    bool

config MCUX_USE_driver_lpi2c_edma
    depends on MCUX_HAS_driver_lpi2c_edma
    bool "LPI2C Edma Driver"
    select MCUX_USE_driver_lpi2c
    help
      LPI2C Driver

# driver_lpi2c
config MCUX_HAS_driver_lpi2c
    bool

config MCUX_USE_driver_lpi2c
    depends on MCUX_HAS_driver_lpi2c
    bool "LPI2C Driver"
    select MCUX_USE_driver_common
    help
      LPI2C Driver
```

## drivers/lpit/Kconfig
```kconfig
# Copyright 2023 NXP
# All rights reserved.
#
# SPDX-License-Identifier: BSD-3-Clause

# driver_lpit
config MCUX_HAS_driver_lpit
    bool

config MCUX_USE_driver_lpit
    depends on MCUX_HAS_driver_lpit
    bool "LPIT Driver"
    select MCUX_USE_driver_common
    help
      LPIT Driver
```

## drivers/lpspi/Kconfig
```kconfig
# Copyright 2023 NXP
# All rights reserved.
#
# SPDX-License-Identifier: BSD-3-Clause

# driver_lpspi
config MCUX_HAS_driver_lpspi
    bool

config MCUX_USE_driver_lpspi
    depends on MCUX_HAS_driver_lpspi
    bool "LPSPI Driver"
    select MCUX_USE_driver_common
    help
      LPSPI Driver

# driver_lpspi_edma
config MCUX_HAS_driver_lpspi_edma
    bool

config MCUX_USE_driver_lpspi_edma
    depends on MCUX_HAS_driver_lpspi_edma
    bool "LPSPI Edma Driver"
    select MCUX_USE_driver_lpspi
    help
      LPSPI Driver
```

## drivers/lptmr/Kconfig
```kconfig
# Copyright 2023 NXP
# All rights reserved.
#
# SPDX-License-Identifier: BSD-3-Clause

# driver_lptmr
config MCUX_HAS_driver_lptmr
    bool

config MCUX_USE_driver_lptmr
    depends on MCUX_HAS_driver_lptmr
    bool "LPTMR Driver"
    select MCUX_USE_driver_common
    help
      LPTMR Driver
```

## drivers/lpuart/Kconfig
```kconfig
# Copyright 2023 NXP
# All rights reserved.
#
# SPDX-License-Identifier: BSD-3-Clause

# driver_lpuart_dma
config MCUX_HAS_driver_lpuart_dma
    bool

config MCUX_USE_driver_lpuart_dma
    depends on MCUX_HAS_driver_lpuart_dma
    bool "LPUART DMA Driver"
    select MCUX_USE_driver_lpuart
    help
      LPUART Driver

# driver_lpuart
config MCUX_HAS_driver_lpuart
    bool

config MCUX_USE_driver_lpuart
    depends on MCUX_HAS_driver_lpuart
    bool "LPUART Driver"
    select MCUX_USE_driver_common
    help
      LPUART Driver

# driver_lpuart_edma
config MCUX_HAS_driver_lpuart_edma
    bool

config MCUX_USE_driver_lpuart_edma
    depends on MCUX_HAS_driver_lpuart_edma
    bool "LPUART Edma Driver"
    select MCUX_USE_driver_lpuart
    help
      LPUART Driver
```

## drivers/ltc/Kconfig
```kconfig
# Copyright 2023 NXP
# All rights reserved.
#
# SPDX-License-Identifier: BSD-3-Clause

# driver_ltc
config MCUX_HAS_driver_ltc
    bool

config MCUX_USE_driver_ltc
    depends on MCUX_HAS_driver_ltc
    bool "LTC Driver"
    select MCUX_USE_driver_common
    help
      LTC Driver

# driver_ltc_edma
config MCUX_HAS_driver_ltc_edma
    bool

config MCUX_USE_driver_ltc_edma
    depends on MCUX_HAS_driver_ltc_edma
    bool "LTC EDMA Driver"
    select MCUX_USE_driver_ltc
    help
      LTC Driver
```

## drivers/mailbox/Kconfig
```kconfig
# Copyright 2023 NXP
# All rights reserved.
#
# SPDX-License-Identifier: BSD-3-Clause

# driver_mailbox
config MCUX_HAS_driver_mailbox
    bool

config MCUX_USE_driver_mailbox
    depends on MCUX_HAS_driver_mailbox
    bool "MAILBOX Driver"
    select MCUX_USE_driver_common
    help
      MAILBOX Driver
```

## drivers/mecc/Kconfig
```kconfig
# Copyright 2023 NXP
# All rights reserved.
#
# SPDX-License-Identifier: BSD-3-Clause

# driver_mecc
config MCUX_HAS_driver_mecc
    bool

config MCUX_USE_driver_mecc
    depends on MCUX_HAS_driver_mecc
    bool "MECC Driver"
    select MCUX_USE_driver_common
    help
      MECC Driver
```

## drivers/mipi_csi2rx/Kconfig
```kconfig
# Copyright 2023 NXP
# All rights reserved.
#
# SPDX-License-Identifier: BSD-3-Clause

# driver_mipi_csi2rx
config MCUX_HAS_driver_mipi_csi2rx
    bool

config MCUX_USE_driver_mipi_csi2rx
    depends on MCUX_HAS_driver_mipi_csi2rx
    bool "MIPI CSI2RX Driver"
    select MCUX_USE_driver_common
    help
      MIPI CSI2RX Driver
```

## drivers/mipi_dsi/Kconfig
```kconfig
# Copyright 2023 NXP
# All rights reserved.
#
# SPDX-License-Identifier: BSD-3-Clause

# driver_mipi_dsi_smartdma
config MCUX_HAS_driver_mipi_dsi_smartdma
    bool

config MCUX_USE_driver_mipi_dsi_smartdma
    depends on MCUX_HAS_driver_mipi_dsi_smartdma
    bool "MIPI DSI SMARTDMA Driver"
    select MCUX_USE_driver_mipi_dsi
    help
      MIPI DSI Driver

# driver_mipi_dsi
config MCUX_HAS_driver_mipi_dsi
    bool

config MCUX_USE_driver_mipi_dsi
    depends on MCUX_HAS_driver_mipi_dsi
    bool "MIPI DSI Driver"
    select MCUX_USE_driver_common
    select MCUX_USE_driver_soc_mipi_dsi
    help
      MIPI DSI Driver
```

## drivers/mipi_dsi_split/Kconfig
```kconfig
# Copyright 2023 NXP
# All rights reserved.
#
# SPDX-License-Identifier: BSD-3-Clause

# driver_mipi_dsi_split
config MCUX_HAS_driver_mipi_dsi_split
    bool

config MCUX_USE_driver_mipi_dsi_split
    depends on MCUX_HAS_driver_mipi_dsi_split
    bool "MIPI DSI Driver"
    select MCUX_USE_driver_common
    select MCUX_USE_driver_soc_mipi_csi2rx
    help
      MIPI DSI Driver
```

## drivers/mmau/Kconfig
```kconfig
# Copyright 2023 NXP
# All rights reserved.
#
# SPDX-License-Identifier: BSD-3-Clause

# driver_mmau
config MCUX_HAS_driver_mmau
    bool

config MCUX_USE_driver_mmau
    depends on MCUX_HAS_driver_mmau
    bool "MMAU Driver"
    select MCUX_USE_driver_common
    help
      MMAU Driver
```

## drivers/mmdvsq/Kconfig
```kconfig
# Copyright 2023 NXP
# All rights reserved.
#
# SPDX-License-Identifier: BSD-3-Clause

# driver_mmdvsq
config MCUX_HAS_driver_mmdvsq
    bool

config MCUX_USE_driver_mmdvsq
    depends on MCUX_HAS_driver_mmdvsq
    bool "MMDVSQ Driver"
    select MCUX_USE_driver_common
    help
      MMDVSQ Driver
```

## drivers/mrt/Kconfig
```kconfig
# Copyright 2023 NXP
# All rights reserved.
#
# SPDX-License-Identifier: BSD-3-Clause

# driver_mrt
config MCUX_HAS_driver_mrt
    bool

config MCUX_USE_driver_mrt
    depends on MCUX_HAS_driver_mrt
    bool "MRT Driver"
    select MCUX_USE_driver_common
    help
      MRT Driver
```

## drivers/mscan/Kconfig
```kconfig
# Copyright 2023 NXP
# All rights reserved.
#
# SPDX-License-Identifier: BSD-3-Clause

# driver_mscan
config MCUX_HAS_driver_mscan
    bool

config MCUX_USE_driver_mscan
    depends on MCUX_HAS_driver_mscan
    bool "MSCAN Driver"
    select MCUX_USE_driver_common
    help
      MSCAN Driver
```

## drivers/msmc/Kconfig
```kconfig
# Copyright 2023 NXP
# All rights reserved.
#
# SPDX-License-Identifier: BSD-3-Clause

# driver_msmc
config MCUX_HAS_driver_msmc
    bool

config MCUX_USE_driver_msmc
    depends on MCUX_HAS_driver_msmc
    bool "MSMC Driver"
    select MCUX_USE_driver_common
    help
      MSMC Driver
```

## drivers/mu/Kconfig
```kconfig
# Copyright 2023 NXP
# All rights reserved.
#
# SPDX-License-Identifier: BSD-3-Clause

# driver_mu
config MCUX_HAS_driver_mu
    bool

config MCUX_USE_driver_mu
    depends on MCUX_HAS_driver_mu
    bool "MU Driver"
    select MCUX_USE_driver_common
    help
      MU Driver
```

## drivers/mu1/Kconfig
```kconfig
# Copyright 2024 NXP
#
# SPDX-License-Identifier: BSD-3-Clause

# driver_mu1
config MCUX_HAS_driver_mu1
    bool

config MCUX_USE_driver_mu1
    depends on MCUX_HAS_driver_mu1
    bool "MU1 Driver"
    select MCUX_USE_driver_common
    help
      MU1 Driver
```
