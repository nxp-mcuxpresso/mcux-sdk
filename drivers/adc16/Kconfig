## drivers/adc16/Kconfig
```kconfig
# Copyright 2023 NXP
# All rights reserved.
#
# SPDX-License-Identifier: BSD-3-Clause

# driver_adc16
config MCUX_HAS_driver_adc16
    bool

config MCUX_USE_driver_adc16
    depends on MCUX_HAS_driver_adc16
    bool "ADC16 Driver"
    select MCUX_USE_driver_common
    help
      ADC16 Driver
```

## drivers/adc_12b1msps_sar/Kconfig
```kconfig
# Copyright 2023 NXP
# All rights reserved.
#
# SPDX-License-Identifier: BSD-3-Clause

# driver_adc_12b1msps_sar
config MCUX_HAS_driver_adc_12b1msps_sar
    bool

config MCUX_USE_driver_adc_12b1msps_sar
    depends on MCUX_HAS_driver_adc_12b1msps_sar
    bool "ADC Driver"
    select MCUX_USE_driver_common
    help
      ADC Driver
```

## drivers/adc_5v12b_ll18_015/Kconfig
```kconfig
# Copyright 2023 NXP
# All rights reserved.
#
# SPDX-License-Identifier: BSD-3-Clause

# driver_adc_5v12b_ll18_015
config MCUX_HAS_driver_adc_5v12b_ll18_015
    bool

config MCUX_USE_driver_adc_5v12b_ll18_015
    depends on MCUX_HAS_driver_adc_5v12b_ll18_015
    bool "ADC12 Driver"
    select MCUX_USE_driver_common
    help
      ADC12 Driver
```

## drivers/adc_etc/Kconfig
```kconfig
# Copyright 2023 NXP
# All rights reserved.
#
# SPDX-License-Identifier: BSD-3-Clause

# driver_adc_etc
config MCUX_HAS_driver_adc_etc
    bool

config MCUX_USE_driver_adc_etc
    depends on MCUX_HAS_driver_adc_etc
    bool "ADC_ETC Driver"
    select MCUX_USE_driver_common
    help
      ADC_ETC Driver
```

## drivers/aes/Kconfig
```kconfig
# Copyright 2023 NXP
# All rights reserved.
#
# SPDX-License-Identifier: BSD-3-Clause

# driver_aes
config MCUX_HAS_driver_aes
    bool

config MCUX_USE_driver_aes
    depends on MCUX_HAS_driver_aes
    bool "AES Driver"
    select MCUX_USE_driver_common
    help
      AES Driver
```

## drivers/afe/Kconfig
```kconfig
# Copyright 2023 NXP
# All rights reserved.
#
# SPDX-License-Identifier: BSD-3-Clause

# driver_afe
config MCUX_HAS_driver_afe
    bool

config MCUX_USE_driver_afe
    depends on MCUX_HAS_driver_afe
    bool "AFE Driver"
    select MCUX_USE_driver_common
    help
      AFE Driver
```

## drivers/aipstz/Kconfig
```kconfig
# Copyright 2023 NXP
# All rights reserved.
#
# SPDX-License-Identifier: BSD-3-Clause

# driver_aipstz
config MCUX_HAS_driver_aipstz
    bool

config MCUX_USE_driver_aipstz
    depends on MCUX_HAS_driver_aipstz
    bool "AIPSTZ Driver"
    select MCUX_USE_driver_common
    help
      aipstz Driver
```

## drivers/anactrl/Kconfig
```kconfig
# Copyright 2023 NXP
# All rights reserved.
#
# SPDX-License-Identifier: BSD-3-Clause

# driver_anactrl
config MCUX_HAS_driver_anactrl
    bool

config MCUX_USE_driver_anactrl
    depends on MCUX_HAS_driver_anactrl
    bool "anactrl Driver"
    select MCUX_USE_driver_common
    help
      anactrl Driver
```

## drivers/aoi/Kconfig
```kconfig
# Copyright 2023 NXP
# All rights reserved.
#
# SPDX-License-Identifier: BSD-3-Clause

# driver_aoi
config MCUX_HAS_driver_aoi
    bool

config MCUX_USE_driver_aoi
    depends on MCUX_HAS_driver_aoi
    bool "AOI Driver"
    select MCUX_USE_driver_common
    help
      AOI Driver
```

## drivers/asrc/Kconfig
```kconfig
# Copyright 2023 NXP
# All rights reserved.
#
# SPDX-License-Identifier: BSD-3-Clause

# driver_asrc
config MCUX_HAS_driver_asrc
    bool

config MCUX_USE_driver_asrc
    depends on MCUX_HAS_driver_asrc
    bool "asrc Driver"
    select MCUX_USE_driver_common
    help
      asrc Driver

# driver_asrc_edma
config MCUX_HAS_driver_asrc_edma
    bool

config MCUX_USE_driver_asrc_edma
    depends on MCUX_HAS_driver_asrc_edma
    bool "asrc_edma Driver"
    select MCUX_USE_driver_common
    select MCUX_USE_driver_asrc
    help
      asrc_edma Driver
```

## drivers/bee/Kconfig
```kconfig
# Copyright 2023 NXP
# All rights reserved.
#
# SPDX-License-Identifier: BSD-3-Clause

# driver_bee
config MCUX_HAS_driver_bee
    bool

config MCUX_USE_driver_bee
    depends on MCUX_HAS_driver_bee
    bool "BEE Driver"
    select MCUX_USE_driver_common
    help
      BEE Driver
```

## drivers/cache/Kconfig
```kconfig
# Copyright 2023 NXP
# All rights reserved.
#
# SPDX-License-Identifier: BSD-3-Clause
rsource "./armv7-m7/Kconfig"
rsource "./cache64/Kconfig"
rsource "./lmem/Kconfig"
```

## drivers/cache/armv7-m7/Kconfig
```kconfig
# Copyright 2023 NXP
# All rights reserved.
#
# SPDX-License-Identifier: BSD-3-Clause

# driver_cache_armv7_m7
config MCUX_HAS_driver_cache_armv7_m7
    bool

config MCUX_USE_driver_cache_armv7_m7
    depends on MCUX_HAS_driver_cache_armv7_m7
    bool "CACHE Driver"
    select MCUX_USE_driver_common
    help
      CACHE Driver
```

## drivers/cache/cache64/Kconfig
```kconfig
# Copyright 2023 NXP
# All rights reserved.
#
# SPDX-License-Identifier: BSD-3-Clause

# driver_cache_cache64
config MCUX_HAS_driver_cache_cache64
    bool

config MCUX_USE_driver_cache_cache64
    depends on MCUX_HAS_driver_cache_cache64
    bool "CACHE Driver"
    select MCUX_USE_driver_common
    help
      CACHE Driver
```

## drivers/cache/lmem/Kconfig
```kconfig
# Copyright 2023 NXP
# All rights reserved.
#
# SPDX-License-Identifier: BSD-3-Clause

# driver_cache_lmem
config MCUX_HAS_driver_cache_lmem
    bool

config MCUX_USE_driver_cache_lmem
    depends on MCUX_HAS_driver_cache_lmem
    bool "CACHE LMEM Driver"
    select MCUX_USE_driver_common
    help
      CACHE LMEM Driver
```

## drivers/capt/Kconfig
```kconfig
# Copyright 2023 NXP
# All rights reserved.
#
# SPDX-License-Identifier: BSD-3-Clause

# driver_capt
config MCUX_HAS_driver_capt
    bool

config MCUX_USE_driver_capt
    depends on MCUX_HAS_driver_capt
    bool "CAPT Driver"
    select MCUX_USE_driver_common
    help
      CAPT Driver
```

## drivers/casper/Kconfig
```kconfig
# Copyright 2023 NXP
# All rights reserved.
#
# SPDX-License-Identifier: BSD-3-Clause

# driver_casper
config MCUX_HAS_driver_casper
    bool

config MCUX_USE_driver_casper
    depends on MCUX_HAS_driver_casper
    bool "CASPER Driver"
    select MCUX_USE_driver_common
    help
      CASPER Driver
```

## drivers/cau3/Kconfig
```kconfig
# Copyright 2023 NXP
# All rights reserved.
#
# SPDX-License-Identifier: BSD-3-Clause

# driver_cau3
config MCUX_HAS_driver_cau3
    bool

config MCUX_USE_driver_cau3
    depends on MCUX_HAS_driver_cau3
    bool "CAU3 Driver"
    select MCUX_USE_driver_common
    help
      CAU3 Driver
```

## drivers/cmp/Kconfig
```kconfig
# Copyright 2023 NXP
# All rights reserved.
#
# SPDX-License-Identifier: BSD-3-Clause

# driver_cmp
config MCUX_HAS_driver_cmp
    bool

config MCUX_USE_driver_cmp
    depends on MCUX_HAS_driver_cmp
    bool "CMP Driver"
    select MCUX_USE_driver_common
    help
      CMP Driver
```

## drivers/cmp_1/Kconfig
```kconfig
# Copyright 2023 NXP
# All rights reserved.
#
# SPDX-License-Identifier: BSD-3-Clause

# driver_cmp_1
config MCUX_HAS_driver_cmp_1
    bool

config MCUX_USE_driver_cmp_1
    depends on MCUX_HAS_driver_cmp_1
    bool "cmp_1 Driver"
    select MCUX_USE_driver_common
    help
      cmp_1 Driver
```

## drivers/common/Kconfig
```kconfig
# Copyright 2023 NXP
# All rights reserved.
#
# SPDX-License-Identifier: BSD-3-Clause

# driver_common
config MCUX_HAS_driver_common
    bool

config MCUX_USE_driver_common
    depends on MCUX_HAS_driver_common
    bool "COMMON Driver"
    help
      COMMON Driver
```

## drivers/cop/Kconfig
```kconfig
# Copyright 2023 NXP
# All rights reserved.
#
# SPDX-License-Identifier: BSD-3-Clause

# driver_cop
config MCUX_HAS_driver_cop
    bool

config MCUX_USE_driver_cop
    depends on MCUX_HAS_driver_cop
    bool "COP Driver"
    select MCUX_USE_driver_common
    help
      COP Driver
```

## drivers/crc/Kconfig
```kconfig
# Copyright 2023 NXP
# All rights reserved.
#
# SPDX-License-Identifier: BSD-3-Clause

# driver_crc
config MCUX_HAS_driver_crc
    bool

config MCUX_USE_driver_crc
    depends on MCUX_HAS_driver_crc
    bool "CRC Driver"
    select MCUX_USE_driver_common
    help
      CRC Driver
```

## drivers/csi/Kconfig
```kconfig
# Copyright 2023 NXP
# All rights reserved.
#
# SPDX-License-Identifier: BSD-3-Clause

# driver_csi
config MCUX_HAS_driver_csi
    bool

config MCUX_USE_driver_csi
    depends on MCUX_HAS_driver_csi
    bool "CSI Driver"
    select MCUX_USE_driver_common
    help
      CSI Driver
```

## drivers/ctimer/Kconfig
```kconfig
# Copyright 2023 NXP
# All rights reserved.
#
# SPDX-License-Identifier: BSD-3-Clause

# driver_ctimer
config MCUX_HAS_driver_ctimer
    bool

config MCUX_USE_driver_ctimer
    depends on MCUX_HAS_driver_ctimer
    bool "CTimer Driver"
    select MCUX_USE_driver_common
    help
      CTimer Driver
```
