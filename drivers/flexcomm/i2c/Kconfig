## drivers/flexcomm/i2c/Kconfig
```kconfig
# Copyright 2023 NXP
# All rights reserved.
#
# SPDX-License-Identifier: BSD-3-Clause

# driver_flexcomm_i2c
config MCUX_HAS_driver_flexcomm_i2c
    bool

config MCUX_USE_driver_flexcomm_i2c
    depends on MCUX_HAS_driver_flexcomm_i2c
    bool "FLEXCOMM I2C Driver"
    select MCUX_USE_driver_flexcomm
    select MCUX_USE_driver_common
    help
      I2C Driver

# driver_flexcomm_i2c_dma
config MCUX_HAS_driver_flexcomm_i2c_dma
    bool

config MCUX_USE_driver_flexcomm_i2c_dma
    depends on MCUX_HAS_driver_flexcomm_i2c_dma
    bool "FLEXCOMM I2C DMA Driver"
    select MCUX_USE_driver_flexcomm
    select MCUX_USE_driver_common
    select MCUX_USE_driver_flexcomm_i2c
    help
      I2C Driver
```

## drivers/flexcomm/i2s/Kconfig
```kconfig
# Copyright 2023 NXP
# All rights reserved.
#
# SPDX-License-Identifier: BSD-3-Clause

# driver_flexcomm_i2s
config MCUX_HAS_driver_flexcomm_i2s
    bool

config MCUX_USE_driver_flexcomm_i2s
    depends on MCUX_HAS_driver_flexcomm_i2s
    bool "FLEXCOMM I2S Driver"
    select MCUX_USE_driver_flexcomm
    select MCUX_USE_driver_common
    help
      I2S Driver

# driver_flexcomm_i2s_dma
config MCUX_HAS_driver_flexcomm_i2s_dma
    bool

config MCUX_USE_driver_flexcomm_i2s_dma
    depends on MCUX_HAS_driver_flexcomm_i2s_dma
    bool "FLEXCOMM I2S DMA Driver"
    select MCUX_USE_driver_flexcomm_i2s
    help
      I2S Driver
```

## drivers/flexcomm/spi/Kconfig
```kconfig
# Copyright 2023 NXP
# All rights reserved.
#
# SPDX-License-Identifier: BSD-3-Clause

# driver_flexcomm_spi
config MCUX_HAS_driver_flexcomm_spi
    bool

config MCUX_USE_driver_flexcomm_spi
    depends on MCUX_HAS_driver_flexcomm_spi
    bool "FLEXCOMM SPI Driver"
    select MCUX_USE_driver_flexcomm
    select MCUX_USE_driver_common
    help
      SPI Driver

# driver_flexcomm_spi_dma
config MCUX_HAS_driver_flexcomm_spi_dma
    bool

config MCUX_USE_driver_flexcomm_spi_dma
    depends on MCUX_HAS_driver_flexcomm_spi_dma
    bool "FLEXCOMM SPI DMA Driver"
    select MCUX_USE_driver_flexcomm
    select MCUX_USE_driver_flexcomm_spi
    help
      SPI Driver
```

## drivers/flexcomm/usart/Kconfig
```kconfig
# Copyright 2023 NXP
# All rights reserved.
#
# SPDX-License-Identifier: BSD-3-Clause

# driver_flexcomm_usart
config MCUX_HAS_driver_flexcomm_usart
    bool

config MCUX_USE_driver_flexcomm_usart
    depends on MCUX_HAS_driver_flexcomm_usart
    bool "FLEXCOMM USART Driver"
    select MCUX_USE_driver_flexcomm
    help
      USART Driver

# driver_flexcomm_usart_dma
config MCUX_HAS_driver_flexcomm_usart_dma
    bool

config MCUX_USE_driver_flexcomm_usart_dma
    depends on MCUX_HAS_driver_flexcomm_usart_dma
    bool "FLEXCOMM USART DMA Driver"
    select MCUX_USE_driver_flexcomm
    select MCUX_USE_driver_flexcomm_usart
    help
      USART Driver
```

## drivers/flexio/Kconfig
```kconfig
# Copyright 2023 NXP
# All rights reserved.
#
# SPDX-License-Identifier: BSD-3-Clause

# driver_flexio
config MCUX_HAS_driver_flexio
    bool

config MCUX_USE_driver_flexio
    depends on MCUX_HAS_driver_flexio
    bool "FLEXIO Driver"
    select MCUX_USE_driver_common
    help
      FLEXIO Driver

rsource "./camera/Kconfig"
rsource "./i2c/Kconfig"
rsource "./i2s/Kconfig"
rsource "./mculcd/Kconfig"
rsource "./spi/Kconfig"
rsource "./uart/Kconfig"
```

## drivers/flexio/camera/Kconfig
```kconfig
# Copyright 2023 NXP
# All rights reserved.
#
# SPDX-License-Identifier: BSD-3-Clause

# driver_flexio_camera_edma
config MCUX_HAS_driver_flexio_camera_edma
    bool

config MCUX_USE_driver_flexio_camera_edma
    depends on MCUX_HAS_driver_flexio_camera_edma
    bool "FLEXIO CAMERA EDMA Driver"
    select MCUX_USE_driver_flexio_camera
    help
      FLEXIO CAMERA EDMA Driver

# driver_flexio_camera
config MCUX_HAS_driver_flexio_camera
    bool

config MCUX_USE_driver_flexio_camera
    depends on MCUX_HAS_driver_flexio_camera
    bool "FLEXIO CAMERA Driver"
    select MCUX_USE_driver_flexio
    help
      FLEXIO Driver
```

## drivers/flexio/i2c/Kconfig
```kconfig
# Copyright 2023 NXP
# All rights reserved.
#
# SPDX-License-Identifier: BSD-3-Clause

# driver_flexio_i2c_master
config MCUX_HAS_driver_flexio_i2c_master
    bool

config MCUX_USE_driver_flexio_i2c_master
    depends on MCUX_HAS_driver_flexio_i2c_master
    bool "FLEXIO I2C Driver"
    select MCUX_USE_driver_flexio
    help
      FLEXIO I2C Driver
```

## drivers/flexio/i2s/Kconfig
```kconfig
# Copyright 2023 NXP
# All rights reserved.
#
# SPDX-License-Identifier: BSD-3-Clause

# driver_flexio_i2s_dma
config MCUX_HAS_driver_flexio_i2s_dma
    bool

config MCUX_USE_driver_flexio_i2s_dma
    depends on MCUX_HAS_driver_flexio_i2s_dma
    bool "FLEXIO I2S DMA Driver"
    select MCUX_USE_driver_flexio_i2s
    help
      FLEXIO I2S DMA Driver

# driver_flexio_i2s
config MCUX_HAS_driver_flexio_i2s
    bool

config MCUX_USE_driver_flexio_i2s
    depends on MCUX_HAS_driver_flexio_i2s
    bool "FLEXIO I2S Driver"
    select MCUX_USE_driver_flexio
    help
      FLEXIO I2S Driver

# driver_flexio_i2s_edma
config MCUX_HAS_driver_flexio_i2s_edma
    bool

config MCUX_USE_driver_flexio_i2s_edma
    depends on MCUX_HAS_driver_flexio_i2s_edma
    bool "FLEXIO I2S EDMA Driver"
    select MCUX_USE_driver_flexio_i2s
    help
      FLEXIO I2S EDMA Driver
```

## drivers/flexio/mculcd/Kconfig
```kconfig
# Copyright 2023 NXP
# All rights reserved.
#
# SPDX-License-Identifier: BSD-3-Clause

# driver_flexio_mculcd_edma
config MCUX_HAS_driver_flexio_mculcd_edma
    bool

config MCUX_USE_driver_flexio_mculcd_edma
    depends on MCUX_HAS_driver_flexio_mculcd_edma
    bool "FLEXIO MCULCD EDMA Driver"
    select MCUX_USE_driver_flexio_mculcd
    help
      FLEXIO MCULCD EDMA Driver

# driver_flexio_mculcd
config MCUX_HAS_driver_flexio_mculcd
    bool

config MCUX_USE_driver_flexio_mculcd
    depends on MCUX_HAS_driver_flexio_mculcd
    bool "FLEXIO MCULCD Driver"
    select MCUX_USE_driver_flexio
    help
      FLEXIO MCULCD Driver

# driver_flexio_mculcd_smartdma
config MCUX_HAS_driver_flexio_mculcd_smartdma
    bool

config MCUX_USE_driver_flexio_mculcd_smartdma
    depends on MCUX_HAS_driver_flexio_mculcd_smartdma
    bool "FLEXIO MCULCD SMARTDMA Driver"
    select MCUX_USE_driver_flexio_mculcd
    help
      FLEXIO MCULCD SMARTDMA Driver
```

## drivers/flexio/spi/Kconfig
```kconfig
# Copyright 2023 NXP
# All rights reserved.
#
# SPDX-License-Identifier: BSD-3-Clause

# driver_flexio_spi_edma
config MCUX_HAS_driver_flexio_spi_edma
    bool

config MCUX_USE_driver_flexio_spi_edma
    depends on MCUX_HAS_driver_flexio_spi_edma
    bool "FLEXIO SPI EDMA Driver"
    select MCUX_USE_driver_flexio_spi
    help
      FLEXIO SPI EDMA Driver

# driver_flexio_spi
config MCUX_HAS_driver_flexio_spi
    bool

config MCUX_USE_driver_flexio_spi
    depends on MCUX_HAS_driver_flexio_spi
    bool "FLEXIO SPI Driver"
    select MCUX_USE_driver_flexio
    help
      FLEXIO SPI Driver

# driver_flexio_spi_dma
config MCUX_HAS_driver_flexio_spi_dma
    bool

config MCUX_USE_driver_flexio_spi_dma
    depends on MCUX_HAS_driver_flexio_spi_dma
    bool "FLEXIO SPI DMA Driver"
    select MCUX_USE_driver_flexio_spi
    help
      FLEXIO SPI DMA Driver
```

## drivers/flexio/uart/Kconfig
```kconfig
# Copyright 2023 NXP
# All rights reserved.
#
# SPDX-License-Identifier: BSD-3-Clause

# driver_flexio_uart_edma
config MCUX_HAS_driver_flexio_uart_edma
    bool

config MCUX_USE_driver_flexio_uart_edma
    depends on MCUX_HAS_driver_flexio_uart_edma
    bool "FLEXIO UART EDMA Driver"
    select MCUX_USE_driver_flexio_uart
    help
      FLEXIO UART EDMA Driver

# driver_flexio_uart_dma
config MCUX_HAS_driver_flexio_uart_dma
    bool

config MCUX_USE_driver_flexio_uart_dma
    depends on MCUX_HAS_driver_flexio_uart_dma
    bool "FLEXIO UART DMA Driver"
    select MCUX_USE_driver_flexio_uart
    help
      FLEXIO UART DMA Driver

# driver_flexio_uart
config MCUX_HAS_driver_flexio_uart
    bool

config MCUX_USE_driver_flexio_uart
    depends on MCUX_HAS_driver_flexio_uart
    bool "FLEXIO UART Driver"
    select MCUX_USE_driver_flexio
    help
      FLEXIO UART Driver
```

## drivers/flexram/Kconfig
```kconfig
# Copyright 2023 NXP
# All rights reserved.
#
# SPDX-License-Identifier: BSD-3-Clause

# driver_flexram
config MCUX_HAS_driver_flexram
    bool

config MCUX_USE_driver_flexram
    depends on MCUX_HAS_driver_flexram
    bool "FLEXRAM Driver"
    select MCUX_USE_driver_common
    select MCUX_USE_driver_soc_flexram_allocate
    help
      FLEXRAM Driver
```

## drivers/flexspi/Kconfig
```kconfig
# Copyright 2023 NXP
# All rights reserved.
#
# SPDX-License-Identifier: BSD-3-Clause

# driver_flexspi_edma
config MCUX_HAS_driver_flexspi_edma
    bool

config MCUX_USE_driver_flexspi_edma
    depends on MCUX_HAS_driver_flexspi_edma
    bool "FLEXSPI EDMA Driver"
    select MCUX_USE_driver_flexspi
    help
      FLEXSPI Driver

# driver_flexspi
config MCUX_HAS_driver_flexspi
    bool

config MCUX_USE_driver_flexspi
    depends on MCUX_HAS_driver_flexspi
    bool "FLEXSPI Driver"
    select MCUX_USE_driver_common
    help
      FLEXSPI Driver

# driver_flexspi_dma
config MCUX_HAS_driver_flexspi_dma
    bool

config MCUX_USE_driver_flexspi_dma
    depends on MCUX_HAS_driver_flexspi_dma
    bool "FLEXSPI DMA Driver"
    select MCUX_USE_driver_flexspi
    help
      FLEXSPI DMA Driver
```

## drivers/fmc/Kconfig
```kconfig
# Copyright 2023 NXP
# All rights reserved.
#
# SPDX-License-Identifier: BSD-3-Clause

# driver_fmc
config MCUX_HAS_driver_fmc
    bool

config MCUX_USE_driver_fmc
    depends on MCUX_HAS_driver_fmc
    bool "fmc Driver"
    select MCUX_USE_driver_common
    help
      fmc Driver
```

## drivers/fmeas/Kconfig
```kconfig
# Copyright 2023 NXP
# All rights reserved.
#
# SPDX-License-Identifier: BSD-3-Clause

# driver_fmeas
config MCUX_HAS_driver_fmeas
    bool

config MCUX_USE_driver_fmeas
    depends on MCUX_HAS_driver_fmeas
    bool "FMEAS Driver"
    select MCUX_USE_driver_common
    help
      FMEAS Driver
```

## drivers/ftm/Kconfig
```kconfig
# Copyright 2023 NXP
# All rights reserved.
#
# SPDX-License-Identifier: BSD-3-Clause

# driver_ftm
config MCUX_HAS_driver_ftm
    bool

config MCUX_USE_driver_ftm
    depends on MCUX_HAS_driver_ftm
    bool "FTM Driver"
    select MCUX_USE_driver_common
    help
      FTM Driver
```

## drivers/gint/Kconfig
```kconfig
# Copyright 2023 NXP
# All rights reserved.
#
# SPDX-License-Identifier: BSD-3-Clause

# driver_gint
config MCUX_HAS_driver_gint
    bool

config MCUX_USE_driver_gint
    depends on MCUX_HAS_driver_gint
    bool "GINT Driver"
    select MCUX_USE_driver_common
    help
      GINT Driver
```

## drivers/gpc_1/Kconfig
```kconfig
# Copyright 2023 NXP
# All rights reserved.
#
# SPDX-License-Identifier: BSD-3-Clause

# driver_gpc_1
config MCUX_HAS_driver_gpc_1
    bool

config MCUX_USE_driver_gpc_1
    depends on MCUX_HAS_driver_gpc_1
    bool "GPC Driver"
    select MCUX_USE_driver_common
    help
      GPC Driver
```

## drivers/gpc_2/Kconfig
```kconfig
# Copyright 2023 NXP
# All rights reserved.
#
# SPDX-License-Identifier: BSD-3-Clause

# driver_gpc_2
config MCUX_HAS_driver_gpc_2
    bool

config MCUX_USE_driver_gpc_2
    depends on MCUX_HAS_driver_gpc_2
    bool "GPC Driver"
    select MCUX_USE_driver_common
    help
      GPC Driver
```

## drivers/gpio/Kconfig
```kconfig
# Copyright 2023 NXP
# All rights reserved.
#
# SPDX-License-Identifier: BSD-3-Clause

# driver_gpio
config MCUX_HAS_driver_gpio
    bool

config MCUX_USE_driver_gpio
    depends on MCUX_HAS_driver_gpio
    bool "GPIO Driver"
    select MCUX_USE_driver_common
    help
      GPIO Driver
```

## drivers/gpio_1/Kconfig
```kconfig
# Copyright 2023 NXP
# All rights reserved.
#
# SPDX-License-Identifier: BSD-3-Clause

# driver_gpio_1
config MCUX_HAS_driver_gpio_1
    bool

config MCUX_USE_driver_gpio_1
    depends on MCUX_HAS_driver_gpio_1
    bool "GPIO Driver"
    select MCUX_USE_driver_common
    help
      GPIO Driver
```

## drivers/gpt/Kconfig
```kconfig
# Copyright 2023 NXP
# All rights reserved.
#
# SPDX-License-Identifier: BSD-3-Clause

# driver_gpt
config MCUX_HAS_driver_gpt
    bool

config MCUX_USE_driver_gpt
    depends on MCUX_HAS_driver_gpt
    bool "GPT Driver"
    select MCUX_USE_driver_common
    help
      GPT Driver
```

## drivers/hashcrypt/Kconfig
```kconfig
# Copyright 2023 NXP
# All rights reserved.
#
# SPDX-License-Identifier: BSD-3-Clause

# driver_hashcrypt
config MCUX_HAS_driver_hashcrypt
    bool

config MCUX_USE_driver_hashcrypt
    depends on MCUX_HAS_driver_hashcrypt
    bool "Hashcrypt Driver"
    select MCUX_USE_driver_common
    help
      Hashcrypt Driver
```

## drivers/i2c/Kconfig
```kconfig
# Copyright 2023 NXP
# All rights reserved.
#
# SPDX-License-Identifier: BSD-3-Clause

# driver_i2c
config MCUX_HAS_driver_i2c
    bool

config MCUX_USE_driver_i2c
    depends on MCUX_HAS_driver_i2c
    bool "I2C Driver"
    select MCUX_USE_driver_common
    help
      I2C Driver

# driver_i2c_dma
config MCUX_HAS_driver_i2c_dma
    bool

config MCUX_USE_driver_i2c_dma
    depends on MCUX_HAS_driver_i2c_dma
    bool "I2C DMA Driver"
    select MCUX_USE_driver_i2c
    help
      I2C Driver

# driver_i2c_edma
config MCUX_HAS_driver_i2c_edma
    bool

config MCUX_USE_driver_i2c_edma
    depends on MCUX_HAS_driver_i2c_edma
    bool "I2C EDMA Driver"
    select MCUX_USE_driver_i2c
    help
      I2C Driver
```

## drivers/i3c/Kconfig
```kconfig
# Copyright 2023 NXP
# All rights reserved.
#
# SPDX-License-Identifier: BSD-3-Clause

# driver_i3c
config MCUX_HAS_driver_i3c
    bool

config MCUX_USE_driver_i3c
    depends on MCUX_HAS_driver_i3c
    bool "I3C Driver"
    select MCUX_USE_driver_common
    help
      I3C Driver
```
