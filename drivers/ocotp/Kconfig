## drivers/ocotp/Kconfig
```kconfig
# Copyright 2023 NXP
# All rights reserved.
#
# SPDX-License-Identifier: BSD-3-Clause

# driver_ocotp
config MCUX_HAS_driver_ocotp
    bool

config MCUX_USE_driver_ocotp
    depends on MCUX_HAS_driver_ocotp
    bool "OCOTP Driver"
    select MCUX_USE_driver_common
    help
      OCOTP Driver
```

## drivers/ostimer/Kconfig
```kconfig
# Copyright 2023 NXP
# All rights reserved.
#
# SPDX-License-Identifier: BSD-3-Clause

# driver_ostimer
config MCUX_HAS_driver_ostimer
    bool

config MCUX_USE_driver_ostimer
    depends on MCUX_HAS_driver_ostimer
    bool "OSTimer Driver"
    select MCUX_USE_driver_common
    help
      OSTimer Driver
```

## drivers/otfad/Kconfig
```kconfig
# Copyright 2023 NXP
# All rights reserved.
#
# SPDX-License-Identifier: BSD-3-Clause

# driver_otfad
config MCUX_HAS_driver_otfad
    bool

config MCUX_USE_driver_otfad
    depends on MCUX_HAS_driver_otfad
    bool "OTFAD Driver"
    select MCUX_USE_driver_common
    help
      OTFAD Driver
```

## drivers/otp/Kconfig
```kconfig
# Copyright 2023 NXP
# All rights reserved.
#
# SPDX-License-Identifier: BSD-3-Clause

# driver_otp
config MCUX_HAS_driver_otp
    bool

config MCUX_USE_driver_otp
    depends on MCUX_HAS_driver_otp
    bool "OTP Driver"
    select MCUX_USE_driver_common
    help
      OTP Driver
```

## drivers/pdm/Kconfig
```kconfig
# Copyright 2023 NXP
# All rights reserved.
#
# SPDX-License-Identifier: BSD-3-Clause

# driver_pdm_sdma
config MCUX_HAS_driver_pdm_sdma
    bool

config MCUX_USE_driver_pdm_sdma
    depends on MCUX_HAS_driver_pdm_sdma
    bool "PDM SDMA Driver"
    select MCUX_USE_driver_pdm
    help
      PDM SDMA Driver

# driver_pdm_edma
config MCUX_HAS_driver_pdm_edma
    bool

config MCUX_USE_driver_pdm_edma
    depends on MCUX_HAS_driver_pdm_edma
    bool "PDM EDMA Driver"
    select MCUX_USE_driver_pdm
    help
      PDM EDMA Driver

# driver_pdm
config MCUX_HAS_driver_pdm
    bool

config MCUX_USE_driver_pdm
    depends on MCUX_HAS_driver_pdm
    bool "PDM Driver"
    select MCUX_USE_driver_common
    help
      PDM Driver
```

## drivers/pint/Kconfig
```kconfig
# Copyright 2023 NXP
# All rights reserved.
#
# SPDX-License-Identifier: BSD-3-Clause

# driver_pint
config MCUX_HAS_driver_pint
    bool

config MCUX_USE_driver_pint
    depends on MCUX_HAS_driver_pint
    bool "PINT Driver"
    select MCUX_USE_driver_common
    help
      PINT Driver
```

## drivers/pit/Kconfig
```kconfig
# Copyright 2023 NXP
# All rights reserved.
#
# SPDX-License-Identifier: BSD-3-Clause

# driver_pit
config MCUX_HAS_driver_pit
    bool

config MCUX_USE_driver_pit
    depends on MCUX_HAS_driver_pit
    bool "PIT Driver"
    select MCUX_USE_driver_common
    help
      PIT Driver
```

## drivers/plu/Kconfig
```kconfig
# Copyright 2023 NXP
# All rights reserved.
#
# SPDX-License-Identifier: BSD-3-Clause

# driver_plu
config MCUX_HAS_driver_plu
    bool

config MCUX_USE_driver_plu
    depends on MCUX_HAS_driver_plu
    bool "PLU Driver"
    select MCUX_USE_driver_common
    help
      PLU Driver
```

## drivers/pmc/Kconfig
```kconfig
# Copyright 2023 NXP
# All rights reserved.
#
# SPDX-License-Identifier: BSD-3-Clause

# driver_pmc
config MCUX_HAS_driver_pmc
    bool

config MCUX_USE_driver_pmc
    depends on MCUX_HAS_driver_pmc
    bool "PMC Driver"
    select MCUX_USE_driver_common
    help
      PMC Driver
```

## drivers/pmc0/Kconfig
```kconfig
# Copyright 2023 NXP
# All rights reserved.
#
# SPDX-License-Identifier: BSD-3-Clause

# driver_pmc0
config MCUX_HAS_driver_pmc0
    bool

config MCUX_USE_driver_pmc0
    depends on MCUX_HAS_driver_pmc0
    bool "PMC0 Driver"
    select MCUX_USE_driver_common
    help
      PMC0 Driver
```

## drivers/pmu/Kconfig
```kconfig
# Copyright 2023 NXP
# All rights reserved.
#
# SPDX-License-Identifier: BSD-3-Clause

# driver_pmu
config MCUX_HAS_driver_pmu
    bool

config MCUX_USE_driver_pmu
    depends on MCUX_HAS_driver_pmu
    bool "pmu Driver"
    select MCUX_USE_driver_common
    help
      pmu Driver
```

## drivers/port/Kconfig
```kconfig
# Copyright 2023 NXP
# All rights reserved.
#
# SPDX-License-Identifier: BSD-3-Clause

# driver_port
config MCUX_HAS_driver_port
    bool

config MCUX_USE_driver_port
    depends on MCUX_HAS_driver_port
    bool "PORT Driver"
    select MCUX_USE_driver_common
    help
      PORT Driver
```

## drivers/powerquad/Kconfig
```kconfig
# Copyright 2023 NXP
# All rights reserved.
#
# SPDX-License-Identifier: BSD-3-Clause

# driver_powerquad
config MCUX_HAS_driver_powerquad
    bool

config MCUX_USE_driver_powerquad
    depends on MCUX_HAS_driver_powerquad
    bool "POWERQUAD Driver"
    select MCUX_USE_driver_common
    help
      POWERQUAD Driver

# driver_powerquad_cmsis
config MCUX_HAS_driver_powerquad_cmsis
    bool

config MCUX_USE_driver_powerquad_cmsis
    depends on MCUX_HAS_driver_powerquad_cmsis
    bool "POWERQUAD CMSIS DSP Driver"
    select MCUX_USE_driver_powerquad
    select MCUX_USE_CMSIS_DSP_Include
    help
      CMSIS DSP functions based on POWERQUAD
```

## drivers/prince/Kconfig
```kconfig
# Copyright 2023 NXP
# All rights reserved.
#
# SPDX-License-Identifier: BSD-3-Clause

# driver_prince
config MCUX_HAS_driver_prince
    bool

config MCUX_USE_driver_prince
    depends on MCUX_HAS_driver_prince
    bool "PRINCE Driver"
    select MCUX_USE_driver_common
    help
      PRINCE Driver
```

## drivers/puf/Kconfig
```kconfig
# Copyright 2023 NXP
# All rights reserved.
#
# SPDX-License-Identifier: BSD-3-Clause

# driver_puf
config MCUX_HAS_driver_puf
    bool

config MCUX_USE_driver_puf
    depends on MCUX_HAS_driver_puf
    bool "PUF Driver"
    select MCUX_USE_driver_common
    help
      PUF Driver
```

## drivers/pwm/Kconfig
```kconfig
# Copyright 2023 NXP
# All rights reserved.
#
# SPDX-License-Identifier: BSD-3-Clause

# driver_pwm
config MCUX_HAS_driver_pwm
    bool

config MCUX_USE_driver_pwm
    depends on MCUX_HAS_driver_pwm
    bool "PWM Driver"
    select MCUX_USE_driver_common
    help
      PWM Driver
```

## drivers/pwt/Kconfig
```kconfig
# Copyright 2023 NXP
# All rights reserved.
#
# SPDX-License-Identifier: BSD-3-Clause

# driver_pwt
config MCUX_HAS_driver_pwt
    bool

config MCUX_USE_driver_pwt
    depends on MCUX_HAS_driver_pwt
    bool "PWT Driver"
    select MCUX_USE_driver_common
    help
      PWT Driver
```

## drivers/pxp/Kconfig
```kconfig
# Copyright 2023 NXP
# All rights reserved.
#
# SPDX-License-Identifier: BSD-3-Clause

# driver_pxp
config MCUX_HAS_driver_pxp
    bool

config MCUX_USE_driver_pxp
    depends on MCUX_HAS_driver_pxp
    bool "PXP Driver"
    select MCUX_USE_driver_common
    help
      PXP Driver
```

## drivers/qspi/Kconfig
```kconfig
# Copyright 2023 NXP
# All rights reserved.
#
# SPDX-License-Identifier: BSD-3-Clause

# driver_qspi_edma
config MCUX_HAS_driver_qspi_edma
    bool

config MCUX_USE_driver_qspi_edma
    depends on MCUX_HAS_driver_qspi_edma
    bool "QSPI EDMA Driver"
    select MCUX_USE_driver_qspi
    help
      QSPI Driver

# driver_qspi
config MCUX_HAS_driver_qspi
    bool

config MCUX_USE_driver_qspi
    depends on MCUX_HAS_driver_qspi
    bool "QSPI Driver"
    select MCUX_USE_driver_common
    help
      QSPI Driver
```

## drivers/qtmr_2/Kconfig
```kconfig
# Copyright 2023 NXP
# All rights reserved.
#
# SPDX-License-Identifier: BSD-3-Clause

# driver_qtmr_2
config MCUX_HAS_driver_qtmr_2
    bool

config MCUX_USE_driver_qtmr_2
    depends on MCUX_HAS_driver_qtmr_2
    bool "QTMR_2 Driver"
    select MCUX_USE_driver_common
    help
      QTMR Driver
```

## drivers/rcm/Kconfig
```kconfig
# Copyright 2023 NXP
# All rights reserved.
#
# SPDX-License-Identifier: BSD-3-Clause

# driver_rcm
config MCUX_HAS_driver_rcm
    bool

config MCUX_USE_driver_rcm
    depends on MCUX_HAS_driver_rcm
    bool "RCM Driver"
    select MCUX_USE_driver_common
    help
      RCM Driver
```

## drivers/rdc/Kconfig
```kconfig
# Copyright 2023 NXP
# All rights reserved.
#
# SPDX-License-Identifier: BSD-3-Clause

# driver_rdc
config MCUX_HAS_driver_rdc
    bool

config MCUX_USE_driver_rdc
    depends on MCUX_HAS_driver_rdc
    bool "RDC Driver"
    select MCUX_USE_driver_common
    help
      RDC Driver
```

## drivers/rdc_sema42/Kconfig
```kconfig
# Copyright 2023 NXP
# All rights reserved.
#
# SPDX-License-Identifier: BSD-3-Clause

# driver_rdc_sema42
config MCUX_HAS_driver_rdc_sema42
    bool

config MCUX_USE_driver_rdc_sema42
    depends on MCUX_HAS_driver_rdc_sema42
    bool "RDC SEMA42 Driver"
    select MCUX_USE_driver_common
    help
      RDC SEMA42 Driver
```

## drivers/rng/Kconfig
```kconfig
# Copyright 2023 NXP
# All rights reserved.
#
# SPDX-License-Identifier: BSD-3-Clause

# driver_rng
config MCUX_HAS_driver_rng
    bool

config MCUX_USE_driver_rng
    depends on MCUX_HAS_driver_rng
    bool "RNG Driver"
    select MCUX_USE_driver_common
    help
      RNG Driver
```

## drivers/rng_1/Kconfig
```kconfig
# Copyright 2023 NXP
# All rights reserved.
#
# SPDX-License-Identifier: BSD-3-Clause

# driver_rng_1
config MCUX_HAS_driver_rng_1
    bool

config MCUX_USE_driver_rng_1
    depends on MCUX_HAS_driver_rng_1
    bool "RNG Driver"
    select MCUX_USE_driver_common
    help
      RNG Driver
```
