## drivers/rnga/Kconfig
```kconfig
# Copyright 2023 NXP
# All rights reserved.
#
# SPDX-License-Identifier: BSD-3-Clause

# driver_rnga
config MCUX_HAS_driver_rnga
    bool

config MCUX_USE_driver_rnga
    depends on MCUX_HAS_driver_rnga
    bool "RNGA Driver"
    select MCUX_USE_driver_common
    help
      RNGA Driver
```

## drivers/rtc/Kconfig
```kconfig
# Copyright 2023 NXP
# All rights reserved.
#
# SPDX-License-Identifier: BSD-3-Clause

# driver_rtc
config MCUX_HAS_driver_rtc
    bool

config MCUX_USE_driver_rtc
    depends on MCUX_HAS_driver_rtc
    bool "RTC Driver"
    select MCUX_USE_driver_common
    help
      RTC Driver
```

## drivers/rtwdog/Kconfig
```kconfig
# Copyright 2023 NXP
# All rights reserved.
#
# SPDX-License-Identifier: BSD-3-Clause

# driver_rtwdog
config MCUX_HAS_driver_rtwdog
    bool

config MCUX_USE_driver_rtwdog
    depends on MCUX_HAS_driver_rtwdog
    bool "RTWDOG Driver"
    select MCUX_USE_driver_common
    help
      RTWDOG Driver
```

## drivers/sai/Kconfig
```kconfig
# Copyright 2023 NXP
# All rights reserved.
#
# SPDX-License-Identifier: BSD-3-Clause

# driver_sai
config MCUX_HAS_driver_sai
    bool

config MCUX_USE_driver_sai
    depends on MCUX_HAS_driver_sai
    bool "SAI Driver"
    select MCUX_USE_driver_common
    help
      SAI Driver

# driver_sai_edma
config MCUX_HAS_driver_sai_edma
    bool

config MCUX_USE_driver_sai_edma
    depends on MCUX_HAS_driver_sai_edma
    bool "SAI EDMA Driver"
    select MCUX_USE_driver_sai
    help
      SAI EDMA Driver

# driver_sai_sdma
config MCUX_HAS_driver_sai_sdma
    bool

config MCUX_USE_driver_sai_sdma
    depends on MCUX_HAS_driver_sai_sdma
    bool "SAI SDMA Driver"
    select MCUX_USE_driver_sai
    help
      SAI SDMA Driver
```

## drivers/sctimer/Kconfig
```kconfig
# Copyright 2023 NXP
# All rights reserved.
#
# SPDX-License-Identifier: BSD-3-Clause

# driver_sctimer
config MCUX_HAS_driver_sctimer
    bool

config MCUX_USE_driver_sctimer
    depends on MCUX_HAS_driver_sctimer
    bool "SCT Driver"
    select MCUX_USE_driver_common
    help
      SCT Driver
```

## drivers/sdma/Kconfig
```kconfig
# Copyright 2023 NXP
# All rights reserved.
#
# SPDX-License-Identifier: BSD-3-Clause

# driver_sdma
config MCUX_HAS_driver_sdma
    bool

config MCUX_USE_driver_sdma
    depends on MCUX_HAS_driver_sdma
    bool "SDMA Driver"
    select MCUX_USE_driver_common
    help
      SDMA Driver
```

## drivers/sema4/Kconfig
```kconfig
# Copyright 2023 NXP
# All rights reserved.
#
# SPDX-License-Identifier: BSD-3-Clause

# driver_sema4
config MCUX_HAS_driver_sema4
    bool

config MCUX_USE_driver_sema4
    depends on MCUX_HAS_driver_sema4
    bool "SEMA4 Driver"
    select MCUX_USE_driver_common
    help
      SEMA4 Driver
```

## drivers/sema42/Kconfig
```kconfig
# Copyright 2023 NXP
# All rights reserved.
#
# SPDX-License-Identifier: BSD-3-Clause

# driver_sema42
config MCUX_HAS_driver_sema42
    bool

config MCUX_USE_driver_sema42
    depends on MCUX_HAS_driver_sema42
    bool "SEMA42 Driver"
    select MCUX_USE_driver_common
    help
      SEMA42 Driver
```

## drivers/semc/Kconfig
```kconfig
# Copyright 2023 NXP
# All rights reserved.
#
# SPDX-License-Identifier: BSD-3-Clause

# driver_semc
config MCUX_HAS_driver_semc
    bool

config MCUX_USE_driver_semc
    depends on MCUX_HAS_driver_semc
    bool "SEMC Driver"
    select MCUX_USE_driver_common
    help
      SEMC Driver
```

## drivers/sha/Kconfig
```kconfig
# Copyright 2023 NXP
# All rights reserved.
#
# SPDX-License-Identifier: BSD-3-Clause

# driver_sha
config MCUX_HAS_driver_sha
    bool

config MCUX_USE_driver_sha
    depends on MCUX_HAS_driver_sha
    bool "SHA Driver"
    select MCUX_USE_driver_common
    help
      SHA Driver
```

## drivers/sim/Kconfig
```kconfig
# Copyright 2023 NXP
# All rights reserved.
#
# SPDX-License-Identifier: BSD-3-Clause

# driver_sim
config MCUX_HAS_driver_sim
    bool

config MCUX_USE_driver_sim
    depends on MCUX_HAS_driver_sim
    bool "SIM Driver"
    select MCUX_USE_driver_common
    help
      SIM Driver
```

## drivers/slcd/Kconfig
```kconfig
# Copyright 2023 NXP
# All rights reserved.
#
# SPDX-License-Identifier: BSD-3-Clause

# driver_slcd
config MCUX_HAS_driver_slcd
    bool

config MCUX_USE_driver_slcd
    depends on MCUX_HAS_driver_slcd
    bool "SLCD Driver"
    select MCUX_USE_driver_common
    help
      SLCD Driver
```

## drivers/smartcard/Kconfig
```kconfig
# Copyright 2023 NXP
# All rights reserved.
#
# SPDX-License-Identifier: BSD-3-Clause

# driver_smartcard_emvsim
config MCUX_HAS_driver_smartcard_emvsim
    bool

config MCUX_USE_driver_smartcard_emvsim
    depends on MCUX_HAS_driver_smartcard_emvsim
    bool "SMARTCARD EMVSIM Driver"
    select MCUX_USE_driver_common
    help
      SMARTCARD EMVSIM Driver

# driver_smartcard_phy_emvsim
config MCUX_HAS_driver_smartcard_phy_emvsim
    bool

config MCUX_USE_driver_smartcard_phy_emvsim
    depends on MCUX_HAS_driver_smartcard_phy_emvsim
    bool "SMARTCARD PHY EMVSIM"
    select MCUX_USE_driver_smartcard_emvsim
    select MCUX_USE_driver_common
    help
      SMARTCARD PHY EMVSIM, use only one SMARTCARD PHY in the project
```

## drivers/smartdma/Kconfig
```kconfig
# Copyright 2023 NXP
# All rights reserved.
#
# SPDX-License-Identifier: BSD-3-Clause

# driver_lpc_smartdma
config MCUX_HAS_driver_lpc_smartdma
    bool

config MCUX_USE_driver_lpc_smartdma
    depends on MCUX_HAS_driver_lpc_smartdma
    bool "SMARTDMA Driver"
    select MCUX_USE_driver_common
    help
      SMARTDMA Driver
```

## drivers/smc/Kconfig
```kconfig
# Copyright 2023 NXP
# All rights reserved.
#
# SPDX-License-Identifier: BSD-3-Clause

# driver_smc
config MCUX_HAS_driver_smc
    bool

config MCUX_USE_driver_smc
    depends on MCUX_HAS_driver_smc
    bool "SMC Driver"
    select MCUX_USE_driver_common
    help
      SMC Driver
```

## drivers/snvs_hp/Kconfig
```kconfig
# Copyright 2023 NXP
# All rights reserved.
#
# SPDX-License-Identifier: BSD-3-Clause

# driver_snvs_hp
config MCUX_HAS_driver_snvs_hp
    bool

config MCUX_USE_driver_snvs_hp
    depends on MCUX_HAS_driver_snvs_hp
    bool "SNVS HP Driver"
    select MCUX_USE_driver_common
    help
      SNVS HP Driver
```

## drivers/snvs_lp/Kconfig
```kconfig
# Copyright 2023 NXP
# All rights reserved.
#
# SPDX-License-Identifier: BSD-3-Clause

# driver_snvs_lp
config MCUX_HAS_driver_snvs_lp
    bool

config MCUX_USE_driver_snvs_lp
    depends on MCUX_HAS_driver_snvs_lp
    bool "SNVS LP Driver"
    select MCUX_USE_driver_common
    help
      SNVS LP Driver
```

## drivers/spdif/Kconfig
```kconfig
# Copyright 2023 NXP
# All rights reserved.
#
# SPDX-License-Identifier: BSD-3-Clause

# driver_spdif_edma
config MCUX_HAS_driver_spdif_edma
    bool

config MCUX_USE_driver_spdif_edma
    depends on MCUX_HAS_driver_spdif_edma
    bool "SPDIF EDMA Driver"
    select MCUX_USE_driver_spdif
    help
      SPDIF EDMA Driver

# driver_spdif
config MCUX_HAS_driver_spdif
    bool

config MCUX_USE_driver_spdif
    depends on MCUX_HAS_driver_spdif
    bool "SPDIF Driver"
    select MCUX_USE_driver_common
    help
      SPDIF Driver
```

## drivers/spi/Kconfig
```kconfig
# Copyright 2023 NXP
# All rights reserved.
#
# SPDX-License-Identifier: BSD-3-Clause

# driver_spi
config MCUX_HAS_driver_spi
    bool

config MCUX_USE_driver_spi
    depends on MCUX_HAS_driver_spi
    bool "SPI Driver"
    select MCUX_USE_driver_common
    help
      SPI Driver

# driver_spi_dma
config MCUX_HAS_driver_spi_dma
    bool

config MCUX_USE_driver_spi_dma
    depends on MCUX_HAS_driver_spi_dma
    bool "SPI DMA Driver"
    select MCUX_USE_driver_spi
    help
      SPI Driver
```

## drivers/spifi/Kconfig
```kconfig
# Copyright 2023 NXP
# All rights reserved.
#
# SPDX-License-Identifier: BSD-3-Clause

# driver_spifi_dma
config MCUX_HAS_driver_spifi_dma
    bool

config MCUX_USE_driver_spifi_dma
    depends on MCUX_HAS_driver_spifi_dma
    bool "SPIFI DMA Driver"
    select MCUX_USE_driver_spifi
    help
      SPIFI Driver

# driver_spifi
config MCUX_HAS_driver_spifi
    bool

config MCUX_USE_driver_spifi
    depends on MCUX_HAS_driver_spifi
    bool "SPIFI Driver"
    select MCUX_USE_driver_common
    help
      SPIFI Driver
```

## drivers/spm/Kconfig
```kconfig
# Copyright 2023 NXP
# All rights reserved.
#
# SPDX-License-Identifier: BSD-3-Clause

# driver_spm
config MCUX_HAS_driver_spm
    bool

config MCUX_USE_driver_spm
    depends on MCUX_HAS_driver_spm
    bool "SPM Driver"
    select MCUX_USE_driver_common
    help
      SPM Driver
```

## drivers/src/Kconfig
```kconfig
# Copyright 2023 NXP
# All rights reserved.
#
# SPDX-License-Identifier: BSD-3-Clause

# driver_src
config MCUX_HAS_driver_src
    bool

config MCUX_USE_driver_src
    depends on MCUX_HAS_driver_src
    bool "SRC Driver"
    select MCUX_USE_driver_common
    help
      SRC Driver
```

## drivers/ssarc/Kconfig
```kconfig
# Copyright 2023 NXP
# All rights reserved.
#
# SPDX-License-Identifier: BSD-3-Clause

# driver_ssarc
config MCUX_HAS_driver_ssarc
    bool

config MCUX_USE_driver_ssarc
    depends on MCUX_HAS_driver_ssarc
    bool "SSARC Driver"
    select MCUX_USE_driver_common
    help
      SSARC Driver
```

## drivers/swm/Kconfig
```kconfig
# Copyright 2023 NXP
# All rights reserved.
#
# SPDX-License-Identifier: BSD-3-Clause

# driver_swm
config MCUX_HAS_driver_swm
    bool

config MCUX_USE_driver_swm
    depends on MCUX_HAS_driver_swm
    bool "SWM Driver"
    select MCUX_USE_driver_common
    select MCUX_USE_driver_swm_connections
    help
      SWM Driver
```

## drivers/syscon/Kconfig
```kconfig
# Copyright 2023 NXP
# All rights reserved.
#
# SPDX-License-Identifier: BSD-3-Clause

# driver_syscon
config MCUX_HAS_driver_syscon
    bool

config MCUX_USE_driver_syscon
    depends on MCUX_HAS_driver_syscon
    bool "SYSCON Driver"
    select MCUX_USE_driver_common
    select MCUX_USE_driver_syscon_connections
    help
      SYSCON Driver
```
