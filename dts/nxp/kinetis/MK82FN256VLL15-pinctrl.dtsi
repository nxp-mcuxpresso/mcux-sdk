/*
 * NOTE: Autogenerated file by kinetis_signal2dts.py
 *       for MK82FN256VLL15/signal_configuration.xml
 *
 * SPDX-License-Identifier: Apache-2.0
 */

/*
 * Pin nodes are of the form:
 *
 *	<SIGNAL[0..n]>: <signal[0]> {
 *		nxp,kinetis-port-pins = < PIN PCR[MUX] >;
 *	};
 */

&porta {
	TSI0_CH1_PTA0: tsi0_ch1_pta0 {
		nxp,kinetis-port-pins = < 0 0 >;
	};
	PTA0: GPIOA_PTA0: gpioa_pta0 {
		nxp,kinetis-port-pins = < 0 1 >;
	};
	LPUART0_CTS_b_PTA0: lpuart0_cts_b_pta0 {
		nxp,kinetis-port-pins = < 0 2 >;
	};
	FTM0_CH5_PTA0: ftm0_ch5_pta0 {
		nxp,kinetis-port-pins = < 0 3 >;
	};
	FXIO0_D10_PTA0: fxio0_d10_pta0 {
		nxp,kinetis-port-pins = < 0 5 >;
	};
	EMVSIM0_CLK_PTA0: emvsim0_clk_pta0 {
		nxp,kinetis-port-pins = < 0 6 >;
	};
	JTAG_TCLK_PTA0: jtag_tclk_pta0 {
		nxp,kinetis-port-pins = < 0 7 >;
	};
	TSI0_CH2_PTA1: tsi0_ch2_pta1 {
		nxp,kinetis-port-pins = < 1 0 >;
	};
	PTA1: GPIOA_PTA1: gpioa_pta1 {
		nxp,kinetis-port-pins = < 1 1 >;
	};
	LPUART0_RX_PTA1: lpuart0_rx_pta1 {
		nxp,kinetis-port-pins = < 1 2 >;
	};
	FTM0_CH6_PTA1: ftm0_ch6_pta1 {
		nxp,kinetis-port-pins = < 1 3 >;
	};
	I2C3_SDA_PTA1: i2c3_sda_pta1 {
		nxp,kinetis-port-pins = < 1 4 >;
	};
	FXIO0_D11_PTA1: fxio0_d11_pta1 {
		nxp,kinetis-port-pins = < 1 5 >;
	};
	EMVSIM0_IO_PTA1: emvsim0_io_pta1 {
		nxp,kinetis-port-pins = < 1 6 >;
	};
	JTAG_TDI_PTA1: jtag_tdi_pta1 {
		nxp,kinetis-port-pins = < 1 7 >;
	};
	TSI0_CH3_PTA2: tsi0_ch3_pta2 {
		nxp,kinetis-port-pins = < 2 0 >;
	};
	PTA2: GPIOA_PTA2: gpioa_pta2 {
		nxp,kinetis-port-pins = < 2 1 >;
	};
	LPUART0_TX_PTA2: lpuart0_tx_pta2 {
		nxp,kinetis-port-pins = < 2 2 >;
	};
	FTM0_CH7_PTA2: ftm0_ch7_pta2 {
		nxp,kinetis-port-pins = < 2 3 >;
	};
	I2C3_SCL_PTA2: i2c3_scl_pta2 {
		nxp,kinetis-port-pins = < 2 4 >;
	};
	FXIO0_D12_PTA2: fxio0_d12_pta2 {
		nxp,kinetis-port-pins = < 2 5 >;
	};
	EMVSIM0_PD_PTA2: emvsim0_pd_pta2 {
		nxp,kinetis-port-pins = < 2 6 >;
	};
	JTAG_TDO_PTA2: TRACE_SWO_PTA2: jtag_tdo_pta2 {
		nxp,kinetis-port-pins = < 2 7 >;
	};
	TSI0_CH4_PTA3: tsi0_ch4_pta3 {
		nxp,kinetis-port-pins = < 3 0 >;
	};
	PTA3: GPIOA_PTA3: gpioa_pta3 {
		nxp,kinetis-port-pins = < 3 1 >;
	};
	LPUART0_RTS_b_PTA3: lpuart0_rts_b_pta3 {
		nxp,kinetis-port-pins = < 3 2 >;
	};
	FTM0_CH0_PTA3: ftm0_ch0_pta3 {
		nxp,kinetis-port-pins = < 3 3 >;
	};
	FXIO0_D13_PTA3: fxio0_d13_pta3 {
		nxp,kinetis-port-pins = < 3 5 >;
	};
	EMVSIM0_RST_PTA3: emvsim0_rst_pta3 {
		nxp,kinetis-port-pins = < 3 6 >;
	};
	JTAG_TMS_PTA3: jtag_tms_pta3 {
		nxp,kinetis-port-pins = < 3 7 >;
	};
	TSI0_CH5_PTA4: tsi0_ch5_pta4 {
		nxp,kinetis-port-pins = < 4 0 >;
	};
	PTA4: GPIOA_PTA4: LLWU_P3_PTA4: gpioa_pta4 {
		nxp,kinetis-port-pins = < 4 1 >;
	};
	FTM0_CH1_PTA4: ftm0_ch1_pta4 {
		nxp,kinetis-port-pins = < 4 3 >;
	};
	FXIO0_D14_PTA4: fxio0_d14_pta4 {
		nxp,kinetis-port-pins = < 4 5 >;
	};
	EMVSIM0_VCCEN_PTA4: emvsim0_vccen_pta4 {
		nxp,kinetis-port-pins = < 4 6 >;
	};
	NMI_b_PTA4: nmi_b_pta4 {
		nxp,kinetis-port-pins = < 4 7 >;
	};
	PTA5: GPIOA_PTA5: gpioa_pta5 {
		nxp,kinetis-port-pins = < 5 1 >;
	};
	USB0_CLKIN_PTA5: usb0_clkin_pta5 {
		nxp,kinetis-port-pins = < 5 2 >;
	};
	FTM0_CH2_PTA5: ftm0_ch2_pta5 {
		nxp,kinetis-port-pins = < 5 3 >;
	};
	FXIO0_D15_PTA5: fxio0_d15_pta5 {
		nxp,kinetis-port-pins = < 5 5 >;
	};
	I2S0_TX_BCLK_PTA5: i2s0_tx_bclk_pta5 {
		nxp,kinetis-port-pins = < 5 6 >;
	};
	JTAG_TRST_b_PTA5: jtag_trst_b_pta5 {
		nxp,kinetis-port-pins = < 5 7 >;
	};
	PTA12: GPIOA_PTA12: gpioa_pta12 {
		nxp,kinetis-port-pins = < 12 1 >;
	};
	FTM1_CH0_PTA12: ftm1_ch0_pta12 {
		nxp,kinetis-port-pins = < 12 3 >;
	};
	TRACE_CLKOUT_PTA12: trace_clkout_pta12 {
		nxp,kinetis-port-pins = < 12 4 >;
	};
	FXIO0_D18_PTA12: fxio0_d18_pta12 {
		nxp,kinetis-port-pins = < 12 5 >;
	};
	I2S0_TXD0_PTA12: i2s0_txd0_pta12 {
		nxp,kinetis-port-pins = < 12 6 >;
	};
	FTM1_QD_PHA_PTA12: TPM1_CH0_PTA12: ftm1_qd_pha_pta12 {
		nxp,kinetis-port-pins = < 12 7 >;
	};
	PTA13: GPIOA_PTA13: LLWU_P4_PTA13: gpioa_pta13 {
		nxp,kinetis-port-pins = < 13 1 >;
	};
	FTM1_CH1_PTA13: ftm1_ch1_pta13 {
		nxp,kinetis-port-pins = < 13 3 >;
	};
	TRACE_D3_PTA13: trace_d3_pta13 {
		nxp,kinetis-port-pins = < 13 4 >;
	};
	FXIO0_D19_PTA13: fxio0_d19_pta13 {
		nxp,kinetis-port-pins = < 13 5 >;
	};
	I2S0_TX_FS_PTA13: i2s0_tx_fs_pta13 {
		nxp,kinetis-port-pins = < 13 6 >;
	};
	FTM1_QD_PHB_PTA13: TPM1_CH1_PTA13: ftm1_qd_phb_pta13 {
		nxp,kinetis-port-pins = < 13 7 >;
	};
	PTA14: GPIOA_PTA14: gpioa_pta14 {
		nxp,kinetis-port-pins = < 14 1 >;
	};
	SPI0_PCS0_PTA14: spi0_pcs0_pta14 {
		nxp,kinetis-port-pins = < 14 2 >;
	};
	LPUART0_TX_PTA14: lpuart0_tx_pta14 {
		nxp,kinetis-port-pins = < 14 3 >;
	};
	TRACE_D2_PTA14: trace_d2_pta14 {
		nxp,kinetis-port-pins = < 14 4 >;
	};
	FXIO0_D20_PTA14: fxio0_d20_pta14 {
		nxp,kinetis-port-pins = < 14 5 >;
	};
	I2S0_RX_BCLK_PTA14: i2s0_rx_bclk_pta14 {
		nxp,kinetis-port-pins = < 14 6 >;
	};
	I2S0_TXD1_PTA14: i2s0_txd1_pta14 {
		nxp,kinetis-port-pins = < 14 7 >;
	};
	PTA15: GPIOA_PTA15: gpioa_pta15 {
		nxp,kinetis-port-pins = < 15 1 >;
	};
	SPI0_SCK_PTA15: spi0_sck_pta15 {
		nxp,kinetis-port-pins = < 15 2 >;
	};
	LPUART0_RX_PTA15: lpuart0_rx_pta15 {
		nxp,kinetis-port-pins = < 15 3 >;
	};
	TRACE_D1_PTA15: trace_d1_pta15 {
		nxp,kinetis-port-pins = < 15 4 >;
	};
	FXIO0_D21_PTA15: fxio0_d21_pta15 {
		nxp,kinetis-port-pins = < 15 5 >;
	};
	I2S0_RXD0_PTA15: i2s0_rxd0_pta15 {
		nxp,kinetis-port-pins = < 15 6 >;
	};
	PTA16: GPIOA_PTA16: gpioa_pta16 {
		nxp,kinetis-port-pins = < 16 1 >;
	};
	SPI0_SOUT_PTA16: spi0_sout_pta16 {
		nxp,kinetis-port-pins = < 16 2 >;
	};
	LPUART0_CTS_b_PTA16: lpuart0_cts_b_pta16 {
		nxp,kinetis-port-pins = < 16 3 >;
	};
	TRACE_D0_PTA16: trace_d0_pta16 {
		nxp,kinetis-port-pins = < 16 4 >;
	};
	FXIO0_D22_PTA16: fxio0_d22_pta16 {
		nxp,kinetis-port-pins = < 16 5 >;
	};
	I2S0_RX_FS_PTA16: i2s0_rx_fs_pta16 {
		nxp,kinetis-port-pins = < 16 6 >;
	};
	I2S0_RXD1_PTA16: i2s0_rxd1_pta16 {
		nxp,kinetis-port-pins = < 16 7 >;
	};
	PTA17: GPIOA_PTA17: gpioa_pta17 {
		nxp,kinetis-port-pins = < 17 1 >;
	};
	SPI0_SIN_PTA17: spi0_sin_pta17 {
		nxp,kinetis-port-pins = < 17 2 >;
	};
	LPUART0_RTS_b_PTA17: lpuart0_rts_b_pta17 {
		nxp,kinetis-port-pins = < 17 3 >;
	};
	FXIO0_D23_PTA17: fxio0_d23_pta17 {
		nxp,kinetis-port-pins = < 17 5 >;
	};
	I2S0_MCLK_PTA17: i2s0_mclk_pta17 {
		nxp,kinetis-port-pins = < 17 6 >;
	};
	EXTAL0_PTA18: extal0_pta18 {
		nxp,kinetis-port-pins = < 18 0 >;
	};
	PTA18: GPIOA_PTA18: gpioa_pta18 {
		nxp,kinetis-port-pins = < 18 1 >;
	};
	FTM0_FLT2_PTA18: ftm0_flt2_pta18 {
		nxp,kinetis-port-pins = < 18 3 >;
	};
	FTM_CLKIN0_PTA18: ftm_clkin0_pta18 {
		nxp,kinetis-port-pins = < 18 4 >;
	};
	TPM_CLKIN0_PTA18: tpm_clkin0_pta18 {
		nxp,kinetis-port-pins = < 18 7 >;
	};
	XTAL0_PTA19: xtal0_pta19 {
		nxp,kinetis-port-pins = < 19 0 >;
	};
	PTA19: GPIOA_PTA19: gpioa_pta19 {
		nxp,kinetis-port-pins = < 19 1 >;
	};
	FTM1_FLT0_PTA19: ftm1_flt0_pta19 {
		nxp,kinetis-port-pins = < 19 3 >;
	};
	FTM_CLKIN1_PTA19: ftm_clkin1_pta19 {
		nxp,kinetis-port-pins = < 19 4 >;
	};
	LPTMR0_ALT1_PTA19: LPTMR1_ALT1_PTA19: lptmr0_alt1_pta19 {
		nxp,kinetis-port-pins = < 19 6 >;
	};
	TPM_CLKIN1_PTA19: tpm_clkin1_pta19 {
		nxp,kinetis-port-pins = < 19 7 >;
	};
};

&portb {
	ADC0_SE8_PTB0: TSI0_CH0_PTB0: adc0_se8_ptb0 {
		nxp,kinetis-port-pins = < 0 0 >;
	};
	PTB0: GPIOB_PTB0: LLWU_P5_PTB0: gpiob_ptb0 {
		nxp,kinetis-port-pins = < 0 1 >;
	};
	I2C0_SCL_PTB0: i2c0_scl_ptb0 {
		nxp,kinetis-port-pins = < 0 2 >;
	};
	FTM1_CH0_PTB0: ftm1_ch0_ptb0 {
		nxp,kinetis-port-pins = < 0 3 >;
	};
	SDRAM_CAS_b_PTB0: sdram_cas_b_ptb0 {
		nxp,kinetis-port-pins = < 0 5 >;
	};
	FTM1_QD_PHA_PTB0: TPM1_CH0_PTB0: ftm1_qd_pha_ptb0 {
		nxp,kinetis-port-pins = < 0 6 >;
	};
	FXIO0_D0_PTB0: fxio0_d0_ptb0 {
		nxp,kinetis-port-pins = < 0 7 >;
	};
	ADC0_SE9_PTB1: TSI0_CH6_PTB1: adc0_se9_ptb1 {
		nxp,kinetis-port-pins = < 1 0 >;
	};
	PTB1: GPIOB_PTB1: gpiob_ptb1 {
		nxp,kinetis-port-pins = < 1 1 >;
	};
	I2C0_SDA_PTB1: i2c0_sda_ptb1 {
		nxp,kinetis-port-pins = < 1 2 >;
	};
	FTM1_CH1_PTB1: ftm1_ch1_ptb1 {
		nxp,kinetis-port-pins = < 1 3 >;
	};
	SDRAM_RAS_b_PTB1: sdram_ras_b_ptb1 {
		nxp,kinetis-port-pins = < 1 5 >;
	};
	FTM1_QD_PHB_PTB1: TPM1_CH1_PTB1: ftm1_qd_phb_ptb1 {
		nxp,kinetis-port-pins = < 1 6 >;
	};
	FXIO0_D1_PTB1: fxio0_d1_ptb1 {
		nxp,kinetis-port-pins = < 1 7 >;
	};
	ADC0_SE12_PTB2: TSI0_CH7_PTB2: adc0_se12_ptb2 {
		nxp,kinetis-port-pins = < 2 0 >;
	};
	PTB2: GPIOB_PTB2: gpiob_ptb2 {
		nxp,kinetis-port-pins = < 2 1 >;
	};
	I2C0_SCL_PTB2: i2c0_scl_ptb2 {
		nxp,kinetis-port-pins = < 2 2 >;
	};
	LPUART0_RTS_b_PTB2: lpuart0_rts_b_ptb2 {
		nxp,kinetis-port-pins = < 2 3 >;
	};
	SDRAM_WE_PTB2: sdram_we_ptb2 {
		nxp,kinetis-port-pins = < 2 5 >;
	};
	FTM0_FLT3_PTB2: ftm0_flt3_ptb2 {
		nxp,kinetis-port-pins = < 2 6 >;
	};
	FXIO0_D2_PTB2: fxio0_d2_ptb2 {
		nxp,kinetis-port-pins = < 2 7 >;
	};
	ADC0_SE13_PTB3: TSI0_CH8_PTB3: adc0_se13_ptb3 {
		nxp,kinetis-port-pins = < 3 0 >;
	};
	PTB3: GPIOB_PTB3: gpiob_ptb3 {
		nxp,kinetis-port-pins = < 3 1 >;
	};
	I2C0_SDA_PTB3: i2c0_sda_ptb3 {
		nxp,kinetis-port-pins = < 3 2 >;
	};
	LPUART0_CTS_b_PTB3: lpuart0_cts_b_ptb3 {
		nxp,kinetis-port-pins = < 3 3 >;
	};
	SDRAM_CS0_b_PTB3: sdram_cs0_b_ptb3 {
		nxp,kinetis-port-pins = < 3 5 >;
	};
	FTM0_FLT0_PTB3: ftm0_flt0_ptb3 {
		nxp,kinetis-port-pins = < 3 6 >;
	};
	FXIO0_D3_PTB3: fxio0_d3_ptb3 {
		nxp,kinetis-port-pins = < 3 7 >;
	};
	PTB9: GPIOB_PTB9: gpiob_ptb9 {
		nxp,kinetis-port-pins = < 9 1 >;
	};
	SPI1_PCS1_PTB9: spi1_pcs1_ptb9 {
		nxp,kinetis-port-pins = < 9 2 >;
	};
	LPUART3_CTS_b_PTB9: lpuart3_cts_b_ptb9 {
		nxp,kinetis-port-pins = < 9 3 >;
	};
	SDRAM_D20_PTB9: sdram_d20_ptb9 {
		nxp,kinetis-port-pins = < 9 5 >;
	};
	PTB10: GPIOB_PTB10: gpiob_ptb10 {
		nxp,kinetis-port-pins = < 10 1 >;
	};
	SPI1_PCS0_PTB10: spi1_pcs0_ptb10 {
		nxp,kinetis-port-pins = < 10 2 >;
	};
	LPUART3_RX_PTB10: lpuart3_rx_ptb10 {
		nxp,kinetis-port-pins = < 10 3 >;
	};
	I2C2_SCL_PTB10: i2c2_scl_ptb10 {
		nxp,kinetis-port-pins = < 10 4 >;
	};
	SDRAM_D19_PTB10: sdram_d19_ptb10 {
		nxp,kinetis-port-pins = < 10 5 >;
	};
	FTM0_FLT1_PTB10: ftm0_flt1_ptb10 {
		nxp,kinetis-port-pins = < 10 6 >;
	};
	FXIO0_D4_PTB10: fxio0_d4_ptb10 {
		nxp,kinetis-port-pins = < 10 7 >;
	};
	PTB11: GPIOB_PTB11: gpiob_ptb11 {
		nxp,kinetis-port-pins = < 11 1 >;
	};
	SPI1_SCK_PTB11: spi1_sck_ptb11 {
		nxp,kinetis-port-pins = < 11 2 >;
	};
	LPUART3_TX_PTB11: lpuart3_tx_ptb11 {
		nxp,kinetis-port-pins = < 11 3 >;
	};
	I2C2_SDA_PTB11: i2c2_sda_ptb11 {
		nxp,kinetis-port-pins = < 11 4 >;
	};
	SDRAM_D18_PTB11: sdram_d18_ptb11 {
		nxp,kinetis-port-pins = < 11 5 >;
	};
	FTM0_FLT2_PTB11: ftm0_flt2_ptb11 {
		nxp,kinetis-port-pins = < 11 6 >;
	};
	FXIO0_D5_PTB11: fxio0_d5_ptb11 {
		nxp,kinetis-port-pins = < 11 7 >;
	};
	TSI0_CH9_PTB16: tsi0_ch9_ptb16 {
		nxp,kinetis-port-pins = < 16 0 >;
	};
	PTB16: GPIOB_PTB16: gpiob_ptb16 {
		nxp,kinetis-port-pins = < 16 1 >;
	};
	SPI1_SOUT_PTB16: spi1_sout_ptb16 {
		nxp,kinetis-port-pins = < 16 2 >;
	};
	LPUART0_RX_PTB16: lpuart0_rx_ptb16 {
		nxp,kinetis-port-pins = < 16 3 >;
	};
	FTM_CLKIN0_PTB16: ftm_clkin0_ptb16 {
		nxp,kinetis-port-pins = < 16 4 >;
	};
	SDRAM_D17_PTB16: sdram_d17_ptb16 {
		nxp,kinetis-port-pins = < 16 5 >;
	};
	EWM_IN_PTB16: ewm_in_ptb16 {
		nxp,kinetis-port-pins = < 16 6 >;
	};
	TPM_CLKIN0_PTB16: tpm_clkin0_ptb16 {
		nxp,kinetis-port-pins = < 16 7 >;
	};
	TSI0_CH10_PTB17: tsi0_ch10_ptb17 {
		nxp,kinetis-port-pins = < 17 0 >;
	};
	PTB17: GPIOB_PTB17: gpiob_ptb17 {
		nxp,kinetis-port-pins = < 17 1 >;
	};
	SPI1_SIN_PTB17: spi1_sin_ptb17 {
		nxp,kinetis-port-pins = < 17 2 >;
	};
	LPUART0_TX_PTB17: lpuart0_tx_ptb17 {
		nxp,kinetis-port-pins = < 17 3 >;
	};
	FTM_CLKIN1_PTB17: ftm_clkin1_ptb17 {
		nxp,kinetis-port-pins = < 17 4 >;
	};
	SDRAM_D16_PTB17: sdram_d16_ptb17 {
		nxp,kinetis-port-pins = < 17 5 >;
	};
	EWM_OUT_b_PTB17: ewm_out_b_ptb17 {
		nxp,kinetis-port-pins = < 17 6 >;
	};
	TPM_CLKIN1_PTB17: tpm_clkin1_ptb17 {
		nxp,kinetis-port-pins = < 17 7 >;
	};
	TSI0_CH11_PTB18: tsi0_ch11_ptb18 {
		nxp,kinetis-port-pins = < 18 0 >;
	};
	PTB18: GPIOB_PTB18: gpiob_ptb18 {
		nxp,kinetis-port-pins = < 18 1 >;
	};
	FTM2_CH0_PTB18: ftm2_ch0_ptb18 {
		nxp,kinetis-port-pins = < 18 3 >;
	};
	I2S0_TX_BCLK_PTB18: i2s0_tx_bclk_ptb18 {
		nxp,kinetis-port-pins = < 18 4 >;
	};
	SDRAM_A23_PTB18: sdram_a23_ptb18 {
		nxp,kinetis-port-pins = < 18 5 >;
	};
	FTM2_QD_PHA_PTB18: TPM2_CH0_PTB18: ftm2_qd_pha_ptb18 {
		nxp,kinetis-port-pins = < 18 6 >;
	};
	FXIO0_D6_PTB18: fxio0_d6_ptb18 {
		nxp,kinetis-port-pins = < 18 7 >;
	};
	TSI0_CH12_PTB19: tsi0_ch12_ptb19 {
		nxp,kinetis-port-pins = < 19 0 >;
	};
	PTB19: GPIOB_PTB19: gpiob_ptb19 {
		nxp,kinetis-port-pins = < 19 1 >;
	};
	FTM2_CH1_PTB19: ftm2_ch1_ptb19 {
		nxp,kinetis-port-pins = < 19 3 >;
	};
	I2S0_TX_FS_PTB19: i2s0_tx_fs_ptb19 {
		nxp,kinetis-port-pins = < 19 4 >;
	};
	FTM2_QD_PHB_PTB19: TPM2_CH1_PTB19: ftm2_qd_phb_ptb19 {
		nxp,kinetis-port-pins = < 19 6 >;
	};
	FXIO0_D7_PTB19: fxio0_d7_ptb19 {
		nxp,kinetis-port-pins = < 19 7 >;
	};
	PTB20: GPIOB_PTB20: gpiob_ptb20 {
		nxp,kinetis-port-pins = < 20 1 >;
	};
	SPI2_PCS0_PTB20: spi2_pcs0_ptb20 {
		nxp,kinetis-port-pins = < 20 2 >;
	};
	SDRAM_D31_PTB20: sdram_d31_ptb20 {
		nxp,kinetis-port-pins = < 20 5 >;
	};
	CMP0_OUT_PTB20: cmp0_out_ptb20 {
		nxp,kinetis-port-pins = < 20 6 >;
	};
	FXIO0_D8_PTB20: fxio0_d8_ptb20 {
		nxp,kinetis-port-pins = < 20 7 >;
	};
	PTB21: GPIOB_PTB21: gpiob_ptb21 {
		nxp,kinetis-port-pins = < 21 1 >;
	};
	SPI2_SCK_PTB21: spi2_sck_ptb21 {
		nxp,kinetis-port-pins = < 21 2 >;
	};
	SDRAM_D30_PTB21: sdram_d30_ptb21 {
		nxp,kinetis-port-pins = < 21 5 >;
	};
	CMP1_OUT_PTB21: cmp1_out_ptb21 {
		nxp,kinetis-port-pins = < 21 6 >;
	};
	FXIO0_D9_PTB21: fxio0_d9_ptb21 {
		nxp,kinetis-port-pins = < 21 7 >;
	};
	PTB22: GPIOB_PTB22: gpiob_ptb22 {
		nxp,kinetis-port-pins = < 22 1 >;
	};
	SPI2_SOUT_PTB22: spi2_sout_ptb22 {
		nxp,kinetis-port-pins = < 22 2 >;
	};
	SDRAM_D29_PTB22: sdram_d29_ptb22 {
		nxp,kinetis-port-pins = < 22 5 >;
	};
	FXIO0_D10_PTB22: fxio0_d10_ptb22 {
		nxp,kinetis-port-pins = < 22 7 >;
	};
	PTB23: GPIOB_PTB23: gpiob_ptb23 {
		nxp,kinetis-port-pins = < 23 1 >;
	};
	SPI2_SIN_PTB23: spi2_sin_ptb23 {
		nxp,kinetis-port-pins = < 23 2 >;
	};
	SPI0_PCS5_PTB23: spi0_pcs5_ptb23 {
		nxp,kinetis-port-pins = < 23 3 >;
	};
	SDRAM_D28_PTB23: sdram_d28_ptb23 {
		nxp,kinetis-port-pins = < 23 5 >;
	};
	FXIO0_D11_PTB23: fxio0_d11_ptb23 {
		nxp,kinetis-port-pins = < 23 7 >;
	};
};

&portc {
	ADC0_SE14_PTC0: TSI0_CH13_PTC0: adc0_se14_ptc0 {
		nxp,kinetis-port-pins = < 0 0 >;
	};
	PTC0: GPIOC_PTC0: gpioc_ptc0 {
		nxp,kinetis-port-pins = < 0 1 >;
	};
	SPI0_PCS4_PTC0: spi0_pcs4_ptc0 {
		nxp,kinetis-port-pins = < 0 2 >;
	};
	PDB0_EXTRG_PTC0: pdb0_extrg_ptc0 {
		nxp,kinetis-port-pins = < 0 3 >;
	};
	USB0_SOF_OUT_PTC0: usb0_sof_out_ptc0 {
		nxp,kinetis-port-pins = < 0 4 >;
	};
	SDRAM_A22_PTC0: sdram_a22_ptc0 {
		nxp,kinetis-port-pins = < 0 5 >;
	};
	I2S0_TXD1_PTC0: i2s0_txd1_ptc0 {
		nxp,kinetis-port-pins = < 0 6 >;
	};
	FXIO0_D12_PTC0: fxio0_d12_ptc0 {
		nxp,kinetis-port-pins = < 0 7 >;
	};
	ADC0_SE15_PTC1: TSI0_CH14_PTC1: adc0_se15_ptc1 {
		nxp,kinetis-port-pins = < 1 0 >;
	};
	PTC1: GPIOC_PTC1: LLWU_P6_PTC1: gpioc_ptc1 {
		nxp,kinetis-port-pins = < 1 1 >;
	};
	SPI0_PCS3_PTC1: spi0_pcs3_ptc1 {
		nxp,kinetis-port-pins = < 1 2 >;
	};
	LPUART1_RTS_b_PTC1: lpuart1_rts_b_ptc1 {
		nxp,kinetis-port-pins = < 1 3 >;
	};
	FTM0_CH0_PTC1: ftm0_ch0_ptc1 {
		nxp,kinetis-port-pins = < 1 4 >;
	};
	SDRAM_A21_PTC1: sdram_a21_ptc1 {
		nxp,kinetis-port-pins = < 1 5 >;
	};
	I2S0_TXD0_PTC1: i2s0_txd0_ptc1 {
		nxp,kinetis-port-pins = < 1 6 >;
	};
	FXIO0_D13_PTC1: fxio0_d13_ptc1 {
		nxp,kinetis-port-pins = < 1 7 >;
	};
	ADC0_SE4b_PTC2: CMP1_IN0_PTC2: TSI0_CH15_PTC2: adc0_se4b_ptc2 {
		nxp,kinetis-port-pins = < 2 0 >;
	};
	PTC2: GPIOC_PTC2: gpioc_ptc2 {
		nxp,kinetis-port-pins = < 2 1 >;
	};
	SPI0_PCS2_PTC2: spi0_pcs2_ptc2 {
		nxp,kinetis-port-pins = < 2 2 >;
	};
	LPUART1_CTS_b_PTC2: lpuart1_cts_b_ptc2 {
		nxp,kinetis-port-pins = < 2 3 >;
	};
	FTM0_CH1_PTC2: ftm0_ch1_ptc2 {
		nxp,kinetis-port-pins = < 2 4 >;
	};
	SDRAM_A20_PTC2: sdram_a20_ptc2 {
		nxp,kinetis-port-pins = < 2 5 >;
	};
	I2S0_TX_FS_PTC2: i2s0_tx_fs_ptc2 {
		nxp,kinetis-port-pins = < 2 6 >;
	};
	CMP1_IN1_PTC3: cmp1_in1_ptc3 {
		nxp,kinetis-port-pins = < 3 0 >;
	};
	PTC3: GPIOC_PTC3: LLWU_P7_PTC3: gpioc_ptc3 {
		nxp,kinetis-port-pins = < 3 1 >;
	};
	SPI0_PCS1_PTC3: spi0_pcs1_ptc3 {
		nxp,kinetis-port-pins = < 3 2 >;
	};
	LPUART1_RX_PTC3: lpuart1_rx_ptc3 {
		nxp,kinetis-port-pins = < 3 3 >;
	};
	FTM0_CH2_PTC3: ftm0_ch2_ptc3 {
		nxp,kinetis-port-pins = < 3 4 >;
	};
	CLKOUT_PTC3: clkout_ptc3 {
		nxp,kinetis-port-pins = < 3 5 >;
	};
	I2S0_TX_BCLK_PTC3: i2s0_tx_bclk_ptc3 {
		nxp,kinetis-port-pins = < 3 6 >;
	};
	PTC4: GPIOC_PTC4: LLWU_P8_PTC4: gpioc_ptc4 {
		nxp,kinetis-port-pins = < 4 1 >;
	};
	SPI0_PCS0_PTC4: spi0_pcs0_ptc4 {
		nxp,kinetis-port-pins = < 4 2 >;
	};
	LPUART1_TX_PTC4: lpuart1_tx_ptc4 {
		nxp,kinetis-port-pins = < 4 3 >;
	};
	FTM0_CH3_PTC4: ftm0_ch3_ptc4 {
		nxp,kinetis-port-pins = < 4 4 >;
	};
	SDRAM_A19_PTC4: sdram_a19_ptc4 {
		nxp,kinetis-port-pins = < 4 5 >;
	};
	CMP1_OUT_PTC4: cmp1_out_ptc4 {
		nxp,kinetis-port-pins = < 4 6 >;
	};
	PTC5: GPIOC_PTC5: LLWU_P9_PTC5: gpioc_ptc5 {
		nxp,kinetis-port-pins = < 5 1 >;
	};
	SPI0_SCK_PTC5: spi0_sck_ptc5 {
		nxp,kinetis-port-pins = < 5 2 >;
	};
	LPTMR0_ALT2_PTC5: LPTMR1_ALT2_PTC5: lptmr0_alt2_ptc5 {
		nxp,kinetis-port-pins = < 5 3 >;
	};
	I2S0_RXD0_PTC5: i2s0_rxd0_ptc5 {
		nxp,kinetis-port-pins = < 5 4 >;
	};
	SDRAM_A18_PTC5: sdram_a18_ptc5 {
		nxp,kinetis-port-pins = < 5 5 >;
	};
	CMP0_OUT_PTC5: cmp0_out_ptc5 {
		nxp,kinetis-port-pins = < 5 6 >;
	};
	FTM0_CH2_PTC5: ftm0_ch2_ptc5 {
		nxp,kinetis-port-pins = < 5 7 >;
	};
	CMP0_IN0_PTC6: cmp0_in0_ptc6 {
		nxp,kinetis-port-pins = < 6 0 >;
	};
	PTC6: GPIOC_PTC6: LLWU_P10_PTC6: gpioc_ptc6 {
		nxp,kinetis-port-pins = < 6 1 >;
	};
	SPI0_SOUT_PTC6: spi0_sout_ptc6 {
		nxp,kinetis-port-pins = < 6 2 >;
	};
	PDB0_EXTRG_PTC6: pdb0_extrg_ptc6 {
		nxp,kinetis-port-pins = < 6 3 >;
	};
	I2S0_RX_BCLK_PTC6: i2s0_rx_bclk_ptc6 {
		nxp,kinetis-port-pins = < 6 4 >;
	};
	SDRAM_A17_PTC6: sdram_a17_ptc6 {
		nxp,kinetis-port-pins = < 6 5 >;
	};
	I2S0_MCLK_PTC6: i2s0_mclk_ptc6 {
		nxp,kinetis-port-pins = < 6 6 >;
	};
	FXIO0_D14_PTC6: fxio0_d14_ptc6 {
		nxp,kinetis-port-pins = < 6 7 >;
	};
	CMP0_IN1_PTC7: cmp0_in1_ptc7 {
		nxp,kinetis-port-pins = < 7 0 >;
	};
	PTC7: GPIOC_PTC7: gpioc_ptc7 {
		nxp,kinetis-port-pins = < 7 1 >;
	};
	SPI0_SIN_PTC7: spi0_sin_ptc7 {
		nxp,kinetis-port-pins = < 7 2 >;
	};
	USB0_SOF_OUT_PTC7: usb0_sof_out_ptc7 {
		nxp,kinetis-port-pins = < 7 3 >;
	};
	I2S0_RX_FS_PTC7: i2s0_rx_fs_ptc7 {
		nxp,kinetis-port-pins = < 7 4 >;
	};
	SDRAM_A16_PTC7: sdram_a16_ptc7 {
		nxp,kinetis-port-pins = < 7 5 >;
	};
	FXIO0_D15_PTC7: fxio0_d15_ptc7 {
		nxp,kinetis-port-pins = < 7 7 >;
	};
	CMP0_IN2_PTC8: cmp0_in2_ptc8 {
		nxp,kinetis-port-pins = < 8 0 >;
	};
	PTC8: GPIOC_PTC8: gpioc_ptc8 {
		nxp,kinetis-port-pins = < 8 1 >;
	};
	FTM3_CH4_PTC8: ftm3_ch4_ptc8 {
		nxp,kinetis-port-pins = < 8 3 >;
	};
	I2S0_MCLK_PTC8: i2s0_mclk_ptc8 {
		nxp,kinetis-port-pins = < 8 4 >;
	};
	SDRAM_A15_PTC8: sdram_a15_ptc8 {
		nxp,kinetis-port-pins = < 8 5 >;
	};
	FXIO0_D16_PTC8: fxio0_d16_ptc8 {
		nxp,kinetis-port-pins = < 8 7 >;
	};
	CMP0_IN3_PTC9: cmp0_in3_ptc9 {
		nxp,kinetis-port-pins = < 9 0 >;
	};
	PTC9: GPIOC_PTC9: gpioc_ptc9 {
		nxp,kinetis-port-pins = < 9 1 >;
	};
	FTM3_CH5_PTC9: ftm3_ch5_ptc9 {
		nxp,kinetis-port-pins = < 9 3 >;
	};
	I2S0_RX_BCLK_PTC9: i2s0_rx_bclk_ptc9 {
		nxp,kinetis-port-pins = < 9 4 >;
	};
	SDRAM_A14_PTC9: sdram_a14_ptc9 {
		nxp,kinetis-port-pins = < 9 5 >;
	};
	FTM2_FLT0_PTC9: ftm2_flt0_ptc9 {
		nxp,kinetis-port-pins = < 9 6 >;
	};
	FXIO0_D17_PTC9: fxio0_d17_ptc9 {
		nxp,kinetis-port-pins = < 9 7 >;
	};
	PTC10: GPIOC_PTC10: gpioc_ptc10 {
		nxp,kinetis-port-pins = < 10 1 >;
	};
	I2C1_SCL_PTC10: i2c1_scl_ptc10 {
		nxp,kinetis-port-pins = < 10 2 >;
	};
	FTM3_CH6_PTC10: ftm3_ch6_ptc10 {
		nxp,kinetis-port-pins = < 10 3 >;
	};
	I2S0_RX_FS_PTC10: i2s0_rx_fs_ptc10 {
		nxp,kinetis-port-pins = < 10 4 >;
	};
	SDRAM_A13_PTC10: sdram_a13_ptc10 {
		nxp,kinetis-port-pins = < 10 5 >;
	};
	FXIO0_D18_PTC10: fxio0_d18_ptc10 {
		nxp,kinetis-port-pins = < 10 7 >;
	};
	PTC11: GPIOC_PTC11: LLWU_P11_PTC11: gpioc_ptc11 {
		nxp,kinetis-port-pins = < 11 1 >;
	};
	I2C1_SDA_PTC11: i2c1_sda_ptc11 {
		nxp,kinetis-port-pins = < 11 2 >;
	};
	FTM3_CH7_PTC11: ftm3_ch7_ptc11 {
		nxp,kinetis-port-pins = < 11 3 >;
	};
	I2S0_RXD1_PTC11: i2s0_rxd1_ptc11 {
		nxp,kinetis-port-pins = < 11 4 >;
	};
	FXIO0_D19_PTC11: fxio0_d19_ptc11 {
		nxp,kinetis-port-pins = < 11 7 >;
	};
	PTC12: GPIOC_PTC12: gpioc_ptc12 {
		nxp,kinetis-port-pins = < 12 1 >;
	};
	LPUART4_RTS_b_PTC12: lpuart4_rts_b_ptc12 {
		nxp,kinetis-port-pins = < 12 3 >;
	};
	FTM_CLKIN0_PTC12: ftm_clkin0_ptc12 {
		nxp,kinetis-port-pins = < 12 4 >;
	};
	SDRAM_D27_PTC12: sdram_d27_ptc12 {
		nxp,kinetis-port-pins = < 12 5 >;
	};
	FTM3_FLT0_PTC12: ftm3_flt0_ptc12 {
		nxp,kinetis-port-pins = < 12 6 >;
	};
	TPM_CLKIN0_PTC12: tpm_clkin0_ptc12 {
		nxp,kinetis-port-pins = < 12 7 >;
	};
	PTC13: GPIOC_PTC13: gpioc_ptc13 {
		nxp,kinetis-port-pins = < 13 1 >;
	};
	LPUART4_CTS_b_PTC13: lpuart4_cts_b_ptc13 {
		nxp,kinetis-port-pins = < 13 3 >;
	};
	FTM_CLKIN1_PTC13: ftm_clkin1_ptc13 {
		nxp,kinetis-port-pins = < 13 4 >;
	};
	SDRAM_D26_PTC13: sdram_d26_ptc13 {
		nxp,kinetis-port-pins = < 13 5 >;
	};
	TPM_CLKIN1_PTC13: tpm_clkin1_ptc13 {
		nxp,kinetis-port-pins = < 13 7 >;
	};
	PTC14: GPIOC_PTC14: gpioc_ptc14 {
		nxp,kinetis-port-pins = < 14 1 >;
	};
	LPUART4_RX_PTC14: lpuart4_rx_ptc14 {
		nxp,kinetis-port-pins = < 14 3 >;
	};
	SDRAM_D25_PTC14: sdram_d25_ptc14 {
		nxp,kinetis-port-pins = < 14 5 >;
	};
	FXIO0_D20_PTC14: fxio0_d20_ptc14 {
		nxp,kinetis-port-pins = < 14 7 >;
	};
	PTC15: GPIOC_PTC15: gpioc_ptc15 {
		nxp,kinetis-port-pins = < 15 1 >;
	};
	LPUART4_TX_PTC15: lpuart4_tx_ptc15 {
		nxp,kinetis-port-pins = < 15 3 >;
	};
	SDRAM_D24_PTC15: sdram_d24_ptc15 {
		nxp,kinetis-port-pins = < 15 5 >;
	};
	FXIO0_D21_PTC15: fxio0_d21_ptc15 {
		nxp,kinetis-port-pins = < 15 7 >;
	};
	PTC17: GPIOC_PTC17: gpioc_ptc17 {
		nxp,kinetis-port-pins = < 17 1 >;
	};
	LPUART3_TX_PTC17: lpuart3_tx_ptc17 {
		nxp,kinetis-port-pins = < 17 3 >;
	};
	SDRAM_DQM3_PTC17: sdram_dqm3_ptc17 {
		nxp,kinetis-port-pins = < 17 5 >;
	};
};

&portd {
	PTD0: GPIOD_PTD0: LLWU_P12_PTD0: gpiod_ptd0 {
		nxp,kinetis-port-pins = < 0 1 >;
	};
	SPI0_PCS0_PTD0: spi0_pcs0_ptd0 {
		nxp,kinetis-port-pins = < 0 2 >;
	};
	LPUART2_RTS_b_PTD0: lpuart2_rts_b_ptd0 {
		nxp,kinetis-port-pins = < 0 3 >;
	};
	FTM3_CH0_PTD0: ftm3_ch0_ptd0 {
		nxp,kinetis-port-pins = < 0 4 >;
	};
	FXIO0_D22_PTD0: fxio0_d22_ptd0 {
		nxp,kinetis-port-pins = < 0 7 >;
	};
	ADC0_SE5b_PTD1: adc0_se5b_ptd1 {
		nxp,kinetis-port-pins = < 1 0 >;
	};
	PTD1: GPIOD_PTD1: gpiod_ptd1 {
		nxp,kinetis-port-pins = < 1 1 >;
	};
	SPI0_SCK_PTD1: spi0_sck_ptd1 {
		nxp,kinetis-port-pins = < 1 2 >;
	};
	LPUART2_CTS_b_PTD1: lpuart2_cts_b_ptd1 {
		nxp,kinetis-port-pins = < 1 3 >;
	};
	FTM3_CH1_PTD1: ftm3_ch1_ptd1 {
		nxp,kinetis-port-pins = < 1 4 >;
	};
	FXIO0_D23_PTD1: fxio0_d23_ptd1 {
		nxp,kinetis-port-pins = < 1 7 >;
	};
	PTD2: GPIOD_PTD2: LLWU_P13_PTD2: gpiod_ptd2 {
		nxp,kinetis-port-pins = < 2 1 >;
	};
	SPI0_SOUT_PTD2: spi0_sout_ptd2 {
		nxp,kinetis-port-pins = < 2 2 >;
	};
	LPUART2_RX_PTD2: lpuart2_rx_ptd2 {
		nxp,kinetis-port-pins = < 2 3 >;
	};
	FTM3_CH2_PTD2: ftm3_ch2_ptd2 {
		nxp,kinetis-port-pins = < 2 4 >;
	};
	SDRAM_A12_PTD2: sdram_a12_ptd2 {
		nxp,kinetis-port-pins = < 2 5 >;
	};
	I2C0_SCL_PTD2: i2c0_scl_ptd2 {
		nxp,kinetis-port-pins = < 2 7 >;
	};
	PTD3: GPIOD_PTD3: gpiod_ptd3 {
		nxp,kinetis-port-pins = < 3 1 >;
	};
	SPI0_SIN_PTD3: spi0_sin_ptd3 {
		nxp,kinetis-port-pins = < 3 2 >;
	};
	LPUART2_TX_PTD3: lpuart2_tx_ptd3 {
		nxp,kinetis-port-pins = < 3 3 >;
	};
	FTM3_CH3_PTD3: ftm3_ch3_ptd3 {
		nxp,kinetis-port-pins = < 3 4 >;
	};
	SDRAM_A11_PTD3: sdram_a11_ptd3 {
		nxp,kinetis-port-pins = < 3 5 >;
	};
	I2C0_SDA_PTD3: i2c0_sda_ptd3 {
		nxp,kinetis-port-pins = < 3 7 >;
	};
	PTD4: GPIOD_PTD4: LLWU_P14_PTD4: gpiod_ptd4 {
		nxp,kinetis-port-pins = < 4 1 >;
	};
	SPI0_PCS1_PTD4: spi0_pcs1_ptd4 {
		nxp,kinetis-port-pins = < 4 2 >;
	};
	LPUART0_RTS_b_PTD4: lpuart0_rts_b_ptd4 {
		nxp,kinetis-port-pins = < 4 3 >;
	};
	FTM0_CH4_PTD4: ftm0_ch4_ptd4 {
		nxp,kinetis-port-pins = < 4 4 >;
	};
	SDRAM_A10_PTD4: sdram_a10_ptd4 {
		nxp,kinetis-port-pins = < 4 5 >;
	};
	EWM_IN_PTD4: ewm_in_ptd4 {
		nxp,kinetis-port-pins = < 4 6 >;
	};
	SPI1_PCS0_PTD4: spi1_pcs0_ptd4 {
		nxp,kinetis-port-pins = < 4 7 >;
	};
	ADC0_SE6b_PTD5: adc0_se6b_ptd5 {
		nxp,kinetis-port-pins = < 5 0 >;
	};
	PTD5: GPIOD_PTD5: gpiod_ptd5 {
		nxp,kinetis-port-pins = < 5 1 >;
	};
	SPI0_PCS2_PTD5: spi0_pcs2_ptd5 {
		nxp,kinetis-port-pins = < 5 2 >;
	};
	LPUART0_CTS_b_PTD5: lpuart0_cts_b_ptd5 {
		nxp,kinetis-port-pins = < 5 3 >;
	};
	FTM0_CH5_PTD5: ftm0_ch5_ptd5 {
		nxp,kinetis-port-pins = < 5 4 >;
	};
	SDRAM_A9_PTD5: sdram_a9_ptd5 {
		nxp,kinetis-port-pins = < 5 5 >;
	};
	EWM_OUT_b_PTD5: ewm_out_b_ptd5 {
		nxp,kinetis-port-pins = < 5 6 >;
	};
	SPI1_SCK_PTD5: spi1_sck_ptd5 {
		nxp,kinetis-port-pins = < 5 7 >;
	};
	ADC0_SE7b_PTD6: adc0_se7b_ptd6 {
		nxp,kinetis-port-pins = < 6 0 >;
	};
	PTD6: GPIOD_PTD6: LLWU_P15_PTD6: gpiod_ptd6 {
		nxp,kinetis-port-pins = < 6 1 >;
	};
	SPI0_PCS3_PTD6: spi0_pcs3_ptd6 {
		nxp,kinetis-port-pins = < 6 2 >;
	};
	LPUART0_RX_PTD6: lpuart0_rx_ptd6 {
		nxp,kinetis-port-pins = < 6 3 >;
	};
	FTM0_CH6_PTD6: ftm0_ch6_ptd6 {
		nxp,kinetis-port-pins = < 6 4 >;
	};
	FTM0_FLT0_PTD6: ftm0_flt0_ptd6 {
		nxp,kinetis-port-pins = < 6 6 >;
	};
	SPI1_SOUT_PTD6: spi1_sout_ptd6 {
		nxp,kinetis-port-pins = < 6 7 >;
	};
	PTD7: GPIOD_PTD7: gpiod_ptd7 {
		nxp,kinetis-port-pins = < 7 1 >;
	};
	CMT_IRO_PTD7: cmt_iro_ptd7 {
		nxp,kinetis-port-pins = < 7 2 >;
	};
	LPUART0_TX_PTD7: lpuart0_tx_ptd7 {
		nxp,kinetis-port-pins = < 7 3 >;
	};
	FTM0_CH7_PTD7: ftm0_ch7_ptd7 {
		nxp,kinetis-port-pins = < 7 4 >;
	};
	SDRAM_CKE_PTD7: sdram_cke_ptd7 {
		nxp,kinetis-port-pins = < 7 5 >;
	};
	FTM0_FLT1_PTD7: ftm0_flt1_ptd7 {
		nxp,kinetis-port-pins = < 7 6 >;
	};
	SPI1_SIN_PTD7: spi1_sin_ptd7 {
		nxp,kinetis-port-pins = < 7 7 >;
	};
};

&porte {
	PTE0: GPIOE_PTE0: gpioe_pte0 {
		nxp,kinetis-port-pins = < 0 1 >;
	};
	SPI1_PCS1_PTE0: spi1_pcs1_pte0 {
		nxp,kinetis-port-pins = < 0 2 >;
	};
	LPUART1_TX_PTE0: lpuart1_tx_pte0 {
		nxp,kinetis-port-pins = < 0 3 >;
	};
	SDHC0_D1_PTE0: sdhc0_d1_pte0 {
		nxp,kinetis-port-pins = < 0 4 >;
	};
	QSPI0A_DATA3_PTE0: qspi0a_data3_pte0 {
		nxp,kinetis-port-pins = < 0 5 >;
	};
	I2C1_SDA_PTE0: i2c1_sda_pte0 {
		nxp,kinetis-port-pins = < 0 6 >;
	};
	RTC_CLKOUT_PTE0: rtc_clkout_pte0 {
		nxp,kinetis-port-pins = < 0 7 >;
	};
	PTE1: GPIOE_PTE1: LLWU_P0_PTE1: gpioe_pte1 {
		nxp,kinetis-port-pins = < 1 1 >;
	};
	SPI1_SCK_PTE1: spi1_sck_pte1 {
		nxp,kinetis-port-pins = < 1 2 >;
	};
	LPUART1_RX_PTE1: lpuart1_rx_pte1 {
		nxp,kinetis-port-pins = < 1 3 >;
	};
	SDHC0_D0_PTE1: sdhc0_d0_pte1 {
		nxp,kinetis-port-pins = < 1 4 >;
	};
	QSPI0A_SCLK_PTE1: qspi0a_sclk_pte1 {
		nxp,kinetis-port-pins = < 1 5 >;
	};
	I2C1_SCL_PTE1: i2c1_scl_pte1 {
		nxp,kinetis-port-pins = < 1 6 >;
	};
	SPI1_SIN_PTE1: spi1_sin_pte1 {
		nxp,kinetis-port-pins = < 1 7 >;
	};
	PTE2: GPIOE_PTE2: LLWU_P1_PTE2: gpioe_pte2 {
		nxp,kinetis-port-pins = < 2 1 >;
	};
	SPI1_SOUT_PTE2: spi1_sout_pte2 {
		nxp,kinetis-port-pins = < 2 2 >;
	};
	LPUART1_CTS_b_PTE2: lpuart1_cts_b_pte2 {
		nxp,kinetis-port-pins = < 2 3 >;
	};
	SDHC0_DCLK_PTE2: sdhc0_dclk_pte2 {
		nxp,kinetis-port-pins = < 2 4 >;
	};
	QSPI0A_DATA0_PTE2: qspi0a_data0_pte2 {
		nxp,kinetis-port-pins = < 2 5 >;
	};
	SPI1_SCK_PTE2: spi1_sck_pte2 {
		nxp,kinetis-port-pins = < 2 7 >;
	};
	PTE3: GPIOE_PTE3: gpioe_pte3 {
		nxp,kinetis-port-pins = < 3 1 >;
	};
	SPI1_PCS2_PTE3: spi1_pcs2_pte3 {
		nxp,kinetis-port-pins = < 3 2 >;
	};
	LPUART1_RTS_b_PTE3: lpuart1_rts_b_pte3 {
		nxp,kinetis-port-pins = < 3 3 >;
	};
	SDHC0_CMD_PTE3: sdhc0_cmd_pte3 {
		nxp,kinetis-port-pins = < 3 4 >;
	};
	QSPI0A_DATA2_PTE3: qspi0a_data2_pte3 {
		nxp,kinetis-port-pins = < 3 5 >;
	};
	SPI1_SOUT_PTE3: spi1_sout_pte3 {
		nxp,kinetis-port-pins = < 3 7 >;
	};
	PTE4: GPIOE_PTE4: LLWU_P2_PTE4: gpioe_pte4 {
		nxp,kinetis-port-pins = < 4 1 >;
	};
	SPI1_SIN_PTE4: spi1_sin_pte4 {
		nxp,kinetis-port-pins = < 4 2 >;
	};
	LPUART3_TX_PTE4: lpuart3_tx_pte4 {
		nxp,kinetis-port-pins = < 4 3 >;
	};
	SDHC0_D3_PTE4: sdhc0_d3_pte4 {
		nxp,kinetis-port-pins = < 4 4 >;
	};
	QSPI0A_DATA1_PTE4: qspi0a_data1_pte4 {
		nxp,kinetis-port-pins = < 4 5 >;
	};
	PTE5: GPIOE_PTE5: gpioe_pte5 {
		nxp,kinetis-port-pins = < 5 1 >;
	};
	SPI1_PCS0_PTE5: spi1_pcs0_pte5 {
		nxp,kinetis-port-pins = < 5 2 >;
	};
	LPUART3_RX_PTE5: lpuart3_rx_pte5 {
		nxp,kinetis-port-pins = < 5 3 >;
	};
	SDHC0_D2_PTE5: sdhc0_d2_pte5 {
		nxp,kinetis-port-pins = < 5 4 >;
	};
	QSPI0A_SS0_B_PTE5: qspi0a_ss0_b_pte5 {
		nxp,kinetis-port-pins = < 5 5 >;
	};
	FTM3_CH0_PTE5: ftm3_ch0_pte5 {
		nxp,kinetis-port-pins = < 5 6 >;
	};
	USB0_SOF_OUT_PTE5: usb0_sof_out_pte5 {
		nxp,kinetis-port-pins = < 5 7 >;
	};
	PTE6: GPIOE_PTE6: LLWU_P16_PTE6: gpioe_pte6 {
		nxp,kinetis-port-pins = < 6 1 >;
	};
	SPI1_PCS3_PTE6: spi1_pcs3_pte6 {
		nxp,kinetis-port-pins = < 6 2 >;
	};
	LPUART3_CTS_b_PTE6: lpuart3_cts_b_pte6 {
		nxp,kinetis-port-pins = < 6 3 >;
	};
	I2S0_MCLK_PTE6: i2s0_mclk_pte6 {
		nxp,kinetis-port-pins = < 6 4 >;
	};
	QSPI0B_DATA3_PTE6: qspi0b_data3_pte6 {
		nxp,kinetis-port-pins = < 6 5 >;
	};
	FTM3_CH1_PTE6: ftm3_ch1_pte6 {
		nxp,kinetis-port-pins = < 6 6 >;
	};
	SDHC0_D4_PTE6: sdhc0_d4_pte6 {
		nxp,kinetis-port-pins = < 6 7 >;
	};
	PTE7: GPIOE_PTE7: gpioe_pte7 {
		nxp,kinetis-port-pins = < 7 1 >;
	};
	SPI2_SCK_PTE7: spi2_sck_pte7 {
		nxp,kinetis-port-pins = < 7 2 >;
	};
	LPUART3_RTS_b_PTE7: lpuart3_rts_b_pte7 {
		nxp,kinetis-port-pins = < 7 3 >;
	};
	I2S0_RXD0_PTE7: i2s0_rxd0_pte7 {
		nxp,kinetis-port-pins = < 7 4 >;
	};
	QSPI0B_SCLK_PTE7: qspi0b_sclk_pte7 {
		nxp,kinetis-port-pins = < 7 5 >;
	};
	FTM3_CH2_PTE7: ftm3_ch2_pte7 {
		nxp,kinetis-port-pins = < 7 6 >;
	};
	QSPI0A_SS1_B_PTE7: qspi0a_ss1_b_pte7 {
		nxp,kinetis-port-pins = < 7 7 >;
	};
	PTE8: GPIOE_PTE8: gpioe_pte8 {
		nxp,kinetis-port-pins = < 8 1 >;
	};
	I2S0_RXD1_PTE8: i2s0_rxd1_pte8 {
		nxp,kinetis-port-pins = < 8 2 >;
	};
	SPI2_SOUT_PTE8: spi2_sout_pte8 {
		nxp,kinetis-port-pins = < 8 3 >;
	};
	I2S0_RX_FS_PTE8: i2s0_rx_fs_pte8 {
		nxp,kinetis-port-pins = < 8 4 >;
	};
	QSPI0B_DATA0_PTE8: qspi0b_data0_pte8 {
		nxp,kinetis-port-pins = < 8 5 >;
	};
	FTM3_CH3_PTE8: ftm3_ch3_pte8 {
		nxp,kinetis-port-pins = < 8 6 >;
	};
	SDHC0_D5_PTE8: sdhc0_d5_pte8 {
		nxp,kinetis-port-pins = < 8 7 >;
	};
	PTE9: GPIOE_PTE9: LLWU_P17_PTE9: gpioe_pte9 {
		nxp,kinetis-port-pins = < 9 1 >;
	};
	I2S0_TXD1_PTE9: i2s0_txd1_pte9 {
		nxp,kinetis-port-pins = < 9 2 >;
	};
	SPI2_PCS1_PTE9: spi2_pcs1_pte9 {
		nxp,kinetis-port-pins = < 9 3 >;
	};
	I2S0_RX_BCLK_PTE9: i2s0_rx_bclk_pte9 {
		nxp,kinetis-port-pins = < 9 4 >;
	};
	QSPI0B_DATA2_PTE9: qspi0b_data2_pte9 {
		nxp,kinetis-port-pins = < 9 5 >;
	};
	FTM3_CH4_PTE9: ftm3_ch4_pte9 {
		nxp,kinetis-port-pins = < 9 6 >;
	};
	SDHC0_D6_PTE9: sdhc0_d6_pte9 {
		nxp,kinetis-port-pins = < 9 7 >;
	};
	PTE10: GPIOE_PTE10: LLWU_P18_PTE10: gpioe_pte10 {
		nxp,kinetis-port-pins = < 10 1 >;
	};
	I2C3_SDA_PTE10: i2c3_sda_pte10 {
		nxp,kinetis-port-pins = < 10 2 >;
	};
	SPI2_SIN_PTE10: spi2_sin_pte10 {
		nxp,kinetis-port-pins = < 10 3 >;
	};
	I2S0_TXD0_PTE10: i2s0_txd0_pte10 {
		nxp,kinetis-port-pins = < 10 4 >;
	};
	QSPI0B_DATA1_PTE10: qspi0b_data1_pte10 {
		nxp,kinetis-port-pins = < 10 5 >;
	};
	FTM3_CH5_PTE10: ftm3_ch5_pte10 {
		nxp,kinetis-port-pins = < 10 6 >;
	};
	SDHC0_D7_PTE10: sdhc0_d7_pte10 {
		nxp,kinetis-port-pins = < 10 7 >;
	};
	PTE11: GPIOE_PTE11: gpioe_pte11 {
		nxp,kinetis-port-pins = < 11 1 >;
	};
	I2C3_SCL_PTE11: i2c3_scl_pte11 {
		nxp,kinetis-port-pins = < 11 2 >;
	};
	SPI2_PCS0_PTE11: spi2_pcs0_pte11 {
		nxp,kinetis-port-pins = < 11 3 >;
	};
	I2S0_TX_FS_PTE11: i2s0_tx_fs_pte11 {
		nxp,kinetis-port-pins = < 11 4 >;
	};
	QSPI0B_SS0_B_PTE11: qspi0b_ss0_b_pte11 {
		nxp,kinetis-port-pins = < 11 5 >;
	};
	FTM3_CH6_PTE11: ftm3_ch6_pte11 {
		nxp,kinetis-port-pins = < 11 6 >;
	};
	QSPI0A_DQS_PTE11: qspi0a_dqs_pte11 {
		nxp,kinetis-port-pins = < 11 7 >;
	};
};

