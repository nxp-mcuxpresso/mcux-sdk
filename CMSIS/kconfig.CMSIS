## CMSIS/kconfig.CMSIS
```kconfig
# Copyright 2021 NXP
# SPDX-License-Identifier: BSD-3-Clause

menu "CMSIS"

config USE_CMSIS_Include_core_cm
    bool "CMSIS Include For Cortex-M, ARMv8-M, ARMv8.1-M"
    depends on HAS_MCUX_SDK_CMSIS_Include_core_cm
    default n

config USE_CMSIS_DSP_Library
    bool "CMSIS DSP Library"
    depends on HAS_MCUX_SDK_CMSIS_DSP_Library
    default n

config USE_CMSIS_Driver_Include_Common
    bool 
    depends on HAS_MCUX_SDK_CMSIS_Driver_Include_Common
    default n

config USE_CMSIS_Driver_Include_I2C
    bool 
    depends on HAS_MCUX_SDK_CMSIS_Driver_Include_I2C
    default n
    select USE_CMSIS_Driver_Include_Common if HAS_MCUX_SDK_CMSIS_Driver_Include_Common

config USE_CMSIS_Driver_Include_SPI
    bool 
    depends on HAS_MCUX_SDK_CMSIS_Driver_Include_SPI
    default n
    select USE_CMSIS_Driver_Include_Common if HAS_MCUX_SDK_CMSIS_Driver_Include_Common

config USE_CMSIS_Include_common
    bool "Cmsis_include_common"
    depends on HAS_MCUX_SDK_CMSIS_Include_common
    default n

config USE_CMSIS_Include_core_cm0plus
    bool "Cmsis_include_core_cm0plus"
    depends on HAS_MCUX_SDK_CMSIS_Include_core_cm0plus
    default n
    select USE_CMSIS_Include_common if HAS_MCUX_SDK_CMSIS_Include_common
    select USE_CMSIS_Include_dsp if HAS_MCUX_SDK_CMSIS_Include_dsp

config USE_CMSIS_Include_core_cm33
    bool "Cmsis_include_core_cm33"
    depends on HAS_MCUX_SDK_CMSIS_Include_core_cm33
    default n
    select USE_CMSIS_Include_common if HAS_MCUX_SDK_CMSIS_Include_common
    select USE_CMSIS_Include_dsp if HAS_MCUX_SDK_CMSIS_Include_dsp

config USE_CMSIS_Include_core_cm4
    bool "Cmsis_include_core_cm4"
    depends on HAS_MCUX_SDK_CMSIS_Include_core_cm4
    default n
    select USE_CMSIS_Include_common if HAS_MCUX_SDK_CMSIS_Include_common
    select USE_CMSIS_Include_dsp if HAS_MCUX_SDK_CMSIS_Include_dsp

config USE_CMSIS_Include_core_cm7
    bool "Cmsis_include_core_cm7"
    depends on HAS_MCUX_SDK_CMSIS_Include_core_cm7
    default n
    select USE_CMSIS_Include_common if HAS_MCUX_SDK_CMSIS_Include_common
    select USE_CMSIS_Include_dsp if HAS_MCUX_SDK_CMSIS_Include_dsp

config USE_CMSIS_Include_dsp
    bool "Cmsis_include_dsp"
    depends on HAS_MCUX_SDK_CMSIS_Include_dsp
    default n

config HAS_MCUX_SDK_CMSIS_Include_core_cm
    bool


config HAS_MCUX_SDK_CMSIS_DSP_Library
    bool


config HAS_MCUX_SDK_CMSIS_Driver_Include_Common
    bool


config HAS_MCUX_SDK_CMSIS_Driver_Include_I2C
    bool


config HAS_MCUX_SDK_CMSIS_Driver_Include_SPI
    bool


config HAS_MCUX_SDK_CMSIS_Include_common
    bool


config HAS_MCUX_SDK_CMSIS_Include_core_cm0plus
    bool


config HAS_MCUX_SDK_CMSIS_Include_core_cm33
    bool


config HAS_MCUX_SDK_CMSIS_Include_core_cm4
    bool


config HAS_MCUX_SDK_CMSIS_Include_core_cm7
    bool


config HAS_MCUX_SDK_CMSIS_Include_dsp
    bool


endmenu
```

## Kconfig
```kconfig
# Copyright 2023 NXP
# All rights reserved.
#
# SPDX-License-Identifier: BSD-3-Clause

mainmenu "MCUX SDK Configuration"

rsource "./boards/Kconfig"
rsource "./arch/Kconfig"
rsource "./devices/Kconfig"
rsource "./drivers/Kconfig"
rsource "./components/Kconfig"
rsource "./utilities/Kconfig"
orsource  "./CMSIS/Kconfig"
rsource "./cmsis_drivers/Kconfig"
```

## arch/Kconfig
```kconfig
# Copyright 2023 NXP
# All rights reserved.
#
# SPDX-License-Identifier: BSD-3-Clause

config MCUX_CORE
    string
    default 'cm0p'  if MCUX_CPU_ARCH_ARM_CM0P
    default 'cm4'   if MCUX_CPU_ARCH_ARM_CM4
    default 'cm4f'  if MCUX_CPU_ARCH_ARM_CM4F
    default 'cm7f'  if MCUX_CPU_ARCH_ARM_CM7F
    default 'cm33'  if MCUX_CPU_ARCH_ARM_CM33
    default 'cm33f' if MCUX_CPU_ARCH_ARM_CM33F
    default 'ca7'   if MCUX_CPU_ARCH_ARM_CA7
    default 'dsp'   if MCUX_CPU_ARCH_DSP

config MCUX_FPU
    string
    default 'NO_FPU' if !MCUX_CPU_HAS_FPU
    default 'SP_FPU' if MCUX_CPU_HAS_SP_FPU
    default 'DP_FPU' if MCUX_CPU_HAS_DP_FPU

config MCUX_DSP
    string
    default 'NO_DSP' if !MCUX_CPU_HAS_DSP
    default 'DSP'    if MCUX_CPU_HAS_DSP


# Architecture definition
config MCUX_CPU_ARCH_ARM
    bool

config MCUX_CPU_ARCH_DSP
    bool

# CPU features
config MCUX_CPU_HAS_FPU
    bool

config MCUX_CPU_HAS_SP_FPU
    bool
    select MCUX_CPU_HAS_FPU
    help
      Single-precision FPU

config MCUX_CPU_HAS_DP_FPU
    bool
    select MCUX_CPU_HAS_FPU
    help
      Double-precision FPU

config MCUX_CPU_HAS_DSP
    bool
    help
      ARM DSP extension

rsource "./*/Kconfig"
```

## arch/arm/Kconfig
```kconfig
# Copyright 2023 NXP
# All rights reserved.
#
# SPDX-License-Identifier: BSD-3-Clause


# Core type definition
config MCUX_CPU_ARCH_ARM_CM0P
    bool
    select MCUX_CPU_ARCH_ARM

config MCUX_CPU_ARCH_ARM_CM4
    bool
    select MCUX_CPU_ARCH_ARM

config MCUX_CPU_ARCH_ARM_CM4F
    bool
    select MCUX_CPU_ARCH_ARM

config MCUX_CPU_ARCH_ARM_CM7F
    bool
    select MCUX_CPU_ARCH_ARM

config MCUX_CPU_ARCH_ARM_CM33
    bool
    select MCUX_CPU_ARCH_ARM

config MCUX_CPU_ARCH_ARM_CM33F
    bool
    select MCUX_CPU_ARCH_ARM

config MCUX_CPU_ARCH_ARM_CA7
    bool
    select MCUX_CPU_ARCH_ARM
```

## boards/Kconfig
```kconfig
# Copyright 2023 NXP
# All rights reserved.
#
# SPDX-License-Identifier: BSD-3-Clause

config MCUX_BOARD
    string

config MCUX_KIT
    string

choice
prompt "Select Board"
rsource "./*/Kconfig.board"
endchoice

menu "Board Configuration"
rsource "./*/Kconfig"
endmenu
```

## boards/evkbimxrt1050/Kconfig
```kconfig
# Copyright 2023 NXP
# All rights reserved.
#
# SPDX-License-Identifier: BSD-3-Clause
if MCUX_USE_BOARD_EVKBIMXRT1050

config MCUX_BOARD
    default "evkbimxrt1050"

config MCUX_KIT
    default "evkbimxrt1050"


#### Board level drivers ####
rsource "xip/Kconfig"

endif
```

## boards/evkbimxrt1050/Kconfig.board
```kconfig
# Copyright 2023 NXP
# All rights reserved.
#
# SPDX-License-Identifier: BSD-3-Clause


config MCUX_USE_BOARD_EVKBIMXRT1050
    bool "EVKBIMXRT1050"
    select MCUX_USE_SOC_MIMXRT1052
    select MCUX_SOC_PART_MIMXRT1052xxxxB
```

## boards/evkbimxrt1050/xip/Kconfig
```kconfig
# Copyright 2023 NXP
# All rights reserved.
#
# SPDX-License-Identifier: BSD-3-Clause

# driver_xip_board_evkbimxrt1050
config MCUX_USE_driver_xip_board_evkbimxrt1050
    bool "XIP Board Driver"
    select MCUX_USE_driver_common
    help
      XIP Board Driver
```

## boards/evkbmimxrt1060/Kconfig
```kconfig
# Copyright 2023 NXP
# All rights reserved.
#
# SPDX-License-Identifier: BSD-3-Clause
if MCUX_USE_BOARD_EVKBMIMXRT1060

config MCUX_BOARD
    default "evkbmimxrt1060"

config MCUX_KIT
    default "evkbmimxrt1060"


#### Board level drivers ####
rsource "xip/Kconfig"

endif
```

## boards/evkbmimxrt1060/Kconfig.board
```kconfig
# Copyright 2023 NXP
# All rights reserved.
#
# SPDX-License-Identifier: BSD-3-Clause


config MCUX_USE_BOARD_EVKBMIMXRT1060
    bool "EVKBMIMXRT1060"
    select MCUX_USE_SOC_MIMXRT1062
    select MCUX_SOC_PART_MIMXRT1062xxxxB
```

## boards/evkbmimxrt1170/Kconfig
```kconfig
# Copyright 2023 NXP
# All rights reserved.
#
# SPDX-License-Identifier: BSD-3-Clause
if (MCUX_USE_BOARD_EVKBMIMXRT1170_CM4 || MCUX_USE_BOARD_EVKBMIMXRT1170_CM7)

config MCUX_BOARD
    default "evkbmimxrt1170"

config MCUX_KIT
    default "evkbmimxrt1170"


#### Board level drivers ####
rsource "xip/Kconfig"
rsource "xmcd/Kconfig"

endif
```

## boards/evkbmimxrt1170/Kconfig.board
```kconfig
# Copyright 2023 NXP
# All rights reserved.
#
# SPDX-License-Identifier: BSD-3-Clause


config MCUX_USE_BOARD_EVKBMIMXRT1170_CM4
    bool "EVKBMIMXRT1170 [CM4]"
    select MCUX_USE_SOC_MIMXRT1176_CM4
    select MCUX_SOC_PART_MIMXRT1176xxxxx

config MCUX_USE_BOARD_EVKBMIMXRT1170_CM7
    bool "EVKBMIMXRT1170 [CM7]"
    select MCUX_USE_SOC_MIMXRT1176_CM7
    select MCUX_SOC_PART_MIMXRT1176xxxxx
```

## boards/evkbmimxrt1170/xmcd/Kconfig
```kconfig
# Copyright 2023 NXP
# All rights reserved.
#
# SPDX-License-Identifier: BSD-3-Clause

# driver_xmcd_evkbmimxrt1170
config MCUX_USE_driver_xmcd_evkbmimxrt1170
    bool "XMCD Driver"
    select MCUX_USE_driver_common
    help
      XMCD Driver
```

## boards/evkmcimx7ulp/Kconfig
```kconfig
# Copyright 2023 NXP
# All rights reserved.
#
# SPDX-License-Identifier: BSD-3-Clause
if MCUX_USE_BOARD_EVKMCIMX7ULP

config MCUX_BOARD
    default "evkmcimx7ulp"

config MCUX_KIT
    default "evkmcimx7ulp"


#### Board level drivers ####

endif
```

## boards/evkmcimx7ulp/Kconfig.board
```kconfig
# Copyright 2023 NXP
# All rights reserved.
#
# SPDX-License-Identifier: BSD-3-Clause


config MCUX_USE_BOARD_EVKMCIMX7ULP
    bool "EVKMCIMX7ULP"
    select MCUX_USE_SOC_MCIMX7U5
    select MCUX_SOC_PART_MCIMX7U5xxxxx
```

## boards/evkmimx8mm/Kconfig
```kconfig
# Copyright 2023 NXP
# All rights reserved.
#
# SPDX-License-Identifier: BSD-3-Clause
if MCUX_USE_BOARD_EVKMIMX8MM

config MCUX_BOARD
    default "evkmimx8mm"

config MCUX_KIT
    default "evkmimx8mm"


#### Board level drivers ####

endif
```

## boards/evkmimx8mm/Kconfig.board
```kconfig
# Copyright 2023 NXP
# All rights reserved.
#
# SPDX-License-Identifier: BSD-3-Clause


config MCUX_USE_BOARD_EVKMIMX8MM
    bool "EVKMIMX8MM"
    select MCUX_USE_SOC_MIMX8MM6
    select MCUX_SOC_PART_MIMX8MM6xxxLZ
```

## boards/evkmimx8mn/Kconfig.board
```kconfig
# Copyright 2023 NXP
# All rights reserved.
#
# SPDX-License-Identifier: BSD-3-Clause


config MCUX_USE_BOARD_EVKMIMX8MN
    bool "EVKMIMX8MN"
    select MCUX_USE_SOC_MIMX8MN6
    select MCUX_SOC_PART_MIMX8MN6xxxJZ
```

## boards/evkmimx8mnddr3l/Kconfig
```kconfig
# Copyright 2023 NXP
# All rights reserved.
#
# SPDX-License-Identifier: BSD-3-Clause
if MCUX_USE_BOARD_EVKMIMX8MNDDR3L

config MCUX_BOARD
    default "evkmimx8mnddr3l"

config MCUX_KIT
    default "evkmimx8mnddr3l"


#### Board level drivers ####

endif
```

## boards/evkmimx8mp/Kconfig
```kconfig
# Copyright 2023 NXP
# All rights reserved.
#
# SPDX-License-Identifier: BSD-3-Clause
if MCUX_USE_BOARD_EVKMIMX8MP

config MCUX_BOARD
    default "evkmimx8mp"

config MCUX_KIT
    default "evkmimx8mp"


#### Board level drivers ####

endif
```

## boards/evkmimx8mp/Kconfig.board
```kconfig
# Copyright 2023 NXP
# All rights reserved.
#
# SPDX-License-Identifier: BSD-3-Clause


config MCUX_USE_BOARD_EVKMIMX8MP
    bool "EVKMIMX8MP"
    select MCUX_USE_SOC_MIMX8ML8
    select MCUX_SOC_PART_MIMX8ML8xxxLZ
```

## boards/evkmimx8mq/Kconfig
```kconfig
# Copyright 2023 NXP
# All rights reserved.
#
# SPDX-License-Identifier: BSD-3-Clause
if MCUX_USE_BOARD_EVKMIMX8MQ

config MCUX_BOARD
    default "evkmimx8mq"

config MCUX_KIT
    default "evkmimx8mq"


#### Board level drivers ####

endif
```

## boards/evkmimx8mq/Kconfig.board
```kconfig
# Copyright 2023 NXP
# All rights reserved.
#
# SPDX-License-Identifier: BSD-3-Clause


config MCUX_USE_BOARD_EVKMIMX8MQ
    bool "EVKMIMX8MQ"
    select MCUX_USE_SOC_MIMX8MQ6
    select MCUX_SOC_PART_MIMX8MQ6xxxJZ
```

## boards/evkmimxrt1010/Kconfig
```kconfig
# Copyright 2023 NXP
# All rights reserved.
#
# SPDX-License-Identifier: BSD-3-Clause
if MCUX_USE_BOARD_EVKMIMXRT1010

config MCUX_BOARD
    default "evkmimxrt1010"

config MCUX_KIT
    default "evkmimxrt1010"


#### Board level drivers ####
rsource "xip/Kconfig"

endif
```

## boards/evkmimxrt1010/Kconfig.board
```kconfig
# Copyright 2023 NXP
# All rights reserved.
#
# SPDX-License-Identifier: BSD-3-Clause


config MCUX_USE_BOARD_EVKMIMXRT1010
    bool "EVKMIMXRT1010"
    select MCUX_USE_SOC_MIMXRT1011
    select MCUX_SOC_PART_MIMXRT1011xxxxx
```
