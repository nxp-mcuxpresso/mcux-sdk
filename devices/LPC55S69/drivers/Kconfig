## devices/MKE15Z7/Kconfig
```kconfig
# Copyright 2023 NXP
# All rights reserved.
#
# SPDX-License-Identifier: BSD-3-Clause

config MCUX_USE_SOC_MKE15Z7
    bool
    select MCUX_CPU_ARCH_ARM_CM0P
if MCUX_USE_SOC_MKE15Z7

# Part Number
config MCUX_SOC_PART_MKE15Z128xxx7
    bool

config MCUX_SOC_PART_MKE15Z256xxx7
    bool

config MCUX_DEVICE
    default "MKE15Z7"

config MCUX_DEVICE_ID
    default "MKE15Z128xxx7" if MCUX_SOC_PART_MKE15Z128xxx7
    default "MKE15Z256xxx7" if MCUX_SOC_PART_MKE15Z256xxx7


# Select supported components
config MCUX_USE_SOC_MKE15Z7
    select MCUX_HAS_CMSIS_DSP_Include
    select MCUX_HAS_CMSIS_DSP_Source
    select MCUX_HAS_CMSIS_Device_API_OSTick
    select MCUX_HAS_CMSIS_Device_API_RTOS2
    select MCUX_HAS_CMSIS_Driver_Include_CAN
    select MCUX_HAS_CMSIS_Driver_Include_Ethernet
    select MCUX_HAS_CMSIS_Driver_Include_Ethernet_MAC
    select MCUX_HAS_CMSIS_Driver_Include_Ethernet_PHY
    select MCUX_HAS_CMSIS_Driver_Include_Flash
    select MCUX_HAS_CMSIS_Driver_Include_I2C
    select MCUX_HAS_CMSIS_Driver_Include_MCI
    select MCUX_HAS_CMSIS_Driver_Include_NAND
    select MCUX_HAS_CMSIS_Driver_Include_SAI
    select MCUX_HAS_CMSIS_Driver_Include_SPI
    select MCUX_HAS_CMSIS_Driver_Include_USART
    select MCUX_HAS_CMSIS_Driver_Include_USB_Device
    select MCUX_HAS_CMSIS_Driver_Include_USB_Host
    select MCUX_HAS_CMSIS_Driver_Include_WiFi
    select MCUX_HAS_CMSIS_Include_core_cm
    select MCUX_HAS_CMSIS_NN_Source
    select MCUX_HAS_CMSIS_RTOS2_NonSecure
    select MCUX_HAS_CMSIS_RTOS2_Secure
    select MCUX_HAS_component_ftm_adapter
    select MCUX_HAS_component_gpio_adapter
    select MCUX_HAS_component_lists
    select MCUX_HAS_component_lpi2c_adapter
    select MCUX_HAS_component_lpit_adapter
    select MCUX_HAS_component_lpspi_adapter
    select MCUX_HAS_component_lptmr_adapter
    select MCUX_HAS_component_lpuart_adapter
    select MCUX_HAS_component_lpuart_dma_adapter
    select MCUX_HAS_component_serial_manager
    select MCUX_HAS_component_serial_manager_spi
    select MCUX_HAS_component_serial_manager_uart
    select MCUX_HAS_driver_acmp
    select MCUX_HAS_driver_adc12
    select MCUX_HAS_driver_cmsis_lpi2c
    select MCUX_HAS_driver_cmsis_lpspi
    select MCUX_HAS_driver_cmsis_lpuart
    select MCUX_HAS_driver_common
    select MCUX_HAS_driver_crc
    select MCUX_HAS_driver_dmamux
    select MCUX_HAS_driver_edma
    select MCUX_HAS_driver_ewm
    select MCUX_HAS_driver_flash
    select MCUX_HAS_driver_flexio
    select MCUX_HAS_driver_flexio_i2c_master
    select MCUX_HAS_driver_flexio_i2s
    select MCUX_HAS_driver_flexio_i2s_edma
    select MCUX_HAS_driver_flexio_spi
    select MCUX_HAS_driver_flexio_spi_edma
    select MCUX_HAS_driver_flexio_uart
    select MCUX_HAS_driver_flexio_uart_edma
    select MCUX_HAS_driver_ftm
    select MCUX_HAS_driver_gpio
    select MCUX_HAS_driver_lpi2c
    select MCUX_HAS_driver_lpi2c_edma
    select MCUX_HAS_driver_lpi2c_freertos
    select MCUX_HAS_driver_lpit
    select MCUX_HAS_driver_lpspi
    select MCUX_HAS_driver_lpspi_edma
    select MCUX_HAS_driver_lpspi_freertos
    select MCUX_HAS_driver_lptmr
    select MCUX_HAS_driver_lpuart
    select MCUX_HAS_driver_lpuart_edma
    select MCUX_HAS_driver_lpuart_freertos
    select MCUX_HAS_driver_mmdvsq
    select MCUX_HAS_driver_pdb
    select MCUX_HAS_driver_pmc
    select MCUX_HAS_driver_port
    select MCUX_HAS_driver_pwt
    select MCUX_HAS_driver_rcm
    select MCUX_HAS_driver_rtc
    select MCUX_HAS_driver_sim
    select MCUX_HAS_driver_smc
    select MCUX_HAS_driver_trgmux
    select MCUX_HAS_driver_tsi_v5
    select MCUX_HAS_driver_wdog32
    select MCUX_HAS_utilities_misc_utilities
    select MCUX_HAS_utility_assert
    select MCUX_HAS_utility_assert_lite
    select MCUX_HAS_utility_debug_console
    select MCUX_HAS_utility_debug_console_lite
    select MCUX_HAS_utility_notifier
    select MCUX_HAS_utility_shell
    select MCUX_HAS_utility_str

#### SOC specific dependency ####
config MCUX_USE_RTE_Device
    bool
    select MCUX_USE_driver_dmamux
    select MCUX_USE_driver_edma

config MCUX_USE_component_serial_manager_uart
    bool
    select MCUX_USE_component_lpuart_adapter

config MCUX_USE_driver_cmsis_lpi2c
    bool
    select MCUX_USE_driver_lpi2c_edma

config MCUX_USE_driver_cmsis_lpspi
    bool
    select MCUX_USE_driver_lpspi_edma

config MCUX_USE_driver_cmsis_lpuart
    bool
    select MCUX_USE_driver_lpuart_edma

config MCUX_USE_driver_flexio_i2s_edma
    bool
    select MCUX_USE_driver_edma

config MCUX_USE_driver_flexio_spi_edma
    bool
    select MCUX_USE_driver_edma

config MCUX_USE_driver_flexio_uart_edma
    bool
    select MCUX_USE_driver_edma

config MCUX_USE_driver_lpi2c_edma
    bool
    select MCUX_USE_driver_edma

config MCUX_USE_driver_lpspi_edma
    bool
    select MCUX_USE_driver_edma

config MCUX_USE_driver_lpuart_edma
    bool
    select MCUX_USE_driver_edma

config MCUX_USE_utility_debug_console_lite
    bool
    select MCUX_USE_component_lpuart_adapter


#### SOC level drivers ####
# device_MKE15Z7_CMSIS
config MCUX_USE_device_MKE15Z7_CMSIS
    bool "Device MKE15Z7_cmsis"
    select MCUX_USE_CMSIS_Include_core_cm
    help
      Device MKE15Z7_cmsis

# device_MKE15Z7_startup
config MCUX_USE_device_MKE15Z7_startup
    bool "Device MKE15Z7_startup"
    help
      Device MKE15Z7_startup

# device_MKE15Z7_system
config MCUX_USE_device_MKE15Z7_system
    bool "Device MKE15Z7_system"
    help
      Device MKE15Z7_system

rsource "drivers/Kconfig"

endif # MCUX_USE_SOC_MKE15Z7
```

## devices/MKM34Z7/Kconfig
```kconfig
# Copyright 2023 NXP
# All rights reserved.
#
# SPDX-License-Identifier: BSD-3-Clause

config MCUX_USE_SOC_MKM34Z7
    bool
    select MCUX_CPU_ARCH_ARM_CM0P
if MCUX_USE_SOC_MKM34Z7

# Part Number
config MCUX_SOC_PART_MKM34Z256xxx7
    bool

config MCUX_DEVICE
    default "MKM34Z7"

config MCUX_DEVICE_ID
    default "MKM34Z256xxx7" if MCUX_SOC_PART_MKM34Z256xxx7


# Select supported components
config MCUX_USE_SOC_MKM34Z7
    select MCUX_HAS_CMSIS_DSP_Include
    select MCUX_HAS_CMSIS_DSP_Source
    select MCUX_HAS_CMSIS_Device_API_OSTick
    select MCUX_HAS_CMSIS_Device_API_RTOS2
    select MCUX_HAS_CMSIS_Driver_Include_CAN
    select MCUX_HAS_CMSIS_Driver_Include_Ethernet
    select MCUX_HAS_CMSIS_Driver_Include_Ethernet_MAC
    select MCUX_HAS_CMSIS_Driver_Include_Ethernet_PHY
    select MCUX_HAS_CMSIS_Driver_Include_Flash
    select MCUX_HAS_CMSIS_Driver_Include_I2C
    select MCUX_HAS_CMSIS_Driver_Include_MCI
    select MCUX_HAS_CMSIS_Driver_Include_NAND
    select MCUX_HAS_CMSIS_Driver_Include_SAI
    select MCUX_HAS_CMSIS_Driver_Include_SPI
    select MCUX_HAS_CMSIS_Driver_Include_USART
    select MCUX_HAS_CMSIS_Driver_Include_USB_Device
    select MCUX_HAS_CMSIS_Driver_Include_USB_Host
    select MCUX_HAS_CMSIS_Driver_Include_WiFi
    select MCUX_HAS_CMSIS_Include_core_cm
    select MCUX_HAS_CMSIS_NN_Source
    select MCUX_HAS_CMSIS_RTOS2_NonSecure
    select MCUX_HAS_CMSIS_RTOS2_Secure
    select MCUX_HAS_component_lists
    select MCUX_HAS_component_lptmr_adapter
    select MCUX_HAS_component_lpuart_adapter
    select MCUX_HAS_component_pit_adapter
    select MCUX_HAS_component_serial_manager
    select MCUX_HAS_component_serial_manager_uart
    select MCUX_HAS_component_uart_adapter
    select MCUX_HAS_driver_adc16
    select MCUX_HAS_driver_afe
    select MCUX_HAS_driver_cmp
    select MCUX_HAS_driver_cmsis_i2c
    select MCUX_HAS_driver_cmsis_spi
    select MCUX_HAS_driver_cmsis_uart
    select MCUX_HAS_driver_common
    select MCUX_HAS_driver_crc
    select MCUX_HAS_driver_dma
    select MCUX_HAS_driver_dmamux
    select MCUX_HAS_driver_ewm
    select MCUX_HAS_driver_flash
    select MCUX_HAS_driver_gpio
    select MCUX_HAS_driver_i2c
    select MCUX_HAS_driver_i2c_dma
    select MCUX_HAS_driver_i2c_freertos
    select MCUX_HAS_driver_irtc
    select MCUX_HAS_driver_llwu
    select MCUX_HAS_driver_lptmr
    select MCUX_HAS_driver_lpuart
    select MCUX_HAS_driver_lpuart_dma
    select MCUX_HAS_driver_lpuart_freertos
    select MCUX_HAS_driver_mmau
    select MCUX_HAS_driver_pdb
    select MCUX_HAS_driver_pit
    select MCUX_HAS_driver_pmc
    select MCUX_HAS_driver_port
    select MCUX_HAS_driver_qtmr_2
    select MCUX_HAS_driver_rcm
    select MCUX_HAS_driver_rnga
    select MCUX_HAS_driver_sim
    select MCUX_HAS_driver_slcd
    select MCUX_HAS_driver_smc
    select MCUX_HAS_driver_spi
    select MCUX_HAS_driver_spi_dma
    select MCUX_HAS_driver_spi_freertos
    select MCUX_HAS_driver_sysmpu
    select MCUX_HAS_driver_uart
    select MCUX_HAS_driver_uart_dma
    select MCUX_HAS_driver_uart_freertos
    select MCUX_HAS_driver_vref
    select MCUX_HAS_driver_wdog
    select MCUX_HAS_driver_xbar
    select MCUX_HAS_utilities_misc_utilities
    select MCUX_HAS_utility_assert
    select MCUX_HAS_utility_assert_lite
    select MCUX_HAS_utility_debug_console
    select MCUX_HAS_utility_debug_console_lite
    select MCUX_HAS_utility_notifier
    select MCUX_HAS_utility_shell
    select MCUX_HAS_utility_str

#### SOC specific dependency ####
config MCUX_USE_RTE_Device
    bool
    select MCUX_USE_driver_dma
    select MCUX_USE_driver_dmamux

config MCUX_USE_component_serial_manager_uart
    bool
    select MCUX_USE_component_uart_adapter

config MCUX_USE_driver_cmsis_i2c
    bool
    select MCUX_USE_driver_i2c_dma

config MCUX_USE_driver_cmsis_spi
    bool
    select MCUX_USE_driver_spi_dma

config MCUX_USE_driver_cmsis_uart
    bool
    select MCUX_USE_driver_uart_dma

config MCUX_USE_driver_i2c_dma
    bool
    select MCUX_USE_driver_dma

config MCUX_USE_driver_lpuart_dma
    bool
    select MCUX_USE_driver_dma

config MCUX_USE_driver_spi_dma
    bool
    select MCUX_USE_driver_dma

config MCUX_USE_driver_uart_dma
    bool
    select MCUX_USE_driver_dma

config MCUX_USE_utility_debug_console_lite
    bool
    select MCUX_USE_component_uart_adapter


#### SOC level drivers ####
# device_MKM34Z7_CMSIS
config MCUX_USE_device_MKM34Z7_CMSIS
    bool "Device MKM34Z7_cmsis"
    select MCUX_USE_CMSIS_Include_core_cm
    help
      Device MKM34Z7_cmsis

# device_MKM34Z7_startup
config MCUX_USE_device_MKM34Z7_startup
    bool "Device MKM34Z7_startup"
    help
      Device MKM34Z7_startup

# device_MKM34Z7_system
config MCUX_USE_device_MKM34Z7_system
    bool "Device MKM34Z7_system"
    help
      Device MKM34Z7_system

rsource "drivers/Kconfig"

endif # MCUX_USE_SOC_MKM34Z7
```
