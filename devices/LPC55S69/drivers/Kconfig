## devices/kconfig.devices
```kconfig
# Copyright 2021 NXP
# SPDX-License-Identifier: BSD-3-Clause

config USE_device_CMSIS
    bool 
    depends on HAS_MCUX_SDK_device_CMSIS
    default n
    select USE_CMSIS_Include_core_cm if HAS_MCUX_SDK_CMSIS_Include_core_cm
    select USE_CMSIS_Include_core_cm0plus if HAS_MCUX_SDK_CMSIS_Include_core_cm0plus
    select USE_CMSIS_Include_core_cm4 if HAS_MCUX_SDK_CMSIS_Include_core_cm4

config USE_device_startup
    bool 
    depends on HAS_MCUX_SDK_device_startup
    default n
    select USE_device_system if HAS_MCUX_SDK_device_system

config USE_device_system
    bool 
    depends on HAS_MCUX_SDK_device_system
    default n
    select USE_device_CMSIS if HAS_MCUX_SDK_device_CMSIS

config USE_device_startup_K32L3A60_cm0plus
    bool 
    depends on HAS_MCUX_SDK_device_startup_K32L3A60_cm0plus
    default n
    select USE_device_system_K32L3A60_cm0plus if HAS_MCUX_SDK_device_system_K32L3A60_cm0plus

config USE_device_startup_K32L3A60_cm4
    bool 
    depends on HAS_MCUX_SDK_device_startup_K32L3A60_cm4
    default n
    select USE_device_system_K32L3A60_cm4 if HAS_MCUX_SDK_device_system_K32L3A60_cm4

config USE_device_system_K32L3A60_cm0plus
    bool 
    depends on HAS_MCUX_SDK_device_system_K32L3A60_cm0plus
    default n
    select USE_device_CMSIS if HAS_MCUX_SDK_device_CMSIS

config USE_device_system_K32L3A60_cm4
    bool 
    depends on HAS_MCUX_SDK_device_system_K32L3A60_cm4
    default n
    select USE_device_CMSIS if HAS_MCUX_SDK_device_CMSIS

config USE_device_startup_LPC54114_cm0plus
    bool 
    depends on HAS_MCUX_SDK_device_startup_LPC54114_cm0plus
    default n
    select USE_device_system_LPC54114_cm0plus if HAS_MCUX_SDK_device_system_LPC54114_cm0plus

config USE_device_startup_LPC54114_cm4
    bool 
    depends on HAS_MCUX_SDK_device_startup_LPC54114_cm4
    default n
    select USE_device_system_LPC54114_cm4 if HAS_MCUX_SDK_device_system_LPC54114_cm4

config USE_device_system_LPC54114_cm0plus
    bool 
    depends on HAS_MCUX_SDK_device_system_LPC54114_cm0plus
    default n
    select USE_device_CMSIS if HAS_MCUX_SDK_device_CMSIS

config USE_device_system_LPC54114_cm4
    bool 
    depends on HAS_MCUX_SDK_device_system_LPC54114_cm4
    default n
    select USE_device_CMSIS if HAS_MCUX_SDK_device_CMSIS

config USE_device_startup_LPC55S69_cm33_core0
    bool 
    depends on HAS_MCUX_SDK_device_startup_LPC55S69_cm33_core0
    default n
    select USE_device_system_LPC55S69_cm33_core0 if HAS_MCUX_SDK_device_system_LPC55S69_cm33_core0

config USE_device_startup_LPC55S69_cm33_core1
    bool 
    depends on HAS_MCUX_SDK_device_startup_LPC55S69_cm33_core1
    default n
    select USE_device_system_LPC55S69_cm33_core1 if HAS_MCUX_SDK_device_system_LPC55S69_cm33_core1

config USE_device_system_LPC55S69_cm33_core0
    bool 
    depends on HAS_MCUX_SDK_device_system_LPC55S69_cm33_core0
    default n
    select USE_device_CMSIS if HAS_MCUX_SDK_device_CMSIS

config USE_device_system_LPC55S69_cm33_core1
    bool 
    depends on HAS_MCUX_SDK_device_system_LPC55S69_cm33_core1
    default n
    select USE_device_CMSIS if HAS_MCUX_SDK_device_CMSIS

config USE_device_startup_MIMX8QM6_cm4_core0
    bool 
    depends on HAS_MCUX_SDK_device_startup_MIMX8QM6_cm4_core0
    default n

config USE_device_startup_MIMX8QM6_cm4_core1
    bool 
    depends on HAS_MCUX_SDK_device_startup_MIMX8QM6_cm4_core1
    default n

config USE_device_startup_MIMXRT1166_cm4
    bool 
    depends on HAS_MCUX_SDK_device_startup_MIMXRT1166_cm4
    default n
    select USE_device_system_MIMXRT1166_cm4 if HAS_MCUX_SDK_device_system_MIMXRT1166_cm4

config USE_device_startup_MIMXRT1166_cm7
    bool 
    depends on HAS_MCUX_SDK_device_startup_MIMXRT1166_cm7
    default n
    select USE_device_system_MIMXRT1166_cm7 if HAS_MCUX_SDK_device_system_MIMXRT1166_cm7

config USE_device_system_MIMXRT1166_cm4
    bool 
    depends on HAS_MCUX_SDK_device_system_MIMXRT1166_cm4
    default n
    select USE_device_CMSIS if HAS_MCUX_SDK_device_CMSIS

config USE_device_system_MIMXRT1166_cm7
    bool 
    depends on HAS_MCUX_SDK_device_system_MIMXRT1166_cm7
    default n
    select USE_device_CMSIS if HAS_MCUX_SDK_device_CMSIS

config USE_device_startup_MIMXRT1176_cm4
    bool 
    depends on HAS_MCUX_SDK_device_startup_MIMXRT1176_cm4
    default n
    select USE_device_system_MIMXRT1176_cm4 if HAS_MCUX_SDK_device_system_MIMXRT1176_cm4

config USE_device_startup_MIMXRT1176_cm7
    bool 
    depends on HAS_MCUX_SDK_device_startup_MIMXRT1176_cm7
    default n
    select USE_device_system_MIMXRT1176_cm7 if HAS_MCUX_SDK_device_system_MIMXRT1176_cm7

config USE_device_system_MIMXRT1176_cm4
    bool 
    depends on HAS_MCUX_SDK_device_system_MIMXRT1176_cm4
    default n
    select USE_device_CMSIS if HAS_MCUX_SDK_device_CMSIS

config USE_device_system_MIMXRT1176_cm7
    bool 
    depends on HAS_MCUX_SDK_device_system_MIMXRT1176_cm7
    default n
    select USE_device_CMSIS if HAS_MCUX_SDK_device_CMSIS

config HAS_MCUX_SDK_device_CMSIS
    bool


config HAS_MCUX_SDK_device_startup
    bool


config HAS_MCUX_SDK_device_system
    bool


config HAS_MCUX_SDK_device_startup_K32L3A60_cm0plus
    bool


config HAS_MCUX_SDK_device_startup_K32L3A60_cm4
    bool


config HAS_MCUX_SDK_device_system_K32L3A60_cm0plus
    bool


config HAS_MCUX_SDK_device_system_K32L3A60_cm4
    bool


config HAS_MCUX_SDK_device_startup_LPC54114_cm0plus
    bool


config HAS_MCUX_SDK_device_startup_LPC54114_cm4
    bool


config HAS_MCUX_SDK_device_system_LPC54114_cm0plus
    bool


config HAS_MCUX_SDK_device_system_LPC54114_cm4
    bool


config HAS_MCUX_SDK_device_startup_LPC55S69_cm33_core0
    bool


config HAS_MCUX_SDK_device_startup_LPC55S69_cm33_core1
    bool


config HAS_MCUX_SDK_device_system_LPC55S69_cm33_core0
    bool


config HAS_MCUX_SDK_device_system_LPC55S69_cm33_core1
    bool


config HAS_MCUX_SDK_device_startup_MIMX8QM6_cm4_core0
    bool


config HAS_MCUX_SDK_device_startup_MIMX8QM6_cm4_core1
    bool


config HAS_MCUX_SDK_device_startup_MIMXRT1166_cm4
    bool


config HAS_MCUX_SDK_device_startup_MIMXRT1166_cm7
    bool


config HAS_MCUX_SDK_device_system_MIMXRT1166_cm4
    bool


config HAS_MCUX_SDK_device_system_MIMXRT1166_cm7
    bool


config HAS_MCUX_SDK_device_startup_MIMXRT1176_cm4
    bool


config HAS_MCUX_SDK_device_startup_MIMXRT1176_cm7
    bool


config HAS_MCUX_SDK_device_system_MIMXRT1176_cm4
    bool


config HAS_MCUX_SDK_device_system_MIMXRT1176_cm7
    bool
```

## drivers/Kconfig
```kconfig
# Copyright 2023 NXP
# All rights reserved.
#
# SPDX-License-Identifier: BSD-3-Clause

menu "Driver Configuration"

rsource "./*/Kconfig"

endmenu
```

## drivers/acmp/Kconfig
```kconfig
# Copyright 2023 NXP
# All rights reserved.
#
# SPDX-License-Identifier: BSD-3-Clause

# driver_acmp
config MCUX_HAS_driver_acmp
    bool

config MCUX_USE_driver_acmp
    depends on MCUX_HAS_driver_acmp
    bool "ACMP Driver"
    select MCUX_USE_driver_common
    help
      ACMP Driver
```

## drivers/acmp_1/Kconfig
```kconfig
# Copyright 2023 NXP
# All rights reserved.
#
# SPDX-License-Identifier: BSD-3-Clause

# driver_acmp_1
config MCUX_HAS_driver_acmp_1
    bool

config MCUX_USE_driver_acmp_1
    depends on MCUX_HAS_driver_acmp_1
    bool "ACMP Driver"
    select MCUX_USE_driver_common
    help
      ACMP Driver
```

## drivers/adc12/Kconfig
```kconfig
# Copyright 2023 NXP
# All rights reserved.
#
# SPDX-License-Identifier: BSD-3-Clause

# driver_adc12
config MCUX_HAS_driver_adc12
    bool

config MCUX_USE_driver_adc12
    depends on MCUX_HAS_driver_adc12
    bool "ADC12 Driver"
    select MCUX_USE_driver_common
    help
      ADC12 Driver
```
