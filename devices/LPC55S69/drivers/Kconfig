## devices/MIMXRT1166/drivers/Kconfig
```kconfig
# Copyright 2023 NXP
# All rights reserved.
#
# SPDX-License-Identifier: BSD-3-Clause

# driver_anatop_ai
config MCUX_USE_driver_anatop_ai
    bool "ANATOP AI Driver"
    select MCUX_USE_driver_common
    help
      ANATOP AI Driver

# driver_clock
config MCUX_USE_driver_clock
    bool "Clock Driver"
    select MCUX_USE_driver_common
    select MCUX_USE_driver_anatop_ai
    select MCUX_USE_driver_pmu_1
    help
      Clock Driver

# driver_dcdc_soc
config MCUX_USE_driver_dcdc_soc
    bool "DCDC SOC Driver"
    select MCUX_USE_driver_common
    help
      DCDC SOC Driver

# driver_gpc_3
config MCUX_USE_driver_gpc_3
    bool "GPC Driver"
    select MCUX_USE_driver_common
    help
      GPC Driver

# driver_iomuxc
config MCUX_USE_driver_iomuxc
    bool "IOMUXC Driver"
    select MCUX_USE_driver_common
    help
      IOMUXC Driver

# driver_memory
config MCUX_USE_driver_memory
    bool "Memory Driver"
    select MCUX_USE_driver_common
    help
      MEMORY Driver

# driver_nic301
config MCUX_USE_driver_nic301
    bool "NIC301 Driver"
    select MCUX_USE_driver_common
    help
      NIC301 Driver

# driver_pgmc
config MCUX_USE_driver_pgmc
    bool "PGMC Driver"
    select MCUX_USE_driver_common
    help
      PGMC Driver

# driver_pmu_1
config MCUX_USE_driver_pmu_1
    bool "PMU Driver"
    select MCUX_USE_driver_common
    select MCUX_USE_driver_anatop_ai
    help
      PMU Driver

# driver_romapi
config MCUX_USE_driver_romapi
    bool "ROMAPI Driver"
    select MCUX_USE_driver_common
    help
      ROMAPI Driver

# driver_soc_flexram_allocate
config MCUX_USE_driver_soc_flexram_allocate
    bool "SOC FLEXRAM ALLOCATE Driver"
    select MCUX_USE_driver_common
    help
      SOC FLEXRAM ALLOCATE Driver

# driver_soc_mipi_csi2rx
config MCUX_USE_driver_soc_mipi_csi2rx
    bool "SOC MIPI CSI2RX Driver"
    select MCUX_USE_driver_common
    help
      SOC MIPI CSI2RX Driver

# driver_soc_src
config MCUX_USE_driver_soc_src
    bool "SOC SRC Driver"
    select MCUX_USE_driver_common
    help
      SOC SRC Driver
```

## devices/MIMXRT595S/drivers/Kconfig
```kconfig
# Copyright 2023 NXP
# All rights reserved.
#
# SPDX-License-Identifier: BSD-3-Clause

# driver_clock
config MCUX_USE_driver_clock
    bool "Clock Driver"
    select MCUX_USE_driver_common
    help
      Clock Driver

# driver_dsp
config MCUX_USE_driver_dsp
    bool "dsp Driver"
    select MCUX_USE_driver_power
    select MCUX_USE_driver_common
    help
      dsp Driver

# driver_iap
config MCUX_USE_driver_iap
    bool "IAP Driver"
    select MCUX_USE_driver_common
    help
      ROMIAP Driver

# driver_inputmux_connections
config MCUX_USE_driver_inputmux_connections
    bool "Inputmux_connections Driver"
    select MCUX_USE_driver_common
    help
      Inputmux_connections Driver

# driver_memory
config MCUX_USE_driver_memory
    bool "Memory Driver"
    select MCUX_USE_driver_common
    help
      MEMORY Driver

# driver_power
config MCUX_USE_driver_power
    bool "Driver power"
    select MCUX_USE_driver_common
    help
      Power driver

# driver_reset
config MCUX_USE_driver_reset
    bool "Reset Driver"
    select MCUX_USE_driver_common
    help
      Reset Driver

# driver_soc_mipi_dsi
config MCUX_USE_driver_soc_mipi_dsi
    bool "SOC MIPI DSI Driver"
    select MCUX_USE_driver_common
    help
      SOC MIPI DSI Driver
```

## devices/MIMXRT685S/Kconfig
```kconfig
# Copyright 2023 NXP
# All rights reserved.
#
# SPDX-License-Identifier: BSD-3-Clause

config MCUX_USE_SOC_MIMXRT685S_CM33
    bool
    select MCUX_USE_SOC_MIMXRT685S
    select MCUX_CPU_ARCH_ARM_CM33
    select MCUX_CPU_HAS_SP_FPU
    select MCUX_CPU_ARM_HAS_DSP

config MCUX_USE_SOC_MIMXRT685S
    bool

if MCUX_USE_SOC_MIMXRT685S

# Part Number
config MCUX_SOC_PART_MIMXRT685S
    bool

config MCUX_DEVICE
    default "MIMXRT685S"

config MCUX_DEVICE_ID
    default "MIMXRT685S" if MCUX_SOC_PART_MIMXRT685S

config MCUX_CORE_ID
    default "cm33" if MCUX_USE_SOC_MIMXRT685S_CM33

# Select supported components
config MCUX_USE_SOC_MIMXRT685S
    select MCUX_HAS_CMSIS_DSP_Include
    select MCUX_HAS_CMSIS_DSP_Source
    select MCUX_HAS_CMSIS_Device_API_OSTick
    select MCUX_HAS_CMSIS_Device_API_RTOS2
    select MCUX_HAS_CMSIS_Driver_Include_CAN
    select MCUX_HAS_CMSIS_Driver_Include_Ethernet
    select MCUX_HAS_CMSIS_Driver_Include_Ethernet_MAC
    select MCUX_HAS_CMSIS_Driver_Include_Ethernet_PHY
    select MCUX_HAS_CMSIS_Driver_Include_Flash
    select MCUX_HAS_CMSIS_Driver_Include_I2C
    select MCUX_HAS_CMSIS_Driver_Include_MCI
    select MCUX_HAS_CMSIS_Driver_Include_NAND
    select MCUX_HAS_CMSIS_Driver_Include_SAI
    select MCUX_HAS_CMSIS_Driver_Include_SPI
    select MCUX_HAS_CMSIS_Driver_Include_USART
    select MCUX_HAS_CMSIS_Driver_Include_USB_Device
    select MCUX_HAS_CMSIS_Driver_Include_USB_Host
    select MCUX_HAS_CMSIS_Driver_Include_WiFi
    select MCUX_HAS_CMSIS_Include_core_cm
    select MCUX_HAS_CMSIS_NN_Source
    select MCUX_HAS_CMSIS_RTOS2_NonSecure
    select MCUX_HAS_CMSIS_RTOS2_Secure
    select MCUX_HAS_component_ctimer_adapter
    select MCUX_HAS_component_flexcomm_i2c_adapter
    select MCUX_HAS_component_flexcomm_spi_adapter
    select MCUX_HAS_component_i3c_adapter
    select MCUX_HAS_component_lists
    select MCUX_HAS_component_lpc_gpio_adapter
    select MCUX_HAS_component_mrt_adapter
    select MCUX_HAS_component_ostimer_adapter
    select MCUX_HAS_component_rt_gpio_adapter
    select MCUX_HAS_component_serial_manager
    select MCUX_HAS_component_serial_manager_spi
    select MCUX_HAS_component_serial_manager_swo if (MCUX_CPU_ARCH_ARM_CM33)
    select MCUX_HAS_component_serial_manager_uart
    select MCUX_HAS_component_usart_adapter
    select MCUX_HAS_component_usart_dma_adapter
    select MCUX_HAS_driver_acmp
    select MCUX_HAS_driver_cache_cache64
    select MCUX_HAS_driver_casper
    select MCUX_HAS_driver_cmsis_flexcomm_i2c
    select MCUX_HAS_driver_cmsis_flexcomm_spi
    select MCUX_HAS_driver_cmsis_flexcomm_usart
    select MCUX_HAS_driver_common
    select MCUX_HAS_driver_ctimer
    select MCUX_HAS_driver_dmic
    select MCUX_HAS_driver_dmic_dma
    select MCUX_HAS_driver_flexcomm
    select MCUX_HAS_driver_flexcomm_i2c
    select MCUX_HAS_driver_flexcomm_i2c_dma
    select MCUX_HAS_driver_flexcomm_i2c_freertos
    select MCUX_HAS_driver_flexcomm_i2s
    select MCUX_HAS_driver_flexcomm_i2s_dma
    select MCUX_HAS_driver_flexcomm_spi
    select MCUX_HAS_driver_flexcomm_spi_dma
    select MCUX_HAS_driver_flexcomm_spi_freertos
    select MCUX_HAS_driver_flexcomm_usart
    select MCUX_HAS_driver_flexcomm_usart_dma
    select MCUX_HAS_driver_flexcomm_usart_freertos
    select MCUX_HAS_driver_flexspi
    select MCUX_HAS_driver_flexspi_dma
    select MCUX_HAS_driver_fmeas
    select MCUX_HAS_driver_hashcrypt
    select MCUX_HAS_driver_i3c
    select MCUX_HAS_driver_iap
    select MCUX_HAS_driver_inputmux
    select MCUX_HAS_driver_lpadc
    select MCUX_HAS_driver_lpc_crc
    select MCUX_HAS_driver_lpc_dma
    select MCUX_HAS_driver_lpc_gpio
    select MCUX_HAS_driver_lpc_iopctl
    select MCUX_HAS_driver_lpc_rtc
    select MCUX_HAS_driver_mrt
    select MCUX_HAS_driver_mu
    select MCUX_HAS_driver_ostimer
    select MCUX_HAS_driver_otfad
    select MCUX_HAS_driver_pint
    select MCUX_HAS_driver_powerquad
    select MCUX_HAS_driver_powerquad_cmsis
    select MCUX_HAS_driver_puf
    select MCUX_HAS_driver_sctimer
    select MCUX_HAS_driver_sema42
    select MCUX_HAS_driver_trng
    select MCUX_HAS_driver_usdhc
    select MCUX_HAS_driver_utick
    select MCUX_HAS_driver_wwdt
    select MCUX_HAS_utilities_misc_utilities
    select MCUX_HAS_utility_assert
    select MCUX_HAS_utility_assert_lite
    select MCUX_HAS_utility_debug_console
    select MCUX_HAS_utility_debug_console_lite
    select MCUX_HAS_utility_shell
    select MCUX_HAS_utility_str

#### SOC specific dependency ####
config MCUX_USE_component_serial_manager_uart
    bool
    select MCUX_USE_component_usart_adapter

config MCUX_USE_driver_dmic_dma
    bool
    select MCUX_USE_driver_lpc_dma

config MCUX_USE_driver_dsp
    bool
    select MCUX_USE_driver_power

config MCUX_USE_driver_flexcomm_i2c_dma
    bool
    select MCUX_USE_driver_lpc_dma

config MCUX_USE_driver_flexcomm_i2s_dma
    bool
    select MCUX_USE_driver_lpc_dma

config MCUX_USE_driver_flexcomm_spi_dma
    bool
    select MCUX_USE_driver_lpc_dma

config MCUX_USE_driver_flexcomm_usart_dma
    bool
    select MCUX_USE_driver_lpc_dma

config MCUX_USE_driver_flexspi_dma
    bool
    select MCUX_USE_driver_lpc_dma

config MCUX_USE_driver_iap
    bool
    select MCUX_USE_driver_common

config MCUX_USE_driver_pca9420
    bool
    select MCUX_USE_driver_power

config MCUX_USE_driver_utick
    bool
    select MCUX_USE_driver_power

config MCUX_USE_utility_debug_console_lite
    bool
    select MCUX_USE_component_usart_adapter


#### SOC level drivers ####
# device_MIMXRT685S_CMSIS
config MCUX_USE_device_MIMXRT685S_CMSIS
    bool "Device MIMXRT685S_cmsis"
    select MCUX_USE_CMSIS_Include_core_cm
    help
      Device MIMXRT685S_cmsis

# device_MIMXRT685S_startup
config MCUX_USE_device_MIMXRT685S_startup
    bool "Device MIMXRT685S_startup"
    help
      Device MIMXRT685S_startup

rsource "drivers/Kconfig"

endif # MCUX_USE_SOC_MIMXRT685S
```

## devices/MIMXRT685S/drivers/Kconfig
```kconfig
# Copyright 2023 NXP
# All rights reserved.
#
# SPDX-License-Identifier: BSD-3-Clause

# driver_clock
config MCUX_USE_driver_clock
    bool "Clock Driver"
    select MCUX_USE_driver_common
    help
      Clock Driver

# driver_dsp
config MCUX_USE_driver_dsp
    bool "dsp Driver"
    select MCUX_USE_driver_power
    select MCUX_USE_driver_common
    help
      dsp Driver

# driver_iap
config MCUX_USE_driver_iap
    bool "IAP Driver"
    select MCUX_USE_driver_common
    help
      ROMIAP Driver

# driver_inputmux_connections
config MCUX_USE_driver_inputmux_connections
    bool "Inputmux_connections Driver"
    select MCUX_USE_driver_common
    help
      Inputmux_connections Driver

# driver_power
config MCUX_USE_driver_power
    bool "Driver power"
    select MCUX_USE_driver_common
    help
      Power driver

# driver_reset
config MCUX_USE_driver_reset
    bool "Reset Driver"
    select MCUX_USE_driver_common
    help
      Reset Driver
```

## devices/MKE02Z4/Kconfig
```kconfig
# Copyright 2023 NXP
# All rights reserved.
#
# SPDX-License-Identifier: BSD-3-Clause

config MCUX_USE_SOC_MKE02Z4
    bool
    select MCUX_CPU_ARCH_ARM_CM0P
if MCUX_USE_SOC_MKE02Z4

# Part Number
config MCUX_SOC_PART_MKE02Z16xxx4
    bool

config MCUX_SOC_PART_MKE02Z32xxx4
    bool

config MCUX_SOC_PART_MKE02Z64xxx4
    bool

config MCUX_DEVICE
    default "MKE02Z4"

config MCUX_DEVICE_ID
    default "MKE02Z16xxx4" if MCUX_SOC_PART_MKE02Z16xxx4
    default "MKE02Z32xxx4" if MCUX_SOC_PART_MKE02Z32xxx4
    default "MKE02Z64xxx4" if MCUX_SOC_PART_MKE02Z64xxx4


# Select supported components
config MCUX_USE_SOC_MKE02Z4
    select MCUX_HAS_CMSIS_DSP_Include
    select MCUX_HAS_CMSIS_DSP_Source
    select MCUX_HAS_CMSIS_Device_API_OSTick
    select MCUX_HAS_CMSIS_Device_API_RTOS2
    select MCUX_HAS_CMSIS_Driver_Include_CAN
    select MCUX_HAS_CMSIS_Driver_Include_Ethernet
    select MCUX_HAS_CMSIS_Driver_Include_Ethernet_MAC
    select MCUX_HAS_CMSIS_Driver_Include_Ethernet_PHY
    select MCUX_HAS_CMSIS_Driver_Include_Flash
    select MCUX_HAS_CMSIS_Driver_Include_I2C
    select MCUX_HAS_CMSIS_Driver_Include_MCI
    select MCUX_HAS_CMSIS_Driver_Include_NAND
    select MCUX_HAS_CMSIS_Driver_Include_SAI
    select MCUX_HAS_CMSIS_Driver_Include_SPI
    select MCUX_HAS_CMSIS_Driver_Include_USART
    select MCUX_HAS_CMSIS_Driver_Include_USB_Device
    select MCUX_HAS_CMSIS_Driver_Include_USB_Host
    select MCUX_HAS_CMSIS_Driver_Include_WiFi
    select MCUX_HAS_CMSIS_Include_core_cm
    select MCUX_HAS_CMSIS_NN_Source
    select MCUX_HAS_CMSIS_RTOS2_NonSecure
    select MCUX_HAS_CMSIS_RTOS2_Secure
    select MCUX_HAS_component_ftm_adapter
    select MCUX_HAS_component_i2c_adapter
    select MCUX_HAS_component_lists
    select MCUX_HAS_component_pit_adapter
    select MCUX_HAS_component_serial_manager
    select MCUX_HAS_component_serial_manager_spi
    select MCUX_HAS_component_serial_manager_uart
    select MCUX_HAS_component_spi_adapter
    select MCUX_HAS_component_tpm_adapter
    select MCUX_HAS_component_uart_adapter
    select MCUX_HAS_driver_acmp_1
    select MCUX_HAS_driver_adc_5v12b_ll18_015
    select MCUX_HAS_driver_cmsis_i2c
    select MCUX_HAS_driver_cmsis_spi
    select MCUX_HAS_driver_cmsis_uart
    select MCUX_HAS_driver_common
    select MCUX_HAS_driver_flash_ftmr
    select MCUX_HAS_driver_ftm
    select MCUX_HAS_driver_gpio_1
    select MCUX_HAS_driver_i2c
    select MCUX_HAS_driver_irq
    select MCUX_HAS_driver_kbi
    select MCUX_HAS_driver_pit
    select MCUX_HAS_driver_rtc_1
    select MCUX_HAS_driver_spi
    select MCUX_HAS_driver_tpm
    select MCUX_HAS_driver_uart
    select MCUX_HAS_driver_wdog8
    select MCUX_HAS_utilities_misc_utilities
    select MCUX_HAS_utility_assert
    select MCUX_HAS_utility_assert_lite
    select MCUX_HAS_utility_debug_console
    select MCUX_HAS_utility_debug_console_lite
    select MCUX_HAS_utility_notifier
    select MCUX_HAS_utility_shell
    select MCUX_HAS_utility_str

#### SOC specific dependency ####
config MCUX_USE_component_serial_manager_uart
    bool
    select MCUX_USE_component_uart_adapter

config MCUX_USE_utility_debug_console_lite
    bool
    select MCUX_USE_component_uart_adapter


#### SOC level drivers ####
# device_MKE02Z4_CMSIS
config MCUX_USE_device_MKE02Z4_CMSIS
    bool "Device MKE02Z4_cmsis"
    select MCUX_USE_CMSIS_Include_core_cm
    help
      Device MKE02Z4_cmsis

# device_MKE02Z4_startup
config MCUX_USE_device_MKE02Z4_startup
    bool "Device MKE02Z4_startup"
    help
      Device MKE02Z4_startup

# device_MKE02Z4_system
config MCUX_USE_device_MKE02Z4_system
    bool "Device MKE02Z4_system"
    help
      Device MKE02Z4_system

rsource "drivers/Kconfig"

endif # MCUX_USE_SOC_MKE02Z4
```

## devices/MKE02Z4/drivers/Kconfig
```kconfig
# Copyright 2023 NXP
# All rights reserved.
#
# SPDX-License-Identifier: BSD-3-Clause

# driver_clock
config MCUX_USE_driver_clock
    bool "Clock Driver"
    select MCUX_USE_driver_common
    help
      Clock Driver

# driver_port_ke02
config MCUX_USE_driver_port_ke02
    bool "port Driver"
    select MCUX_USE_driver_common
    help
      PORT Driver
```
