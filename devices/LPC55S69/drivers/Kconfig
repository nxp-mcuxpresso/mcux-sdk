## devices/LPC55S69/drivers/Kconfig
```kconfig
# Copyright 2023 NXP
# All rights reserved.
#
# SPDX-License-Identifier: BSD-3-Clause

# driver_clock
menuconfig MCUX_USE_driver_clock
    bool "Clock Driver"
    select MCUX_USE_driver_common

    help
      Clock Driver

    if MCUX_USE_driver_clock

    config MCUX_driver_clock_USE_power
        depends on MCUX_HAS_driver_power
        bool "Use power"
        select MCUX_USE_driver_power

    endif # MCUX_USE_driver_clock

# driver_inputmux_connections
config MCUX_USE_driver_inputmux_connections
    bool "Inputmux_connections Driver"
    select MCUX_USE_driver_common
    help
      Inputmux_connections Driver

# driver_power
config MCUX_USE_driver_power
    bool "Driver power"
    select MCUX_USE_driver_common
    help
      Power driver

# driver_reset
config MCUX_USE_driver_reset
    bool "Reset Driver"
    select MCUX_USE_driver_common
    help
      Reset Driver
```

## devices/LPC802/Kconfig
```kconfig
# Copyright 2023 NXP
# All rights reserved.
#
# SPDX-License-Identifier: BSD-3-Clause

config MCUX_USE_SOC_LPC802
    bool
    select MCUX_CPU_ARCH_ARM_CM0P
if MCUX_USE_SOC_LPC802

# Part Number
config MCUX_SOC_PART_LPC802
    bool

config MCUX_DEVICE
    default "LPC802"

config MCUX_DEVICE_ID
    default "LPC802" if MCUX_SOC_PART_LPC802


# Select supported components
config MCUX_USE_SOC_LPC802
    select MCUX_HAS_CMSIS_DSP_Include
    select MCUX_HAS_CMSIS_DSP_Source
    select MCUX_HAS_CMSIS_Device_API_OSTick
    select MCUX_HAS_CMSIS_Device_API_RTOS2
    select MCUX_HAS_CMSIS_Driver_Include_CAN
    select MCUX_HAS_CMSIS_Driver_Include_Ethernet
    select MCUX_HAS_CMSIS_Driver_Include_Ethernet_MAC
    select MCUX_HAS_CMSIS_Driver_Include_Ethernet_PHY
    select MCUX_HAS_CMSIS_Driver_Include_Flash
    select MCUX_HAS_CMSIS_Driver_Include_I2C
    select MCUX_HAS_CMSIS_Driver_Include_MCI
    select MCUX_HAS_CMSIS_Driver_Include_NAND
    select MCUX_HAS_CMSIS_Driver_Include_SAI
    select MCUX_HAS_CMSIS_Driver_Include_SPI
    select MCUX_HAS_CMSIS_Driver_Include_USART
    select MCUX_HAS_CMSIS_Driver_Include_USB_Device
    select MCUX_HAS_CMSIS_Driver_Include_USB_Host
    select MCUX_HAS_CMSIS_Driver_Include_WiFi
    select MCUX_HAS_CMSIS_Include_core_cm
    select MCUX_HAS_CMSIS_NN_Source
    select MCUX_HAS_CMSIS_RTOS2_NonSecure
    select MCUX_HAS_CMSIS_RTOS2_Secure
    select MCUX_HAS_component_ctimer_adapter
    select MCUX_HAS_component_lists
    select MCUX_HAS_component_lpc_i2c_adapter
    select MCUX_HAS_component_miniusart_adapter
    select MCUX_HAS_component_mrt_adapter
    select MCUX_HAS_driver_common
    select MCUX_HAS_driver_ctimer
    select MCUX_HAS_driver_iap
    select MCUX_HAS_driver_lpc_acomp
    select MCUX_HAS_driver_lpc_adc
    select MCUX_HAS_driver_lpc_crc
    select MCUX_HAS_driver_lpc_gpio
    select MCUX_HAS_driver_lpc_i2c
    select MCUX_HAS_driver_lpc_iocon_lite
    select MCUX_HAS_driver_lpc_minispi
    select MCUX_HAS_driver_lpc_miniusart
    select MCUX_HAS_driver_mrt
    select MCUX_HAS_driver_pint
    select MCUX_HAS_driver_swm
    select MCUX_HAS_driver_syscon
    select MCUX_HAS_driver_wkt
    select MCUX_HAS_driver_wwdt
    select MCUX_HAS_utilities_misc_utilities
    select MCUX_HAS_utility_assert_lite
    select MCUX_HAS_utility_debug_console_lite

#### SOC specific dependency ####
config MCUX_USE_component_lpc_gpio_adapter
    bool
    select MCUX_USE_driver_syscon

config MCUX_USE_utility_debug_console_lite
    bool
    select MCUX_USE_component_miniusart_adapter


#### SOC level drivers ####
# device_LPC802_CMSIS
config MCUX_USE_device_LPC802_CMSIS
    bool "Device LPC802_cmsis"
    select MCUX_USE_CMSIS_Include_core_cm
    help
      Device LPC802_cmsis

# device_LPC802_startup
config MCUX_USE_device_LPC802_startup
    bool "Device LPC802_startup"
    help
      Device LPC802_startup

# device_LPC802_system
config MCUX_USE_device_LPC802_system
    bool "Device LPC802_system"
    help
      Device LPC802_system

rsource "drivers/Kconfig"

endif # MCUX_USE_SOC_LPC802
```

## devices/LPC824/Kconfig
```kconfig
# Copyright 2023 NXP
# All rights reserved.
#
# SPDX-License-Identifier: BSD-3-Clause

config MCUX_USE_SOC_LPC824
    bool
    select MCUX_CPU_ARCH_ARM_CM0P
if MCUX_USE_SOC_LPC824

# Part Number
config MCUX_SOC_PART_LPC824
    bool

config MCUX_DEVICE
    default "LPC824"

config MCUX_DEVICE_ID
    default "LPC824" if MCUX_SOC_PART_LPC824


# Select supported components
config MCUX_USE_SOC_LPC824
    select MCUX_HAS_CMSIS_DSP_Include
    select MCUX_HAS_CMSIS_DSP_Source
    select MCUX_HAS_CMSIS_Device_API_OSTick
    select MCUX_HAS_CMSIS_Device_API_RTOS2
    select MCUX_HAS_CMSIS_Driver_Include_CAN
    select MCUX_HAS_CMSIS_Driver_Include_Ethernet
    select MCUX_HAS_CMSIS_Driver_Include_Ethernet_MAC
    select MCUX_HAS_CMSIS_Driver_Include_Ethernet_PHY
    select MCUX_HAS_CMSIS_Driver_Include_Flash
    select MCUX_HAS_CMSIS_Driver_Include_I2C
    select MCUX_HAS_CMSIS_Driver_Include_MCI
    select MCUX_HAS_CMSIS_Driver_Include_NAND
    select MCUX_HAS_CMSIS_Driver_Include_SAI
    select MCUX_HAS_CMSIS_Driver_Include_SPI
    select MCUX_HAS_CMSIS_Driver_Include_USART
    select MCUX_HAS_CMSIS_Driver_Include_USB_Device
    select MCUX_HAS_CMSIS_Driver_Include_USB_Host
    select MCUX_HAS_CMSIS_Driver_Include_WiFi
    select MCUX_HAS_CMSIS_Include_core_cm
    select MCUX_HAS_CMSIS_NN_Source
    select MCUX_HAS_CMSIS_RTOS2_NonSecure
    select MCUX_HAS_CMSIS_RTOS2_Secure
    select MCUX_HAS_component_lists
    select MCUX_HAS_component_lpc_gpio_adapter
    select MCUX_HAS_component_lpc_i2c_adapter
    select MCUX_HAS_component_miniusart_adapter
    select MCUX_HAS_component_mrt_adapter
    select MCUX_HAS_driver_common
    select MCUX_HAS_driver_iap
    select MCUX_HAS_driver_inputmux
    select MCUX_HAS_driver_lpc_acomp
    select MCUX_HAS_driver_lpc_adc
    select MCUX_HAS_driver_lpc_crc
    select MCUX_HAS_driver_lpc_dma
    select MCUX_HAS_driver_lpc_gpio
    select MCUX_HAS_driver_lpc_i2c
    select MCUX_HAS_driver_lpc_iocon_lite
    select MCUX_HAS_driver_lpc_minispi
    select MCUX_HAS_driver_lpc_miniusart
    select MCUX_HAS_driver_mrt
    select MCUX_HAS_driver_pint
    select MCUX_HAS_driver_sctimer
    select MCUX_HAS_driver_swm
    select MCUX_HAS_driver_syscon
    select MCUX_HAS_driver_wkt
    select MCUX_HAS_driver_wwdt
    select MCUX_HAS_utilities_misc_utilities
    select MCUX_HAS_utility_assert_lite
    select MCUX_HAS_utility_debug_console_lite

#### SOC specific dependency ####
config MCUX_USE_component_lpc_gpio_adapter
    bool
    select MCUX_USE_driver_syscon

config MCUX_USE_driver_flexcomm_i2c_dma
    bool
    select MCUX_USE_driver_lpc_dma

config MCUX_USE_driver_flexcomm_usart_dma
    bool
    select MCUX_USE_driver_lpc_dma

config MCUX_USE_utility_assert_lite
    bool
    select MCUX_USE_component_miniusart_adapter

config MCUX_USE_utility_debug_console_lite
    bool
    select MCUX_USE_component_miniusart_adapter


#### SOC level drivers ####
# device_LPC824_CMSIS
config MCUX_USE_device_LPC824_CMSIS
    bool "Device LPC824_cmsis"
    select MCUX_USE_CMSIS_Include_core_cm
    help
      Device LPC824_cmsis

# device_LPC824_startup
config MCUX_USE_device_LPC824_startup
    bool "Device LPC824_startup"
    help
      Device LPC824_startup

# device_LPC824_system
config MCUX_USE_device_LPC824_system
    bool "Device LPC824_system"
    help
      Device LPC824_system

rsource "drivers/Kconfig"

endif # MCUX_USE_SOC_LPC824
```

## devices/LPC824/drivers/Kconfig
```kconfig
# Copyright 2023 NXP
# All rights reserved.
#
# SPDX-License-Identifier: BSD-3-Clause

# driver_clock
config MCUX_USE_driver_clock
    bool "Clock Driver"
    select MCUX_USE_driver_power_no_lib
    select MCUX_USE_driver_common
    help
      Clock Driver

# driver_inputmux_connections
config MCUX_USE_driver_inputmux_connections
    bool "Inputmux_connections Driver"
    select MCUX_USE_driver_common
    help
      Inputmux_connections Driver

# driver_power_no_lib
config MCUX_USE_driver_power_no_lib
    bool "power_no_lib"
    select MCUX_USE_driver_common
    help
      Power Driver

# driver_reset
config MCUX_USE_driver_reset
    bool "Reset Driver"
    select MCUX_USE_driver_common
    help
      Reset Driver

# driver_swm_connections
config MCUX_USE_driver_swm_connections
    bool "Swm_connections Driver"
    select MCUX_USE_driver_common
    help
      Swm_connections Driver

# driver_syscon_connections
config MCUX_USE_driver_syscon_connections
    bool "Syscon_connections Driver"
    select MCUX_USE_driver_common
    help
      Syscon_connections Driver
```

## devices/LPC845/Kconfig
```kconfig
# Copyright 2023 NXP
# All rights reserved.
#
# SPDX-License-Identifier: BSD-3-Clause

config MCUX_USE_SOC_LPC845
    bool
    select MCUX_CPU_ARCH_ARM_CM0P
if MCUX_USE_SOC_LPC845

# Part Number
config MCUX_SOC_PART_LPC845
    bool

config MCUX_DEVICE
    default "LPC845"

config MCUX_DEVICE_ID
    default "LPC845" if MCUX_SOC_PART_LPC845


# Select supported components
config MCUX_USE_SOC_LPC845
    select MCUX_HAS_CMSIS_DSP_Include
    select MCUX_HAS_CMSIS_DSP_Source
    select MCUX_HAS_CMSIS_Device_API_OSTick
    select MCUX_HAS_CMSIS_Device_API_RTOS2
    select MCUX_HAS_CMSIS_Driver_Include_CAN
    select MCUX_HAS_CMSIS_Driver_Include_Ethernet
    select MCUX_HAS_CMSIS_Driver_Include_Ethernet_MAC
    select MCUX_HAS_CMSIS_Driver_Include_Ethernet_PHY
    select MCUX_HAS_CMSIS_Driver_Include_Flash
    select MCUX_HAS_CMSIS_Driver_Include_I2C
    select MCUX_HAS_CMSIS_Driver_Include_MCI
    select MCUX_HAS_CMSIS_Driver_Include_NAND
    select MCUX_HAS_CMSIS_Driver_Include_SAI
    select MCUX_HAS_CMSIS_Driver_Include_SPI
    select MCUX_HAS_CMSIS_Driver_Include_USART
    select MCUX_HAS_CMSIS_Driver_Include_USB_Device
    select MCUX_HAS_CMSIS_Driver_Include_USB_Host
    select MCUX_HAS_CMSIS_Driver_Include_WiFi
    select MCUX_HAS_CMSIS_Include_core_cm
    select MCUX_HAS_CMSIS_NN_Source
    select MCUX_HAS_CMSIS_RTOS2_NonSecure
    select MCUX_HAS_CMSIS_RTOS2_Secure
    select MCUX_HAS_component_ctimer_adapter
    select MCUX_HAS_component_lists
    select MCUX_HAS_component_lpc_gpio_adapter
    select MCUX_HAS_component_lpc_i2c_adapter
    select MCUX_HAS_component_miniusart_adapter
    select MCUX_HAS_component_mrt_adapter
    select MCUX_HAS_driver_capt
    select MCUX_HAS_driver_common
    select MCUX_HAS_driver_ctimer
    select MCUX_HAS_driver_iap
    select MCUX_HAS_driver_inputmux
    select MCUX_HAS_driver_lpc_acomp
    select MCUX_HAS_driver_lpc_adc
    select MCUX_HAS_driver_lpc_crc
    select MCUX_HAS_driver_lpc_dac
    select MCUX_HAS_driver_lpc_dma
    select MCUX_HAS_driver_lpc_gpio
    select MCUX_HAS_driver_lpc_i2c
    select MCUX_HAS_driver_lpc_i2c_dma
    select MCUX_HAS_driver_lpc_iocon_lite
    select MCUX_HAS_driver_lpc_minispi
    select MCUX_HAS_driver_lpc_miniusart
    select MCUX_HAS_driver_mrt
    select MCUX_HAS_driver_pint
    select MCUX_HAS_driver_sctimer
    select MCUX_HAS_driver_swm
    select MCUX_HAS_driver_syscon
    select MCUX_HAS_driver_wkt
    select MCUX_HAS_driver_wwdt
    select MCUX_HAS_utilities_misc_utilities
    select MCUX_HAS_utility_assert_lite
    select MCUX_HAS_utility_debug_console_lite

#### SOC specific dependency ####
config MCUX_USE_component_lpc_gpio_adapter
    bool
    select MCUX_USE_driver_syscon

config MCUX_USE_driver_lpc_i2c_dma
    bool
    select MCUX_USE_driver_lpc_dma

config MCUX_USE_utility_assert_lite
    bool
    select MCUX_USE_component_miniusart_adapter

config MCUX_USE_utility_debug_console_lite
    bool
    select MCUX_USE_component_miniusart_adapter


#### SOC level drivers ####
# device_LPC845_CMSIS
config MCUX_USE_device_LPC845_CMSIS
    bool "Device LPC845_cmsis"
    select MCUX_USE_CMSIS_Include_core_cm
    help
      Device LPC845_cmsis

# device_LPC845_startup
config MCUX_USE_device_LPC845_startup
    bool "Device LPC845_startup"
    help
      Device LPC845_startup

# device_LPC845_system
config MCUX_USE_device_LPC845_system
    bool "Device LPC845_system"
    help
      Device LPC845_system

rsource "drivers/Kconfig"

endif # MCUX_USE_SOC_LPC845
```
